## src/linux/adm5120/linux-2.6.23/arch/mips/adm5120/Kconfig
```kconfig
if MIPS_ADM5120

menu "ADM5120 Implementation Options"

config ADM5120_COMPEX_WP54G
	bool "compex wp54g support"
	default n

config ADM5120_COMPEX_NP28G
	bool "compex wp54g support"
	default n

config ADM5120_CPU_OVERRIDES
	bool "Enable CPU feature overrides"
	default y

config PCI_ADM5120
	bool "Enable PCI support"
	select PCI
	default y

endmenu

config ARM_AMBA
	bool
	default y

endif
```

## src/linux/ar531x/linux-2.6.24/drivers/spi/algos/Kconfig
```kconfig
#
# SPI algorithm device configuration
#

menu "SPI Algorithms"
	depends on SPI

config SPI_ALGOBIT
	tristate "SPI bit-banging interfaces"
	depends on SPI
	help
	  This allows you to use a range of SPI adapters called bit-banging
	  adapters.  Say Y if you own an SPI adapter belonging to this class
	  and then say Y to the specific driver for you adapter below.

	  This support is also available as a module.  If so, the module 
	  will be called spi-algo-bit.

endmenu
```

## src/linux/brcm/linux-2.6.23/drivers/net/hnd/Kconfig
```kconfig
#
# Broadcom Home Networking Division (HND) driver configuration
#
# Copyright (C) 2008, Broadcom Corporation
# All Rights Reserved.
# 
# THIS SOFTWARE IS OFFERED "AS IS", AND BROADCOM GRANTS NO WARRANTIES OF ANY
# KIND, EXPRESS OR IMPLIED, BY STATUTE, COMMUNICATION OR OTHERWISE. BROADCOM
# SPECIFICALLY DISCLAIMS ANY IMPLIED WARRANTIES OF MERCHANTABILITY, FITNESS
# FOR A SPECIFIC PURPOSE OR NONINFRINGEMENT CONCERNING THIS SOFTWARE.
#
# $Id: Kconfig,v 1.3 2008/08/11 23:05:54 Exp $
#

menu "Broadcom HND network devices"
	depends on PCI
config HND
	bool "Broadcom HND network device support"
config ET
	tristate "10/100 Ethernet support"
	depends on HND
config ET_47XX
	bool "BCM47xx support"
	depends on ET
config WL_EMULATOR
	bool "WL emulation using Gigabit ethernet"
	depends on HND
config BCM57XX
	tristate "BCM57xx support is ON"
	depends on WL_EMULATOR
config WL
	tristate "Wireless feature variant is set to AP"
	depends on WL_EMULATOR
	select WL_USE_AP
config BCM57XX
	tristate "BCM57xx Gigabit Ethernet support"
	depends on HND && !WL_EMULATOR
config WL
	tristate "BCM43xx 802.11 Wireless support"
	depends on HND && !WL_EMULATOR
choice
	prompt "Wireless feature variant"
	depends on HND && !WL_EMULATOR && WL
config WL_USE_AP
	bool "Config file for basic AP variant"
config WL_USE_AP_SDSTD
	bool "Config file for basic AP sdstd variant"
config WL_USE_STA
	bool "Config file for basic STA variant"
config WL_USE_APSTA
	bool "Config file for basic APSTA variant"
config WL_USE_AP_ONCHIP_G
	bool "Config file for AP 1chipG variant"
config WL_USE_STA_ONCHIP_G
	bool "Config file for STA 1chipG variant"
config WL_USE_APSTA_ONCHIP_G
	bool "Config file for APSTA 1chipG variant"
config WL_USE_HIGH
	bool "Config file for high/bmac split variant"
endchoice
config WL_USBAP
	bool "USB/HSIC Wireless Access Point support"
config WL_AP 
	string "Config file for basic AP variant"
	default "wlconfig_lx_router_ap"
config WL_AP_SDSTD
	string "Config file for basic AP sdstd variant"
	default "wlconfig_lx_router_ap_sdstd"
config WL_STA 
	string "Config file for basic STA variant"
	default "wlconfig_lx_router_sta"
config WL_APSTA 
	string "Config file for basic APSTA variant"
	default "wlconfig_lx_router_apsta"
config WL_AP_ONCHIP_G 
	string "Config file for AP 1chipG variant"
	default "wlconfig_lx_router_ap_1chipG"
config WL_STA_ONCHIP_G 
	string "Config file for STA 1chipG variant"
	default "wlconfig_lx_router_sta_1chipG"
config WL_HIGH 
	string "Config file for high/bmac split variant"
	default "wlconfig_lx_router_high"
config EMF
	tristate "Efficient Multicast Forwarding & IGMP Snooping Layers"
	depends on NETFILTER
endmenu
```

## src/linux/brcm/linux.v24/arch/mips/crypto/Config.in
```kconfig
# $Id: Config.in,v 1.1.2.1 2004/05/23 12:29:03 nikki Exp $

mainmenu_option next_comment
comment 'Cryptography support (CryptoAPI)'

tristate 'CryptoAPI support' CONFIG_CRYPTO

dep_mbool 'Cipher Algorithms' CONFIG_CIPHERS $CONFIG_CRYPTO
source crypto/ciphers/Config.in

dep_mbool 'Digest Algorithms' CONFIG_DIGESTS $CONFIG_CRYPTO
source crypto/digests/Config.in

dep_mbool 'Crypto Devices' CONFIG_CRYPTODEV $CONFIG_CRYPTO
source crypto/drivers/Config.in

endmenu
```

## src/linux/brcm/linux.v24/fs/jffs2/Kconfig.bbc.inc
```kconfig
config JFFS2_BBC_ARMLIB
	bool "ARMLIB compression support for BBC (EXPERIMENTAL)"
	depends on JFFS2_FS && EXPERIMENTAL
	default y
	help
	  This enables ARMLIB support for BBC.

config JFFS2_BBC_LZO
	bool "LZO1X-* compression support for BBC (EXPERIMENTAL)"
	depends on JFFS2_FS && EXPERIMENTAL
	default y
	help
	  This enables LZO1X-1 and LZO1X-999 support for BBC. (fast & good
	  compressor)

config JFFS2_BBC_LZARI
	bool "LZARI compression support for BBC (EXPERIMENTAL)"
	depends on JFFS2_FS && EXPERIMENTAL
	default y
	help
	  This enables LempelZiv-Storer-Szymanski compression for BBC with
	  additional arithmetic coding (damn slow, but best compresor).

config JFFS2_BBC_LZHD
	bool "LZHD compression support for BBC (EXPERIMENTAL)"
	depends on JFFS2_FS && EXPERIMENTAL
	default y
	help
	  This enables LempelZiv-Storer-Szymanski compression for BBC with
	  additional dynamic Huffman coding (a little faster than LZARI, and
	  it's compression ratio is a little worse than LZARI's)

config JFFS2_BBC_LZSS
	bool "LZSS compression support for BBC (EXPERIMENTAL)"
	depends on JFFS2_FS && EXPERIMENTAL
	default y
	help
	  This enables simple LempelZiv-Storer-Szymanski compression for BBC
	  (faster than LZHD, and, and has a not-so-good compression ratio,
	  was included just for testing)
```

## src/linux/danube/linux-2.6.34.6/arch/mips/lantiq/Kconfig
```kconfig
if LANTIQ

config SOC_LANTIQ
	bool
	select DMA_NONCOHERENT
	select IRQ_CPU
	select CEVT_R4K
	select CSRC_R4K
	select SYS_HAS_CPU_MIPS32_R1
	select SYS_HAS_CPU_MIPS32_R2
	select SYS_SUPPORTS_BIG_ENDIAN
	select SYS_SUPPORTS_32BIT_KERNEL
	select SYS_SUPPORTS_MULTITHREADING
	select SYS_HAS_EARLY_PRINTK
	select HW_HAS_PCI
	select ARCH_REQUIRE_GPIOLIB
	select SWAP_IO_SPACE
	select MIPS_MACHINE

choice
	prompt "SoC Type"
	default SOC_LANTIQ_XWAY

#config SOC_LANTIQ_FALCON
#	bool "FALCON"
#	select SOC_LANTIQ

config SOC_LANTIQ_XWAY
	bool "XWAY"
	select SOC_LANTIQ

	
endchoice

config AR9
	bool "AR9 DSL Driver extensions"

#source "arch/mips/lantiq/falcon/Kconfig"
source "arch/mips/lantiq/xway/Kconfig"

if EARLY_PRINTK
choice
	prompt "Early printk port"
	default LANTIQ_PROM_ASC1
	help
	  Choose which serial port is used, until the console driver is loaded

config LANTIQ_PROM_ASC0
	bool "ASC0"

config LANTIQ_PROM_ASC1
	bool "ASC1"


endchoice
endif

endif
```

## src/linux/danube/linux-2.6.34.6/arch/mips/lantiq/xway/Kconfig
```kconfig
if SOC_LANTIQ_XWAY

menu "Mips Machine"

config LANTIQ_MACH_EASY50812
	bool "Easy50812"
	default y

config LANTIQ_MACH_EASY50712
	bool "Easy50712"
	default y

config LANTIQ_MACH_EASY4010
	bool "Easy4010"
	default y

config LANTIQ_MACH_ARV45XX
	bool "ARV45XX"
	default y

endmenu

endif
```

## src/linux/ks8695/linux-2.6.23/arch/arm/mach-ks8695/Kconfig
```kconfig
if ARCH_KS8695

choice
    prompt "Kendin/Micrel KS8695 Implementations"

config MACH_KS8695
	bool "KS8695 development board"
	help
	  Say 'Y' here if you want your kernel to run on the original
	  Kendin-Micrel KS8695 development board.

config ARCH_KS8695_VSOPENRISC
	bool "VScom OpenRISC platform"
	select ISA
	help
	  Say 'Y' here if you want your kernel to run on the OpenRISC
	  platform. <http://www.vscom.de/>

endchoice

endif
```

## src/linux/laguna/linux-2.6.31.14/arch/arm/mach-cns3xxx/Kconfig
```kconfig
menu "CNS3XXX platform type"
	depends on ARCH_CNS3XXX

config MACH_GW2388
	bool "Support Gateworks Laguna Platform"
	select ARM_GIC
	help
	  Include support for the Cavium Networks CNS3XXX MPCore Platform Baseboard.
	  This is a platform with an on-board ARM11 MPCore and has support for USB, 
	  USB-OTG, MMC/SD/SDIO and PCI-E, etc.

config CNS3XXX_PM_API
	bool "Support for CNS3XXX Power Managemnet API"
	depends on ARCH_CNS3XXX
	default y
	help
	  Enable support for the CNS3XXX Power Managemnet API.

config CNS3XXX_RAID
	bool "Support for CNS3XXX RAID"
	depends on ARCH_CNS3XXX
	help
	  Enable RAID 4/5/6 Hardware accelartion in CNS3XXX.
	  If unsure, say N.

config CNS3XXX_DMAC
	bool "Support for CNS3XXX DMAC"
	depends on ARCH_CNS3XXX
	help
	  Enable support for the CNS3XXX DMA controllers.

choice
	prompt "PROM VERSTION"
	default SILICON
	help
	  Select the PROM interrupt ID mapping.
config SILICON
	bool "CNS3XXX_SILICON"
        help
          Temporary option. 
	  Interrupt 
	  ID		Source		Function	Trigger Type
	  ---		-------------	-------------	----------------
	  32		clkscale_intr	PMU		rising edge
	  33		sdio_intr	SDIO		high level
	  34		l2cc_intr	L2CC		high level
	  35		rtc_intr	RTC		high level
	  36		i2s_intr	I2S		high level
	  37		pcm_intr_n	PCM		high level
	  38		spi_intr_n	SPI		high level
	  39		i2c_intr_n	I2C		high level
	  40		cim_intr	CIM		high level
	  41		gpu_intr	GPU		high level
	  42		lcd_intr	LCD		high level
	  43		gpioa_intr	GPIOA		programmable
	  44		gpiob_intr	GPIOB		programmable
	  45		irda0_intr	UART0		high level
	  46		irda1_intr	UART1		high level
	  47		irda2_intr	UART2		high level
	  48		arm11_intr	ARM11		high level
	  49		swsta_intr	PSE Status 	high level
	  50		tstc_r0_intr	PSE R0TxComplete rising edge
	  51		fstc_r0_intr	PSE R0RxComplete rising edge
	  52		tsqe_r0_intr	PSE R0QEmpty 	rising edge
	  53		tsqe_r0_intr	PSE R0QFull 	rising edge
	  54		tstc_r1_intr	PSE R1TxComplete rising edge
	  55		fstc_r1_intr	PSE R1RxComplete rising edge
	  56		tsqe_r1_intr	PSE R1QEmpty 	rising edge
	  57		tsqe_r1_intr	PSE R1QFull 	rising edge
	  58		hnat_intr	PPE 		high level
	  59 		crypto_intr	CRYPTO		high level
	  60		hcie_intr	HCIE 		rising edge
	  61		pcie0_intr	PCIE0 Device	high level
	  62		pcie1_intr	PCIE1 Device	high level
	  63		usbotg_intr	USB OTG		high level
	  64		ehci_intr	USB EHCI	high level
	  65		sata_intr	SATA		high level
	  66		raid_intr_n	RAID		high level
	  67		smc_intr_n	SMC		high level
	  68		dmac_abort_intr	DMAC		high level
	  86:69		dmac_intr[17:0]	DMAC		high level
	  87		pcie0_rc_intr	PCIE0 RC	high level
	  88		pcie1_rc_intr	PCIE1 RC	high level
	  89		timer1_intr	TIMER 1		high level
	  90		timer2_intr	TIMER 2		high level
	  91		ochi_intr_n	USB OCHI	high level
	  92		timer3_intr	TIMER 3		high level
	  93		ext_intr0	Extrenal Pin	programmable
	  94		ext_intr1	Extrenal Pin	programmable
	  95		ext_intr2	Extrenal Pin	programmable

endchoice

config CNS3XXX_GPU_ENVIRONMENT
	bool "CNS3XXX GPU(GC300 2D Acceleration) Support"
	default n
	help
		Say Y if you want to support 2D acceleration.

endmenu
```

## src/linux/laguna/linux-2.6.31.14/drivers/net/cns3xxx/Kconfig
```kconfig
menu "CNS3XXX Gigabit Switch Support"
	depends on ARCH_CNS3XXX

config CNS3XXX_GSW
	tristate "CNS3XXX Gigabit Switch Driver Support"
	help
	  CNS3XXX Gigabit Switch.

config CNS3XXX_SPPE
	bool "CNS3XXX Smart PPE(Packet Processing Engine) Support"
	depends on CNS3XXX_GSW
	help
	  PPE(Packet Processing Engine) is a hardware accelerator hook on a port of 
	  CNS3XXX Gigabit Switch.
	  
	  This option is used for Smart PPE hook. 

	  Say Y if you want to enable Smart PPE function.

config CNS3XXX_HCIE_TEST
	bool "CNS3XXX HCIE(Hardware Content Inspection Engine) Support"
#	depends on CNS3XXX_GSW
	help
	  HCIE is patent-protected layer-7 packet processing engine.
	  
	  This option is used for fundamental HCIE functional test . 
	  Say Y if you want to do HCIE functional test.
		

#config CNS3XXX_SHNAT_PCI_FASTPATH
#	bool "FastPath(From PCI to WAN) Support"
#	depends on CNS3XXX_SHNAT
#	help
#	  Add FastPath Support for Smart HNAT.

comment "NOTE: 'Validation Board' depends on"
comment "GPIO_CNS3XXX and SPI_CNS3XXX"
choice
	prompt "CNS3XXX Board"
	depends on CNS3XXX_GSW
	default FPGA

config FPGA
	bool "Fpga"

config VB
	bool "Validation Board"
	help
	  MAC0 and MAC1 connect to BCM53115M. It need enable CNS3XXX SPI and CNS3XXX GPIO option.
	  MAC2 use ICPLUS IP1001 phy.

#config LEO
#	bool "Leo"

endchoice

endmenu
```

## src/linux/magicbox/linux-2.6.23.rb600/fs/yaffs/Kconfig
```kconfig
#
# YAFFS file system configurations
#

config YAFFS_FS
	tristate "YAFFS2 file system support"
	default n
	depends on MTD
	select YAFFS_YAFFS1
	select YAFFS_YAFFS2
	help
	  YAFFS2, or Yet Another Flash Filing System, is a filing system
	  optimised for NAND Flash chips.

	  To compile the YAFFS2 file system support as a module, choose M here:
	  the module will be called yaffs2.

	  If unsure, say N.

	  Further information on YAFFS2 is available at
	  <http://www.aleph1.co.uk/yaffs/>.

config YAFFS_YAFFS1
	bool "512 byte / page devices"
	depends on YAFFS_FS
	default y
	help
	  Enable YAFFS1 support -- yaffs for 512 byte / page devices

	  If unsure, say Y.

config YAFFS_DOES_ECC
	bool "Lets Yaffs do its own ECC"
	depends on YAFFS_FS && YAFFS_YAFFS1
	default n
	help
	  This enables Yaffs to use its own ECC functions instead of using
	  the ones from the generic MTD-NAND driver.

	  If unsure, say N.

config YAFFS_ECC_WRONG_ORDER
	bool "Use the same ecc byte order as Steven Hill's nand_ecc.c"
	depends on YAFFS_FS && YAFFS_DOES_ECC
	default n
	help
	  This makes yaffs_ecc.c use the same ecc byte order as
	  Steven Hill's nand_ecc.c. If not set, then you get the
	  same ecc byte order as SmartMedia.

	  If unsure, say N.

config YAFFS_YAFFS2
	bool "2048 byte (or larger) / page devices"
	depends on YAFFS_FS
	default y
	help
	  Enable YAFFS2 support -- yaffs for >= 2048 byte / page larger devices

	  If unsure, say Y.

config YAFFS_AUTO_YAFFS2
	bool "Autoselect yaffs2 format"
	depends on YAFFS_YAFFS2
	default y
	help
	  Without this, you need to explicitely use yaffs2 as the file
	  system type. With this, you can say "yaffs" and yaffs or yaffs2
          will be used depending on the device page size.

	  If unsure, say Y.

config YAFFS_DISABLE_LAZY_LOAD
	bool "Disable lazy loading"
	depends on YAFFS_YAFFS2
	default n
	help
	  "Lazy loading" defers loading file details until they are
	  required. This saves mount time, but makes the first look-up
	  a bit longer.

	  Lazy loading will only happen if enabled by this option being 'n'
	  and if the appropriate tags are available, else yaffs2 will
	  automatically fall back to immediate loading and do the right
	  thing.

	  Lazy laoding will be required by checkpointing.

	  Setting this to 'y' will disable lazy loading.

	  If unsure, say N.

config YAFFS_DISABLE_WIDE_TNODES
	bool "Turn off wide tnodes"
	depends on YAFFS_FS
	default n
	help
	  Wide tnodes are only used for large NAND arrays (>=32MB for
	  512-byte page devices and >=128MB for 2k page devices). They use 
	  slightly more RAM but are faster since they eliminate chunk group
	  searching.

	  Setting this to 'y' will force tnode width to 16 bits and make
	  large arrays slower.

	  If unsure, say N.

config YAFFS_DISABLE_CHUNK_ERASED_CHECK
	bool "Turn off debug chunk erase check"
	depends on YAFFS_FS
	default y
	help
	  Enabling this turns off the test that chunks are erased in flash
	  before writing to them.  This is safe, since the write verification
	  will fail.  Suggest enabling the test (ie. say N)
	  during development to help debug things.

	  If unsure, say Y.

config YAFFS_SHORT_NAMES_IN_RAM
	bool "Cache short names in RAM"
	depends on YAFFS_FS
	default y
	help
	  If this config is set, then short names are stored with the
	  yaffs_Object.  This costs an extra 16 bytes of RAM per object,
	  but makes look-ups faster.

	  If unsure, say Y.
```

## src/linux/mv78xx/linux-2.6.23/arch/arm/mach-feroceon-kw/Kconfig
```kconfig
if ARCH_FEROCEON_KW

choice
	prompt "Feroceon-KW SoC type"
	default MV88F6281

config  MV88F6281
	bool "88F6281/88F6192/88F6180 SoC"
	---help---
	Choosing this option will generate a linux kernel for the 88F6281/88F6192/88F6180 SoC

endchoice

endif
```
