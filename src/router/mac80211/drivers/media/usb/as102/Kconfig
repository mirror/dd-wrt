## src/router/mac80211/drivers/media/usb/as102/Kconfig
```kconfig
config DVB_AS102
	tristate "Abilis AS102 DVB receiver"
	depends on m
	depends on DVB_CORE && USB && I2C && INPUT
	depends on FW_LOADER
	help
	  Choose Y or M here if you have a device containing an AS102

	  To compile this driver as a module, choose M here
```

## src/router/mac80211/drivers/net/ethernet/broadcom/Kconfig
```kconfig
#
# Broadcom device configuration
#

config NET_VENDOR_BROADCOM
	bool "Broadcom devices"
	default y
	depends on (SSB_POSSIBLE && HAS_DMA) || PCI || BCM63XX || \
		   SIBYTE_SB1xxx_SOC
	---help---
	  If you have a network (Ethernet) chipset belonging to this class,
	  say Y.

	  Note that the answer to this question does not directly affect
	  the kernel: saying N will just case the configurator to skip all
	  the questions regarding AMD chipsets. If you say Y, you will be asked
	  for your specific chipset/driver in the following questions.

if NET_VENDOR_BROADCOM

config B44
	tristate "Broadcom 440x/47xx ethernet support"
	depends on m
	depends on SSB_POSSIBLE && HAS_DMA
	select SSB
	select BPAUTO_MII
	depends on PHYLIB
	---help---
	  If you have a network (Ethernet) controller of this type, say Y
	  or M here.

	  To compile this driver as a module, choose M here. The module
	  will be called b44.

# Auto-select SSB PCI-HOST support, if possible
config B44_PCI_AUTOSELECT
	bool
	depends on B44 && SSB_PCIHOST_POSSIBLE
	select SSB_PCIHOST
	default y

# Auto-select SSB PCICORE driver, if possible
config B44_PCICORE_AUTOSELECT
	bool
	depends on B44 && SSB_DRIVER_PCICORE_POSSIBLE
	select SSB_DRIVER_PCICORE
	default y

config B44_PCI
	bool
	depends on B44_PCI_AUTOSELECT && B44_PCICORE_AUTOSELECT
	default y

config BCM63XX_ENET
	depends on n
	tristate "Broadcom 63xx internal mac support"
	depends on m
	depends on BCM63XX
	select BPAUTO_MII
	depends on PHYLIB
	help
	  This driver supports the ethernet MACs in the Broadcom 63xx
	  MIPS chipset family (BCM63XX).

config BCMGENET
	depends on n
	tristate "Broadcom GENET internal MAC support"
	depends on m
	select BPAUTO_MII
	depends on PHYLIB
	depends on FIXED_PHY
	depends on BCM7XXX_PHY
	help
	  This driver supports the built-in Ethernet MACs found in the
	  Broadcom BCM7xxx Set Top Box family chipset.

config BNX2
	depends on n
	tristate "QLogic bnx2 support"
	depends on m
	depends on PCI
	depends on CRC32
	depends on FW_LOADER
	---help---
	  This driver supports QLogic bnx2 gigabit Ethernet cards.

	  To compile this driver as a module, choose M here: the module
	  will be called bnx2.  This is recommended.

config CNIC
	depends on n
	tristate "QLogic CNIC support"
	depends on m
	depends on PCI && (IPV6 || IPV6=n)
	select BNX2
	depends on UIO
	---help---
	  This driver supports offload features of QLogic bnx2 gigabit
	  Ethernet cards.

	  To compile this driver as a module, choose M here: the module
	  will be called cnic.  This is recommended.

config SB1250_MAC
	depends on n
	tristate "SB1250 Gigabit Ethernet support"
	depends on m
	depends on SIBYTE_SB1xxx_SOC
	depends on PHYLIB
	---help---
	  This driver supports Gigabit Ethernet interfaces based on the
	  Broadcom SiByte family of System-On-a-Chip parts.  They include
	  the BCM1120, BCM1125, BCM1125H, BCM1250, BCM1255, BCM1280, BCM1455
	  and BCM1480 chips.

	  To compile this driver as a module, choose M here: the module
	  will be called sb1250-mac.

config TIGON3
	depends on n
	tristate "Broadcom Tigon3 support"
	depends on m
	depends on PCI
	depends on PHYLIB
	depends on HWMON
	imply PTP_1588_CLOCK
	---help---
	  This driver supports Broadcom Tigon3 based gigabit Ethernet cards.

	  To compile this driver as a module, choose M here: the module
	  will be called tg3.  This is recommended.

config BNX2X
	depends on n
	tristate "Broadcom NetXtremeII 10Gb support"
	depends on m
	depends on PCI
	imply PTP_1588_CLOCK
	depends on FW_LOADER
	depends on ZLIB_INFLATE
	depends on LIBCRC32C
	select MDIO
	---help---
	  This driver supports Broadcom NetXtremeII 10 gigabit Ethernet cards.
	  To compile this driver as a module, choose M here: the module
	  will be called bnx2x.  This is recommended.

config BNX2X_SRIOV
	bool "Broadcom 578xx and 57712 SR-IOV support"
	depends on BNX2X && PCI_IOV
	default y
	---help---
	  This configuration parameter enables Single Root Input Output
	  Virtualization support in the 578xx and 57712 products. This
	  allows for virtual function acceleration in virtual environments.

config BGMAC
	depends on n
	tristate
	depends on m
	help
	  This enables the integrated ethernet controller support for many
	  Broadcom (mostly iProc) SoCs. An appropriate bus interface driver
	  needs to be enabled to select this.

config BGMAC_BCMA
	depends on n
	tristate "Broadcom iProc GBit BCMA support"
	depends on m
	depends on BCMA && BCMA_HOST_SOC
	depends on HAS_DMA
	depends on BCM47XX || ARCH_BCM_5301X || COMPILE_TEST
	select BGMAC
	depends on PHYLIB
	depends on FIXED_PHY
	---help---
	  This driver supports GBit MAC and BCM4706 GBit MAC cores on BCMA bus.
	  They can be found on BCM47xx SoCs and provide gigabit ethernet.
	  In case of using this driver on BCM4706 it's also requires to enable
	  BCMA_DRIVER_GMAC_CMN to make it work.

config BGMAC_PLATFORM
	depends on n
	tristate "Broadcom iProc GBit platform support"
	depends on m
	depends on HAS_DMA
	depends on ARCH_BCM_IPROC || COMPILE_TEST
	depends on OF
	select BGMAC
	depends on PHYLIB
	depends on FIXED_PHY
	default ARCH_BCM_IPROC
	---help---
	  Say Y here if you want to use the Broadcom iProc Gigabit Ethernet
	  controller through the generic platform interface

config SYSTEMPORT
	depends on n
	tristate "Broadcom SYSTEMPORT internal MAC support"
	depends on m
	depends on OF
	select BPAUTO_MII
	depends on PHYLIB
	depends on FIXED_PHY
	help
	  This driver supports the built-in Ethernet MACs found in the
	  Broadcom BCM7xxx Set Top Box family chipset using an internal
	  Ethernet switch.

config BNXT
	depends on n
	tristate "Broadcom NetXtreme-C/E support"
	depends on m
	depends on PCI
	depends on FW_LOADER
	depends on LIBCRC32C
	---help---
	  This driver supports Broadcom NetXtreme-C/E 10/25/40/50 gigabit
	  Ethernet cards.  To compile this driver as a module, choose M here:
	  the module will be called bnxt_en.  This is recommended.

config BNXT_SRIOV
	bool "Broadcom NetXtreme-C/E SR-IOV support"
	depends on BNXT && PCI_IOV
	default y
	---help---
	  This configuration parameter enables Single Root Input Output
	  Virtualization support in the NetXtreme-C/E products. This
	  allows for virtual function acceleration in virtual environments.

config BNXT_DCB
	bool "Data Center Bridging (DCB) Support"
	default n
	depends on BNXT && DCB
	---help---
	  Say Y here if you want to use Data Center Bridging (DCB) in the
	  driver.

	  If unsure, say N.

endif # NET_VENDOR_BROADCOM
```

## src/router/mac80211/drivers/net/wireless/ath/ar5523/Kconfig
```kconfig
config AR5523
       tristate "Atheros AR5523 wireless driver support"
       depends on m
       depends on MAC80211 && USB
       select ATH_COMMON
       depends on FW_LOADER
       ---help---
         This module add support for AR5523 based USB dongles such as D-Link
         DWL-G132, Netgear WPN111 and many more.
```

## src/router/mac80211/drivers/net/wireless/marvell/libertas/Kconfig
```kconfig
config LIBERTAS
	tristate "Marvell 8xxx Libertas WLAN driver support"
	depends on m
	depends on CFG80211
	depends on WIRELESS_EXT
	depends on WEXT_SPY
	select LIB80211
	depends on FW_LOADER
	---help---
	  A library for Marvell Libertas 8xxx devices.

config LIBERTAS_USB
	tristate "Marvell Libertas 8388 USB 802.11b/g cards"
	depends on m
	depends on LIBERTAS && USB
	---help---
	  A driver for Marvell Libertas 8388 USB devices.

config LIBERTAS_CS
	tristate "Marvell Libertas 8385 CompactFlash 802.11b/g cards"
	depends on m
	depends on LIBERTAS && PCMCIA && HAS_IOPORT_MAP
	---help---
	  A driver for Marvell Libertas 8385 CompactFlash devices.

config LIBERTAS_SDIO
	tristate "Marvell Libertas 8385/8686/8688 SDIO 802.11b/g cards"
	depends on m
	depends on LIBERTAS && MMC
	---help---
	  A driver for Marvell Libertas 8385/8686/8688 SDIO devices.

config LIBERTAS_SPI
	tristate "Marvell Libertas 8686 SPI 802.11b/g cards"
	depends on m
	depends on LIBERTAS && SPI
	---help---
	  A driver for Marvell Libertas 8686 SPI devices.

config LIBERTAS_DEBUG
	bool "Enable full debugging output in the Libertas module."
	depends on LIBERTAS
	---help---
	  Debugging support.

config LIBERTAS_MESH
	bool "Enable mesh support"
	depends on LIBERTAS
	help
	  This enables Libertas' MESH support, used by e.g. the OLPC people.
```

## src/router/mac80211/drivers/net/wireless/marvell/mwifiex/Kconfig
```kconfig
config MWIFIEX
	tristate "Marvell WiFi-Ex Driver"
	depends on m
	depends on CFG80211
	---help---
	  This adds support for wireless adapters based on Marvell
	  802.11n/ac chipsets.

	  If you choose to build it as a module, it will be called
	  mwifiex.

config MWIFIEX_SDIO
	depends on !KERNEL_3_2
	tristate "Marvell WiFi-Ex Driver for SD8786/SD8787/SD8797/SD8887/SD8897/SD8997"
	depends on m
	depends on MWIFIEX && MMC
	depends on FW_LOADER
	select BPAUTO_WANT_DEV_COREDUMP
	---help---
	  This adds support for wireless adapters based on Marvell
	  8786/8787/8797/8887/8897/8997 chipsets with SDIO interface.

	  If you choose to build it as a module, it will be called
	  mwifiex_sdio.

config MWIFIEX_PCIE
	tristate "Marvell WiFi-Ex Driver for PCIE 8766/8897/8997"
	depends on m
	depends on MWIFIEX && PCI
	depends on FW_LOADER
	select BPAUTO_WANT_DEV_COREDUMP
	---help---
	  This adds support for wireless adapters based on Marvell
	  8766/8897/8997 chipsets with PCIe interface.

	  If you choose to build it as a module, it will be called
	  mwifiex_pcie.

config MWIFIEX_USB
	tristate "Marvell WiFi-Ex Driver for USB8766/8797/8997"
	depends on m
	depends on MWIFIEX && USB
	depends on FW_LOADER
	---help---
	  This adds support for wireless adapters based on Marvell
	  8797/8997 chipset with USB interface.

	  If you choose to build it as a module, it will be called
	  mwifiex_usb.
```

## src/router/mac80211/drivers/net/wireless/marvell/mwlwifi/Kconfig
```kconfig
config MWLWIFI
	tristate "Marvell Avastar 88W8864/88W8897 PCIe driver (mac80211 compatible)"
	depends on PCI && MAC80211
	select FW_LOADER
	---help---
		Select to build the driver supporting the:

		Marvell Wireless Wi-Fi 88W8864 modules
		Marvell Wireless Wi-Fi 88W8897 modules

		This driver uses the kernel's mac80211 subsystem.

		If you want to compile the driver as a module (= code which can be
		inserted in and removed from the running kernel whenever you want),
		say M here and read <file:Documentation/kbuild/modules.txt>.  The
		module will be called mwlwifi.

		NOTE: Selecting this driver may cause conflict with MWIFIEX driver
		that also operates on the same part number 88W8897. Users should
		select either MWIFIEX or MWLWIFI, not both. MWIFIEX is fullmac,
		supporting more comprehensive client functions for laptops/embedded
		devices. MWLWIFI is mac80211-based for full AP/Wireless Bridge.
```

## src/router/mac80211/drivers/net/wireless/mediatek/mt76/Kconfig
```kconfig
# SPDX-License-Identifier: GPL-2.0-only
config MT76_CORE
	tristate
	depends on m

config MT76_LEDS
	bool
	depends on MT76_CORE
	depends on LEDS_CLASS=y || MT76_CORE=LEDS_CLASS
	default y

config MT76_USB
	tristate
	depends on m
	depends on MT76_CORE

config MT76_SDIO
	tristate
	depends on m
	depends on MT76_CORE

config MT76x02_LIB
	tristate
	depends on m
	select MT76_CORE

config MT76x02_USB
	tristate
	depends on m
	select MT76_USB

config MT76_CONNAC_LIB
	tristate
	depends on m
	select MT76_CORE

source "drivers/net/wireless/mediatek/mt76/mt76x0/Kconfig"
source "drivers/net/wireless/mediatek/mt76/mt76x2/Kconfig"
source "drivers/net/wireless/mediatek/mt76/mt7603/Kconfig"
source "drivers/net/wireless/mediatek/mt76/mt7615/Kconfig"
source "drivers/net/wireless/mediatek/mt76/mt7915/Kconfig"
source "drivers/net/wireless/mediatek/mt76/mt7921/Kconfig"
```

## src/router/mac80211/drivers/net/wireless/mediatek/mt76/mt7615/Kconfig
```kconfig
config MT7615E
	tristate "MediaTek MT7615E (PCIe) support"
	select MT76_CORE
	depends on MAC80211
	help
	  This adds support for MT7615-based wireless PCIe devices.
```

## src/router/mac80211/drivers/net/wireless/mediatek/mt76/mt76x2/Kconfig
```kconfig
config MT76x2_COMMON
	tristate "MT76x2 Common"
	select MT76x02_LIB

config MT76x2E
	tristate "MediaTek MT76x2E (PCIe) support"
	select MT76x2_COMMON
	depends on MAC80211
	---help---
	  This adds support for MT7612/MT7602/MT7662-based wireless PCIe devices.

config MT76x2U
	tristate "MediaTek MT76x2U (USB) support"
	select MT76x2_COMMON
	select MT76x02_USB
	depends on MAC80211
	help
	  This adds support for MT7612U-based wireless USB dongles.
```

## src/router/mac80211/drivers/net/wireless/ti/wl18xx/Kconfig
```kconfig
# SPDX-License-Identifier: GPL-2.0-only
config WL18XX
	depends on !KERNEL_4_2
	tristate "TI wl18xx support"
	depends on m
	depends on MAC80211
	select WLCORE
	help
	  This module adds support for wireless adapters based on TI
	  WiLink 8 chipsets.
```

## src/router/mac80211/drivers/nfc/nxp-nci/Kconfig
```kconfig
config NFC_NXP_NCI
	tristate "NXP-NCI NFC driver"
	depends on m
	depends on NFC_NCI
	default n
	---help---
	  Generic core driver for NXP NCI chips such as the NPC100
	  or PN7150 families.
	  This is a driver based on the NCI NFC kernel layers and
	  will thus not work with NXP libnfc library.

	  To compile this driver as a module, choose m here. The module will
	  be called nxp_nci.
	  Say N if unsure.

config NFC_NXP_NCI_I2C
	depends on !KERNEL_3_17
	tristate "NXP-NCI I2C support"
	depends on m
	depends on NFC_NXP_NCI && I2C
	---help---
	  This module adds support for an I2C interface to the NXP NCI
	  chips.
	  Select this if your platform is using the I2C bus.

	  To compile this driver as a module, choose m here. The module will
	  be called nxp_nci_i2c.
	  Say Y if unsure.
```

## src/router/mac80211/drivers/nfc/st21nfca/Kconfig
```kconfig
config NFC_ST21NFCA
	tristate
	depends on m
	depends on CRC_CCITT
	---help---
	  STMicroelectronics ST21NFCA core driver. It implements the chipset
	  HCI logic and hooks into the NFC kernel APIs. Physical layers will
	  register against it.

config NFC_ST21NFCA_I2C
	depends on !KERNEL_3_18
	tristate "STMicroelectronics ST21NFCA NFC driver (I2C)"
	depends on m
	depends on NFC_HCI && I2C && NFC_SHDLC
	select NFC_ST21NFCA
	---help---
	  This module adds support for the STMicroelectronics st21nfca i2c interface.
	  Select this if your platform is using the i2c bus.

	  If you choose to build a module, it'll be called st21nfca_i2c.
	  Say N if unsure.
```

## src/router/mac80211/drivers/staging/rtl8723bs/Kconfig
```kconfig
# SPDX-License-Identifier: GPL-2.0
config RTL8723BS
	depends on !KERNEL_5_4
	tristate "Realtek RTL8723BS SDIO Wireless LAN NIC driver"
	depends on m
	depends on WLAN && MMC && CFG80211
	depends on m
	select CFG80211_WEXT
	select BPAUTO_CRYPTO_LIB_ARC4
	help
	This option enables support for RTL8723BS SDIO drivers, such as
	the wifi found on the 1st gen Intel Compute Stick, the CHIP
	and many other Intel Atom and ARM based devices.
	If built as a module, it will be called r8723bs.
```

## src/router/mac80211/net/bluetooth/hidp/Kconfig
```kconfig
config BT_HIDP
	tristate "HIDP protocol support"
	depends on m
	depends on BT_BREDR && INPUT
	depends on HID
	help
	  HIDP (Human Interface Device Protocol) is a transport layer
	  for HID reports.  HIDP is required for the Bluetooth Human
	  Interface Device Profile.

	  Say Y here to compile HIDP support into the kernel or say M to
	  compile it as module (hidp).
```

## src/router/mac80211/net/ieee802154/6lowpan/Kconfig
```kconfig
config IEEE802154_6LOWPAN
	depends on !KERNEL_3_5
	tristate "6lowpan support over IEEE 802.15.4"
	depends on m
	depends on 6LOWPAN
	---help---
	  IPv6 compression over IEEE 802.15.4.
```
