## src/router/mac80211/net/nfc/Kconfig
```kconfig
#
# NFC sybsystem configuration
#

menuconfig NFC
	depends on !KERNEL_3_1
	depends on NET
	depends on RFKILL || !RFKILL
	tristate "NFC subsystem support"
	depends on m
	default n
	help
	  Say Y here if you want to build support for NFC (Near field
	  communication) devices.

	  To compile this support as a module, choose M here: the module will
	  be called nfc.

config NFC_DIGITAL
	depends on NFC
	depends on CRC_CCITT
	depends on CRC_ITU_T
	tristate "NFC Digital Protocol stack support"
	depends on m
	default n
	help
	  Say Y if you want to build NFC digital protocol stack support.
	  This is needed by NFC chipsets whose firmware only implement
	  the NFC analog layer.

	  To compile this support as a module, choose M here: the module will
	  be called nfc_digital.

source "net/nfc/nci/Kconfig"
source "net/nfc/hci/Kconfig"

source "drivers/nfc/Kconfig"
```

## src/router/mac80211/net/qrtr/Kconfig
```kconfig
# SPDX-License-Identifier: GPL-2.0-only
# Qualcomm IPC Router configuration
#

config QRTR
	depends on !KERNEL_5_2
	tristate "Qualcomm IPC Router support"
	depends on m
	help
	  Say Y if you intend to use Qualcomm IPC router protocol.  The
	  protocol is used to communicate with services provided by other
	  hardware blocks in the system.

	  In order to do service lookups, a userspace daemon is required to
	  maintain a service listing.

if QRTR

config QRTR_SMD
	tristate "SMD IPC Router channels"
	depends on m
	depends on RPMSG || (COMPILE_TEST && RPMSG=n)
	help
	  Say Y here to support SMD based ipcrouter channels.  SMD is the
	  most common transport for IPC Router.

config QRTR_TUN
	tristate "TUN device for Qualcomm IPC Router"
	depends on m
	help
	  Say Y here to expose a character device that allows user space to
	  implement endpoints of QRTR, for purpose of tunneling data to other
	  hosts or testing purposes.

config QRTR_MHI
	tristate "MHI IPC Router channels"
	depends on m
	depends on MHI_BUS
	help
	  Say Y here to support MHI based ipcrouter channels. MHI is the
	  transport used for communicating to external modems.

endif # QRTR
```

## src/router/madwifi-ng/ath/Kconfig
```kconfig
comment "Atheros 802.11(a/b/g) PCI/Cardbus support"

config ATHEROS
	tristate "Atheros PCI/Cardbus cards"
	depends on PCI && NET_RADIO && EXPERIMENTAL && HOTPLUG
	select ATHEROS_HAL
	select ATHEROS_RATE
	select NET80211
       ---help---
	  Say Y here if you intend to attach an Atheros Cardbus or PCI
	  wireless Ethernet networking card to your computer.  This
	  driver support the standard Linux Wireless Extensions.

	  You will also very likely also need the Wireless Tools in order to
	  configure your card and that /etc/pcmcia/wireless.opts works:
	  <http://www.hpl.hp.com/personal/Jean_Tourrilhes/Linux/Tools.html>.

	  To compile this driver as a module, choose M here: the module will be
	  called ath_pci.  If unsure, say N.

source "drivers/net/wireless/_ath_hal/Kconfig"

source "drivers/net/wireless/_ath_rate/Kconfig"

source "drivers/net/wireless/net80211/Kconfig"
```

## src/router/madwifi.dev/madwifi.dev/patch-kernel/Config.in
```kconfig
dep_bool '   Atheros 802.11(a/b/g) PCI/Cardbus support' CONFIG_ATHEROS $CONFIG_PCI $CONFIG_NET_RADIO
if [ "$CONFIG_ATHEROS" = "y" ]; then

   choice '    Atheros: Default Transmission Rate Control Algorithm'    \
        "Minstrel       CONFIG_ATHEROS_RATE_DEFAULT_MINSTREL \
         Sample         CONFIG_ATHEROS_RATE_DEFAULT_SAMPLE \
         Onoe           CONFIG_ATHEROS_RATE_DEFAULT_ONOE   \
         AMRR           CONFIG_ATHEROS_RATE_DEFAULT_AMRR" Sample

  if [ "$CONFIG_ATHEROS_RATE_DEFAULT_AMRR" = "y" ]; then
    define_bool CONFIG_ATHEROS_RATE_AMRR y
    define_string CONFIG_ATHEROS_RATE_DEFAULT "amrr"
  else
    dep_bool '    Adaptive Multi-Rate Retry control algorithm' \
	CONFIG_ATHEROS_RATE_AMRR $CONFIG_ATHEROS
  fi

  if [ "$CONFIG_ATHEROS_RATE_DEFAULT_ONOE" = "y" ]; then
    define_bool CONFIG_ATHEROS_RATE_ONOE y
    define_string CONFIG_ATHEROS_RATE_DEFAULT "onoe"
  else
    dep_bool '    Atsushi Onoe rate control algorithm' \
	CONFIG_ATHEROS_RATE_ONOE $CONFIG_ATHEROS
  fi

  if [ "$CONFIG_ATHEROS_RATE_DEFAULT_SAMPLE" = "y" ]; then
    define_bool CONFIG_ATHEROS_RATE_SAMPLE y
    define_string CONFIG_ATHEROS_RATE_DEFAULT "sample"
  else
    dep_bool '    Sample Rate control algorithm' \
	CONFIG_ATHEROS_RATE_SAMPLE $CONFIG_ATHEROS
  fi

  if [ "$CONFIG_ATHEROS_RATE_DEFAULT_MINSTREL" = "y" ]; then
    define_bool CONFIG_ATHEROS_RATE_MINSTREL y
    define_string CONFIG_ATHEROS_RATE_DEFAULT "minstrel"
  else
    dep_bool '    Minstrel Rate control algorithm' \
        CONFIG_ATHEROS_RATE_MINSTREL $CONFIG_ATHEROS
  fi

fi
```

## src/router/madwifi.dev/madwifi.dev/patch-kernel/Kconfig
```kconfig
comment "Atheros 802.11(a/b/g) PCI/Cardbus support"

config ATHEROS
	tristate "Atheros PCI/Cardbus cards"
	depends on PCI && (NET_RADIO || WIRELESS_EXT) && CRYPTO
       ---help---
	  Say Y here if you intend to attach an Atheros Cardbus or PCI
	  wireless Ethernet networking card to your computer.  This
	  driver support the standard Linux Wireless Extensions.

	  You will also very likely also need the Wireless Tools in order to
	  configure your card and that /etc/pcmcia/wireless.opts works:
	  <http://www.hpl.hp.com/personal/Jean_Tourrilhes/Linux/Tools.html>.

	  To compile this driver as a module, choose M here: the module will be
	  called ath_pci.  If unsure, say N.

choice
	prompt "Atheros: Default Transmission Rate Control Algorithm"
	depends on ATHEROS
	default ATHEROS_RATE_DEFAULT_SAMPLE
	help
	  Select the rate control algorithm to be used by default.  You
	  can select additional algorithms below.

	config ATHEROS_RATE_DEFAULT_AMRR
		bool "AMRR"
		select ATHEROS_RATE_AMRR

	config ATHEROS_RATE_DEFAULT_ONOE
		bool "Onoe"
		select ATHEROS_RATE_ONOE

	config ATHEROS_RATE_DEFAULT_SAMPLE
		bool "Sample"
		select ATHEROS_RATE_SAMPLE

        config ATHEROS_RATE_DEFAULT_MINSTREL
                bool "Minstrel"
                select ATHEROS_RATE_MINSTREL

endchoice

config ATHEROS_RATE_DEFAULT
	string
	default "amrr" if ATHEROS_RATE_DEFAULT_AMRR
	default "onoe" if ATHEROS_RATE_DEFAULT_ONOE
	default "sample" if ATHEROS_RATE_DEFAULT_SAMPLE
        default "minstrel" if ATHEROS_RATE_DEFAULT_MINSTREL

config ATHEROS_RATE_AMRR
	bool "Adaptive Multi-Rate Retry control algorithm"
	depends on ATHEROS
	default y
	help
	  Enable Adaptive Multi-Rate Retry control algorithm.

config ATHEROS_RATE_ONOE
	bool "Atsushi Onoe's rate control algorithm"
	depends on ATHEROS
	default y
	help
	  Enable Atsushi Onoe's rate control algorithm.

config ATHEROS_RATE_SAMPLE
	bool "Sample Rate control algorithm"
	depends on ATHEROS
	default y
	help
	  SampleRate chooses the bitrate it predicts will provide the
	  most throughput based on estimates of the expected per-packet
	  transmission time for each bitrate. SampleRate periodically
	  sends packets at bitrates other than the current one to
	  estimate when another bitrate will provide better performance.
	  SampleRate switches to another bitrate when its estimated
	  per-packet transmission time becomes smaller than the current
	  bitrate's. SampleRate reduces the number of bitrates it must
	  sample by eliminating those that could not perform better than
	  the one currently being used. SampleRate also stops probing at
	  a bitrate if it experiences several successive losses.


config ATHEROS_RATE_MINSTREL
        bool "A wandering minstrel rate control algorithm"
        depends on ATHEROS
        default y
        help
          Similar to the SampleRate code base, except that it is
          a)more carefully written
          b)shown to give a throughput similar to what can be obtained by
            manually fixing either end to fixed rates
          c)verified by monitoring the network traffic with an ieee80211
             enabled ethereal
          d)responds to network changes and does modify the rate accordingly. 
            Thus, on moving the two nodes together/apart, the ideal rate will 
            be changed as appropriate.
```

## src/router/madwifi/patches/2.4/Config.in
```kconfig
dep_bool '   Atheros 802.11(a/b/g) PCI/Cardbus support' CONFIG_ATHEROS $CONFIG_PCI $CONFIG_NET_RADIO
if [ "$CONFIG_ATHEROS" = "y" ]; then
   define_bool CONFIG_ATHEROS_HAL y
   define_bool CONFIG_NET80211 y
   choice '    Atheros: Rate Control Algorithm'    \
        "Sample         CONFIG_ATHEROS_RATE_SAMPLE \
         Onoe           CONFIG_ATHEROS_RATE_ONOE   \
         AMRR           CONFIG_ATHEROS_RATE_AMRR" Sample
fi
```

## src/router/madwifi/patches/2.6/Kconfig
```kconfig
comment "Atheros 802.11(a/b/g) PCI/Cardbus support"

config ATHEROS
	tristate "Atheros PCI/Cardbus cards"
	depends on PCI && NET_RADIO
	select ATHEROS_HAL
	select NET80211
       ---help---
	  Say Y here if you intend to attach an Atheros Cardbus or PCI
	  wireless Ethernet networking card to your computer.  This
	  driver support the standard Linux Wireless Extensions.

	  You will also very likely also need the Wireless Tools in order to
	  configure your card and that /etc/pcmcia/wireless.opts works:
	  <http://www.hpl.hp.com/personal/Jean_Tourrilhes/Linux/Tools.html>.

	  To compile this driver as a module, choose M here: the module will be
	  called ath_pci.  If unsure, say N.

choice
	prompt "Atheros: Transmission Rate Control Algorithm"
	depends on ATHEROS
	default ATHEROS_RATE_SAMPLE
	help
	  Rate control algorithms determine how the transmission rate is
	  selected based on the quality of the connection.

config ATHEROS_RATE_SAMPLE
	bool "Sample"
	help
	  SampleRate chooses the bitrate it predicts will provide the
	  most throughput based on estimates of the expected per-packet
	  transmission time for each bitrate. SampleRate periodically
	  sends packets at bitrates other than the current one to
	  estimate when another bitrate will provide better performance.
	  SampleRate switches to another bitrate when its estimated
	  per-packet transmission time becomes smaller than the current
	  bitrate's. SampleRate reduces the number of bitrates it must
	  sample by eliminating those that could not perform better than
	  the one currently being used. SampleRate also stops probing at
	  a bitrate if it experiences several successive losses.

config ATHEROS_RATE_ONOE
	bool "Onoe"
	help
	  Use Atsushi Onoe's rate control algorithm.

config ATHEROS_RATE_AMRR
	bool "AMRR"
	help
	  Adaptive Multi Rate Retry control algorithm.

endchoice

config ATHEROS_HAL
	tristate

config NET80211
	tristate
```

## src/router/morse_driver/Kconfig
```kconfig
config WLAN_VENDOR_MORSE
	tristate "Morse Micro driver"
	help
	  If you have a wireless card belonging to this class, say Y.

	  Note that the answer to this question doesn't directly affect the
	  kernel: saying N will just cause the configurator to skip all
	  the questions about cards. If you say Y, you will be asked for
	  your specific card in the following questions.

if WLAN_VENDOR_MORSE

config MORSE_SDIO
	bool "SDIO support"
	help
	  This driver supports wireless cards connected over SDIO.

	  The kernel device tree must be configured appropriately
	  for the host/device interface.
	  Both SDIO and SPI drivers may be enabled simultaneously.

config MORSE_USB
	bool "USB support"
	help
	  This driver supports wireless cards connected over USB.

config MORSE_SDIO_ALIGNMENT
	int "Alignment requirements for bulk SDIO reads/writes"
	default 2
	range 2 8
	help
	  Number of bytes to align data buffers for bulk SDIO transactions. Some hosts have
	  specific alignment requirements for DMA, use this setting to
	  adjust the alignment required.

	  Must be a power of 2.

config MORSE_SPI
	bool "SPI support"
	help
	  This driver supports wireless cards connected over SPI.

	  The kernel device tree must be configured appropriately
	  for the host/device interface.
	  Both SDIO and SPI drivers may be enabled simultaneously.

config MORSE_SPI_RK3288
	bool "SPI support for Rockchip 3288"
	default n
	depends on MORSE_SPI
	help
	  This driver supports the Rockchip 3288 SPI interface.

	  Special handling is required for this board because initialisation
	  of the Morse chip in SPI mode requires a handshake with the SPI CS
	  line held high, which is not supported in the Rockchip driver.

	  When enabled, the Morse SPI driver must be brought up before the
	  Rockchip SPI driver.

config MORSE_USER_ACCESS
	bool "User space access support"
	help
	  Enable user-space access to wireless cards.

config MORSE_VENDOR_COMMAND
	bool "Morse vendor commands"
	default n
	help
	  Allow vendor-specific commands from userspace applications such as iw.

config MORSE_COUNTRY
	string "Country code for regulatory compliance"
	default "AU"
	help
	  Two-character country code.

config MORSE_DEBUG_MASK
	int "Debug mask"
	default 8
	help
	  Set the Morse driver debug level.
	  Choose any combination of 8 (Error), 4 (Warning), 2 (Informational) and 1 (Debug).
	  The minimum debug level applied is 8 (Error).
	  Note that increasing debug level can impact performance.

config MORSE_SDIO_RESET_TIME
	int "Time to wait after SDIO reset (ms)"
	default 400
	range 0 400
	help
	  Reduce the wait time after SDIO reset to reduce boot time.
	  Can cause instability and load failure if set too low for the device.

config MORSE_POWERSAVE_MODE
	int "Power Save mode"
	default 2
	range 0 2
	help
	  Choose 0 to disable Power Save, 1 to enable the Power Save protocol, or 2 to fully enable
	  Power Save mode.

config MORSE_DHCP_OFFLOAD
	bool "Offload DHCP lease renewal processing to the firmware"
	default n
	help
	  When enabled, DHCP lease renewal and discovery is handled by the firmware, with no
	  interaction with the host device. Only basic DHCP options are supported.

config MORSE_ARP_OFFLOAD
	bool "Offload ARP packet handling to the firmware"
	default n
	help
	  When enabled, the firmware will directly respond to ARP requests for the wireless
	  interface's IP address, with no interaction with the host device. All other ARP requests
	  are ignored.

config MORSE_WATCHDOG_RESET_DEFAULT_DISABLED
	bool "Disable driver reset from watchdog by default"
	default y
	help
	  When not set, if the watchdog detects an unrecoverable error, the default behaviour is to
	  reset the firmware. When set, the default behaviour is to not reset the firmware.
	  This setting can be overridden when loading the driver, by setting the enable_watchdog
	  parameter.

config MORSE_DISABLE_CHANNEL_SURVEY
	bool "Disable channel survey"
	default n
	help
	  When set, the firmware will not perform channel surveys.

config ANDROID
	bool "Android build"
	default n
	help
	  Enable to compile driver for android.

config MORSE_MONITOR
	bool "Monitor mode support"
	default n
	help
	  Enable to monitor traffic in a wireless channel.

config MORSE_DEBUGFS
	bool "DebugFS support"
	default n
	help
	  Enable for debugging support.

endif # WLAN_VENDOR_MORSE
```

## src/router/ovpn-dco/drivers/net/Kconfig
```kconfig
# SPDX-License-Identifier: GPL-2.0
# Copyright (C) 2020-2023 OpenVPN, Inc.
#
#  Author:	Antonio Quartulli <antonio@openvpn.net>

config OVPN_DCO_V2
	tristate "OpenVPN data channel offload (reloaded)"
	depends on NET && INET
	select NET_UDP_TUNNEL
	select DST_CACHE
	select CRYPTO
	select CRYPTO_AES
	select CRYPTO_GCM
	select CRYPTO_CHACHA20POLY1305
	help
	  This module enhances the performance of the OpenVPN userspace software
	  by offloading the data channel processing to kernelspace.
```
