## src/router/smbd/smbd/Kconfig
```kconfig
config SMB_SERVER
	tristate "SMB server support"
	depends on INET
	select NLS
	select NLS_UTF8
	select CRYPTO
	select CRYPTO_MD4
	select CRYPTO_MD5
	select CRYPTO_HMAC
	select CRYPTO_ARC4
	select CRYPTO_ECB
	select CRYPTO_LIB_DES
	select CRYPTO_SHA256
	select CRYPTO_CMAC
	select CRYPTO_SHA512
	select CRYPTO_AEAD2
	select CRYPTO_CCM
	select CRYPTO_GCM
	help
	  This config provides support for in-kernel CIFS/SMB3 server.

config SMB_INSECURE_SERVER
        bool "Support for insecure SMB1/CIFS and SMB2.0 protocols"
        depends on SMB_SERVER && INET
        select NLS
	default n

        help
	  This enables deprecated insecure protocols dialects: SMB1/CIFS
	  and SMB2.0

config SMB_SERVER_SMBDIRECT
	bool "Support for SMB Direct protocol"
	depends on SMB_SERVER && INFINIBAND && INFINIBAND_ADDR_TRANS
	default n

	help
	  This enables SMB direct protocol for SMB 3.x

config SMB_SERVER_DEBUGGING
	bool "Enable verbose debugging code"
	depends on SMB_SERVER
	default n

	help
	  This adds a lot of debugging code, which is compiled out
	  otherwise. Verbose debugging code increases the size of
	  the kernel module quite considerably.
```

## src/router/tools/sysupgrade-ubi.its
```
/dts-v1/;

/ {
        description = "IPQ8066/NAND Sysupgrade image";
        images {

                script {
                        description = "boot.scr";
                        data = /incbin/("tew827/script");
                        type = "script";
                        arch = "arm";
                        compression = "none";
                        hash@1 { algo = "crc32"; };
                };
                ubi {
                        description = "ubi";
                        data = /incbin/("../arm-uclibc/ddwrt-tew827-squashfs-nand-factory.ubi");
                        type = "firmware";
                        arch = "arm";
                        compression = "none";
                        hash@1 { algo = "crc32"; };
                };
                bootconfig {
                        description = "bootconfig";
                        data = /incbin/("tew827/bootconfig");
                        type = "firmware";
                        arch = "arm";
                        compression = "none";
                        hash@1 { algo = "crc32"; };
                };

        };
};
```

## src/router/wiviz2/Config.in
```kconfig
config BR2_PACKAGE_ARPWATCH
	tristate "wiviz - Wireless network environment visualization"
	default m if CONFIG_DEVEL
	help
		http://wiviz.natetrue.com
	  
```

## src/src/router/madwifi-ng/patches/2.6/Kconfig.patch
```kconfig
--- Kconfig.orig	2004-09-28 10:58:29.315549520 -0700
+++ Kconfig	2004-09-28 10:58:40.179897888 -0700
@@ -355,6 +355,8 @@
 	  say M here and read <file:Documentation/modules.txt>.  The module
 	  will be called prism54.ko.
 
+source "drivers/net/wireless/ath/Kconfig"
+
 # yes, this works even when no drivers are selected
 config NET_WIRELESS
 	bool
```
