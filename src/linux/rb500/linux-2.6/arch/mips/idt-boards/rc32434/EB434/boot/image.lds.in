OUTPUT_ARCH(mips)
ENTRY(zstartup)
SECTIONS
{
  /* Read-only sections, merged into text segment: */
  . = IMSTART;
  .init          : { *(.init)		} =0
  .text      :
  {
    _ftext = . ;
    *(.text)
    *(.rodata)
    *(.rodata1)
   . = ALIGN(4096);
    input_data = .;
    arch/mips/idt-boards/rc32434/EB434/boot/piggy.o
    input_data_end = .;
   . = ALIGN(4096);
    *(.gnu.warning)
  } =0

  .reginfo : { *(.reginfo) }

   . = BSS_START;
  __bss_start = .;
  .bss       :
  {
   *(.bss)
  _end = . ;
  }
}
