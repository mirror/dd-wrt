OUTPUT_ARCH(TARGET_ARCH)
ENTRY(startup)
SECTIONS {
	. = TEXT_START;
	.text : {
		_ftext = .;
		text_start = .;
		*(.text.startup)
		*(.init)
		*(.text)
		*(.text.*)
		*(.fini)
		*(.glue_7)
		*(.glue_7t)
		*(.rdata)
		*(.rdata.*)
		*(.rodata)
		*(.rodata.*)
		_etext = .;
		text_end = .;
	}

	. = DATA_START;
	.data : AT(ADDR(.text)+SIZEOF(.text)) {
		_fdata = .;
		data_start = .;
		*(.data)
		*(.data.*)
		*(.sdata)
		_edata = .;
		data_end = .;
	}

	.bss : {
		_fbss = .;
		bss_start = .;
		*(.bss)
		*(.bss.*)
		*(.sbss)
		*(.scommon)
		*(COMMON)
		bss_end = .;
	}

	_end = .;
}
