## src/linux/rt2880/linux-2.6.23/arch/mips/rt2880/Kconfig
```kconfig
if RALINK_RT2880

choice
        prompt "Soc Hardware Type"
	default RT2880_ASIC

config  RT2880_ASIC 
        bool "RT2880-ASIC"
endchoice

endif
#-----------------------------

if RALINK_RT3052

choice
        prompt "Soc Hardware Type"
	default RT3052_ASIC

config  RT3052_ASIC 
        bool "RT3052-ASIC"
endchoice

endif


config  RT2860V2_2850
        bool "Dual Band"
        depends on RALINK_RT2880

choice
        prompt "RF Type"
        depends on RALINK_RT3052
        default RALINK_RT3052_2T2R

        config  RALINK_RT3050_1T1R
        bool "RT3050-1T1R"

        config  RALINK_RT3051_1T2R
        bool "RT3051-1T2R"

        config  RALINK_RT3052_2T2R
        bool "RT3052-2T2R"
endchoice

#--------------------------

config FLASH_REMAP_NEED
       bool
       default y if (RALINK_RT2880)
choice
       prompt "DRAM Size"
       default RT2880_DRAM_16M

config RT2880_DRAM_8M
       bool "8M"

config RT2880_DRAM_16M
       bool "16M"

config RT2880_DRAM_32M
       bool "32M"

config RT2880_DRAM_64M
       bool "64M"

endchoice

choice
       prompt "Flash Size"
       default RT2880_FLASH_4M
       depends on  FLASH_REMAP_NEED

config RT2880_FLASH_2M
       bool "2M"

config RT2880_FLASH_4M
       bool "4M"

config RT2880_FLASH_8M
       bool "8M"

config RT2880_FLASH_16M
       bool "16M"

endchoice

config  RT2880_FLASH_32M
        bool "Flash Size 32MB Support"
	depends on RALINK_RT3052_MP2
	select MTD_CONCAT if RT2880_FLASH_32M

config  RALINK_RAM_SIZE
	int 
	default 8 if RT2880_DRAM_8M
	default 16 if RT2880_DRAM_16M
	default 32 if RT2880_DRAM_32M
	default 64 if RT2880_DRAM_64M

config MTD_PHYSMAP_START
       hex 'Physmap start'
       default 0xBF000000 if !FLASH_REMAP_NEED && RALINK_RT3052

config MTD_PHYSMAP_LEN
       hex 
       default 0x200000 if RT2880_FLASH_2M
       default 0x400000 if RT2880_FLASH_4M
       default 0x800000 if RT2880_FLASH_8M
       default 0x1000000 if RT2880_FLASH_16M
       default 0x2000000 if RT2880_FLASH_32M
       default 0x1000000 if !FLASH_REMAP_NEED

config MTD_PHYSMAP_BUSWIDTH
       int 
       default 2

choice
	prompt "Root File System Type"
	default RT2880_ROOTFS_IN_RAM

config  RT2880_ROOTFS_IN_RAM
        bool "RootFS_in_RAM"
	select BLK_DEV_INITRD 
	select BLK_DEV_RAM 

config  RT2880_ROOTFS_IN_FLASH
        bool "RootFS_in_FLASH"
endchoice

config BLK_DEV_RAM_SIZE
	int 'Default RAM disk size'
	default 8192
	depends on RT2880_ROOTFS_IN_RAM

config	INITRAMFS_LZMA
	bool "Compress ramdisk by lzma instead of gzip"
	depends on RT2880_ROOTFS_IN_RAM

config MTD_KERNEL_PART_SIZ
	hex 'MTD Kernel Partition Size (Unit:Bytes)'
	default 0xD0000
	depends on RT2880_ROOTFS_IN_FLASH

config  RALINK_TIMER
	tristate 'Ralink WatchDog' 

config  RALINK_TIMER_WDG
        bool "Ralink WatchDog Timer"
        depends on RALINK_TIMER

config  RALINK_TIMER_WDG_RESET_OUTPUT
        bool "Ralink WatchDog Reset Output"
        depends on RALINK_TIMER_WDG

config  RALINK_WDG_TIMER
        int "WatchDog Timer (Unit:1Sec, Max=30Sec)"
        default 10
        depends on RALINK_TIMER_WDG

config  RALINK_WDG_REFRESH_INTERVAL
        int "WatchDog Refresh Interval (Unit:1Sec, Max=30Sec)"
        default 4
        depends on RALINK_TIMER_WDG

config  RALINK_TIMER_DFS
        bool "Ralink DFS Timer"
        depends on RALINK_TIMER
```

## src/linux/rt2880/linux-2.6.23/drivers/net/raeth/Kconfig
```kconfig
config RAETH
        tristate "Ralink GMAC"
        ---help---
          This driver supports Ralink gigabit ethernet family of
          adapters.

config RAETH_NAPI
        bool "Use Rx Polling (NAPI)"
        depends on RAETH

config RAETH_JUMBOFRAME
        bool "Jumbo Frame up to 4K bytes"
        depends on RAETH && !RALINK_RT3052

config RAETH_QOS
        bool "QoS Feature"
        depends on RAETH && !RALINK_RT2880

config RAETH_GMAC2
        bool "GMAC2 Support"
        depends on RAETH && RALINK_RT2883


config  RAETH_ROUTER
        bool "IC+"
        depends on !RALINK_RT3052

config  ICPLUS_PHY
        bool "100PHY"
        depends on !RALINK_RT3052

config  RTL8366_SWITCH
        bool "100PHY"
        depends on !RALINK_RT3052

config  RTL8366RB_SWITCH
        bool "100PHY"
        depends on RALINK_RT3052

config  AR690W
        bool "RTL config for AR690W"
        depends on RTL8366_SWITCH

config  RT15N
        bool "RTL config for Asus RT-15N"
        depends on RTL8366_SWITCH

config  MAC_TO_MAC_MODE
        bool "VITESSE"
        depends on !RALINK_RT3052

config  RT_3052_ESW
        bool "RT3052 Embedded Switch"
	select LAN_WAN_SUPPORT
        depends on RALINK_RT3052

config  GIGAPHY
        bool "MARVELL"
        depends on !RALINK_RT3052



config LAN_WAN_SUPPORT
        bool "LAN/WAN Partition"
        depends on RAETH_ROUTER || RT_3052_ESW

choice
        prompt "Board Layout Type"
        depends on LAN_WAN_SUPPORT
	default WAN_AT_P0

	config  WAN_AT_P4
	        bool "LLLL/W"
		
	config  WAN_AT_P0
	        bool "W/LLLL"
endchoice

config	ESW_DOUBLE_VLAN_TAG
	bool "Double VLAN Tag Support"
	depends on RT_3052_ESW

config RAETH_RT3052_P5
        bool "Port 5 Support"
        depends on RAETH && RALINK_RT3052
choice
        prompt "Target Mode"
        depends on RAETH_RT3052_P5
	default P5_RGMII_TO_MAC_MODE

	config P5_MAC_TO_PHY_MODE
		bool "Ethernet_Phy"
	config P5_RGMII_TO_MAC_MODE
		bool "Giga_Switch"
	config P5_MII_TO_MAC_MODE
		bool "External_CPU(MII_RvMII)"
	config P5_RMII_TO_MAC_MODE
		bool "External_CPU(RvMII_MII)"
endchoice

config  MAC_TO_GIGAPHY_MODE_ADDR
        hex "Phy Address"
	default 0x1F
        depends on GIGAPHY || P5_MAC_TO_PHY_MODE
```

## src/linux/rt2880/linux-2.6.23/drivers/usb/dwc_otg/Kconfig
```kconfig
config DWC_OTG
        depends on RALINK_RT3052
        tristate "Ralink DWC_OTG support"
        ---help---
          This driver supports Ralink DWC_OTG

choice
        prompt "USB Operation Mode"
        depends on DWC_OTG
        default DWC_OTG_HOST_ONLY

config DWC_OTG_HOST_ONLY
        bool "HOST ONLY MODE"
        depends on DWC_OTG

config DWC_OTG_DEVICE_ONLY
        bool "DEVICE ONLY MODE"
        depends on DWC_OTG

endchoice


config DWC_OTG_DEBUG
        bool "Enable debug mode"
        depends on DWC_OTG
```

## src/linux/sl2312/linux-2.6.23/arch/arm/mach-sl2312/Kconfig
```kconfig
menu "SL2312"

config SL3516_ASIC
	bool "SL3516 ASIC version"
	depends on ARCH_SL2312
	help
	  This option to select AISC or FPGA
config PCI
       bool "SL2312 PCI"
       depends on ARCH_SL2312
       help
         This option to enable Storlink PCI controller

config SL2312_LPC
       bool "SL2312 LPC"
       depends on ARCH_SL2312
       help
         This option to enable Low Pin Count controller

config SL2312_USB
       bool "SL2312 USB"
       depends on ARCH_SL2312
       help
         This option to enable USB OTG host controller

config GEMINI_IPI
       bool "Gemini IPI test"
       depends on ARCH_SL2312
       help
	 Enable this option to test dual cpu Inter-Processor-Interrupt
endmenu
```

## src/linux/universal/linux-3.10/Documentation/devicetree/bindings/i2c/i2c-ralink.txt
```
I2C for Ralink platforms

Required properties :
- compatible : Must be "link,rt3052-i2c"
- reg: physical base address of the controller and length of memory mapped
     region.
- #address-cells = <1>;
- #size-cells = <0>;

Optional properties:
- Child nodes conforming to i2c bus binding

Example :

palmbus@10000000 {
	i2c@900 {
		compatible = "link,rt3052-i2c";
		reg = <0x900 0x100>;
		#address-cells = <1>;
		#size-cells = <0>;

		hwmon@4b {
			compatible = "national,lm92";
			reg = <0x4b>;
		};
	};
};
```

## src/linux/universal/linux-3.10/drivers/pci/host/Kconfig
```kconfig
menu "PCI host controller drivers"
	depends on PCI

config PCIE_DW
	bool

config PCI_IMX6
	bool "Freescale i.MX6 PCIe controller"
	depends on SOC_IMX6Q
	select PCIEPORTBUS
	select PCIE_DW

endmenu
```

## src/linux/universal/linux-3.10/fs/exfat/Kconfig
```kconfig
config EXFAT_FS
	tristate "exFAT fs support"
	depends on BLOCK
	select NLS
	select NLS_UTF8
	select NLS_CODEPAGE_437
	select NLS_ISO8859_1
	help
	  If you want to use the exFAT file system, then you must say Y or M
	  here to inlucde exFAT support. exFAT supports winnt short-name rule.
	  (winnt: emulate the Windows NT rule for display/create.)

	  To compile this as a module, choose M here: the module will be called
	  exfat.

if EXFAT_FS
config EXFAT_DEFAULT_CODEPAGE
	int "Default codepage for exFAT"
	default 437
	help
	  This option should be set to the codepage of your exFAT filesystems.

config EXFAT_DEFAULT_IOCHARSET
	string "Default iocharset for exFAT"
	default "utf8"
	help
	  Set this to the default input/output character set you'd
	  like exFAT to use. It should probably match the character set
	  that most of your exFAT filesystems use, and can be overridden
	  with the "iocharset" mount option for exFAT filesystems.

config EXFAT_VIRTUAL_XATTR
	bool "Virtual xattr support for exFAT"
	default y
	help
	  To support virtual xattr.

config EXFAT_VIRTUAL_XATTR_SELINUX_LABEL
	string "Default string for SELinux label"
	default "u:object_r:exfat:s0"
	depends on EXFAT_VIRTUAL_XATTR
	help
	  Set this to the default string for SELinux label.
	  Support for "u:object_r:exfat:s0" was added in Android Pie,
	  if you're running Oreo or lower, use "u:object_r:vfat:s0" instead.

config EXFAT_DEBUG
	bool "enable debug features"

if EXFAT_DEBUG

config EXFAT_DBG_MSG
	bool "enable debug messages"

config EXFAT_DBG_BUGON
	bool "enable strict BUG_ON() for debugging"

config EXFAT_DBG_WARNON
	bool "enable strict WARN_ON() for debugging"

endif # if EXFAT_DEBUG

config EXFAT_UEVENT
	bool "enable uevent"

endif # if EXFAT_FS
```

## src/linux/universal/linux-3.10/sound/soc/ralink/Kconfig
```kconfig
config SND_MT7620_SOC_I2S
	depends on SOC_MT7620_OPENWRT && SND_SOC
	select SND_SOC_GENERIC_DMAENGINE_PCM
	tristate "SoC Audio (I2S protocol) for Ralink MT7620 SoC"
	help
	  Say Y if you want to use I2S protocol and I2S codec on Ingenic MT7620
	  based boards.

config SND_MT7620_SOC_WM8960
	tristate "SoC Audio support for Ralink WM8960"
	select SND_MT7620_SOC_I2S
	select SND_SOC_WM8960
	help
	  Say Y if you want to add support for ASoC audio on the Qi LB60 board
	  a.k.a Qi Ben NanoNote.
```

## src/linux/universal/linux-3.11/arch/mips/ralink-openwrt/Kconfig
```kconfig
if RALINK_OPENWRT


choice
	prompt "Ralink SoC selection"
	default SOC_RT305X
	help
	  Select Ralink MIPS SoC type.

	config SOC_RT288X_OPENWRT
		bool "RT288x"
		select HW_HAS_PCI

	config SOC_RT305X_OPENWRT
		bool "RT305x"
		select USB_ARCH_HAS_HCD
		select USB_ARCH_HAS_OHCI
		select USB_ARCH_HAS_EHCI

	config SOC_RT3883_OPENWRT
		bool "RT3883"
		select USB_ARCH_HAS_OHCI
		select USB_ARCH_HAS_EHCI
		select HW_HAS_PCI

	config SOC_MT7620_OPENWRT
		bool "MT7620"
		select USB_ARCH_HAS_OHCI
		select USB_ARCH_HAS_EHCI
		select HW_HAS_PCI

endchoice

choice
	prompt "Devicetree selection"
	default DTB_RT_NONE
	help
	  Select the devicetree.

	config DTB_RT_NONE
		bool "None"

	config DTB_RT2880_EVAL
		bool "RT2880 eval kit"
		depends on SOC_RT288X_OPENWRT

	config DTB_RT305X_EVAL
		bool "RT305x eval kit"
		depends on SOC_RT305X_OPENWRT

	config DTB_RT3883_EVAL
		bool "RT3883 eval kit"
		depends on SOC_RT3883_OPENWRT

	config DTB_MT7620A_EVAL
		bool "MT7620A eval kit"
		depends on SOC_MT7620_OPENWRT

endchoice

config CLKEVT_RT3352
	prompt "Dynamic Frequeny Selection clocksource"
	bool
	depends on SOC_RT305X_OPENWRT || SOC_MT7620_OPENWRT
	default y
	select CLKSRC_OF
	select CLKSRC_MMIO

endif
```

## src/linux/universal/linux-3.11/drivers/net/ethernet/ralink/Kconfig
```kconfig
config NET_RALINK
	tristate "Ralink RT288X/RT3X5X/RT3662/RT3883/MT7620 ethernet driver"
	depends on RALINK_OPENWRT
	help
	  This driver supports the ethernet mac inside the ralink wisocs

if NET_RALINK

config NET_RALINK_MDIO
	def_bool NET_RALINK
	depends on (SOC_RT288X_OPENWRT || SOC_RT3883_OPENWRT || SOC_MT7620_OPENWRT)
	select PHYLIB

config NET_RALINK_MDIO_RT2880
	def_bool NET_RALINK
	depends on (SOC_RT288X_OPENWRT || SOC_RT3883_OPENWRT)
	select NET_RALINK_MDIO

config NET_RALINK_ESW_RT3052
	def_bool NET_RALINK
	depends on SOC_RT305X_OPENWRT
	select PHYLIB
	select SWCONFIG

config NET_RALINK_GSW_MT7620
	def_bool NET_RALINK
	depends on SOC_MT7620_OPENWRT
	select NET_RALINK_MDIO
	select PHYLIB
	select SWCONFIG
endif
```

## src/linux/universal/linux-3.12/arch/mips/ralink/rt305x/Kconfig
```kconfig
if RALINK_RT3052 || RALINK_RT3350
#-----------------------------


choice
        prompt "Soc Hardware Type"
	default RT3052_ASIC

config  RT3052_ASIC 
        bool "RT305x/RT3350-ASIC"
endchoice


choice
        prompt "RF Type"
        depends on RALINK_RT3052
        default RALINK_RT3052_2T2R

        config  RALINK_RT3050_1T1R
        bool "1T1R"

        config  RALINK_RT3051_1T2R
        bool "1T2R"

        config  RALINK_RT3052_2T2R
        bool "2T2R"
endchoice

choice
        prompt "RF Type"
        depends on  RALINK_RT3352 

        config  RALINK_RT3352_2T2R
        bool "2T2R"
endchoice

choice
	prompt "RF Type"
	depends on RALINK_RT3883

	config  RALINK_RT3662_2T2R
	bool "2T3R (RT3662)"

	config  RALINK_RT3883_3T3R
	bool "3T3R (RT3883)"
endchoice

endif
if RALINK_RT3352

choice
        prompt "Soc Hardware Type"
	default RT3352_ASIC

config  RT3352_ASIC 
	bool "RT3352-ASIC"
	select USB_ARCH_HAS_OHCI
	select USB_ARCH_HAS_EHCI

endchoice

endif

#--------------------------

if RALINK_RT3883

choice
        prompt "Soc Hardware Type"
	default RT3883_ASIC

config  RT3883_ASIC 
	bool "RT3883/RT3662-ASIC"
	select USB_ARCH_HAS_OHCI
	select USB_ARCH_HAS_EHCI
endchoice

choice
        prompt "RT3883 PCI architecture"
	default PCIE_PCI_CONCURRENT

config PCIE_PCI_CONCURRENT
        bool "PCIE RC and PCI HOST CONCURRENT"
config PCIE_ONLY
        bool "PCIE RC ONLY"
config PCI_ONLY
        bool "PCI HOST ONLY"
config PCIE_PCI_NONE
        bool "Non-support PCI/PCIe"
endchoice

endif

#---------------------------

if RALINK_RT5350

choice
	prompt "Soc Hardware Type"
	default RT5350_ASIC

config	RT5350_ASIC 
	bool "RT5350-ASIC"
	select USB_ARCH_HAS_OHCI
	select USB_ARCH_HAS_EHCI

endchoice

endif
```

## src/linux/universal/linux-3.13/drivers/usb/dwc_otg_ralink/Kconfig
```kconfig
config DWC_OTG_RALINK
        depends on RALINK_RT3052 || RALINK_RT3352
        tristate "Ralink DWC_OTG support"
        ---help---
          This driver supports Ralink DWC_OTG

choice
        prompt "USB Operation Mode"
        depends on DWC_OTG_RALINK
        default DWC_OTG_HOST_ONLY_RALINK

config DWC_OTG_HOST_ONLY_RALINK
        bool "HOST ONLY MODE"
        depends on DWC_OTG_RALINK

config DWC_OTG_DEVICE_ONLY_RALINK
        bool "DEVICE ONLY MODE"
        depends on DWC_OTG_RALINK

endchoice


config DWC_OTG_DEBUG_RALINK
        bool "Enable debug mode"
        depends on DWC_OTG_RALINK
```
