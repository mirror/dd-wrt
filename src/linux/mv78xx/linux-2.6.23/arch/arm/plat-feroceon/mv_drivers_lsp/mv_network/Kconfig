## src/linux/mv78xx/linux-2.6.23/arch/arm/plat-feroceon/mv_drivers_lsp/mv_network/Kconfig
```kconfig
config MV_ETHERNET
        bool "Networking Support"
	depends MV_INCLUDE_GIG_ETH
        ---help---
        Choose this option to support Marvell Gigabit Ethernet Controller 

config MV_ETH_PORTS_NUM
	int "Number of Marvell Giga Ethernet controllers"
	depends MV_ETHERNET
	default 0 

if MV_ETHERNET

menu "Network Interface Configuration"

config  MV_ETH_0_MTU
	int "Giga port #0 MTU value"
	depends on (MV_ETH_PORTS_NUM != 0)
 	default 1500
        ---help---
	Default MTU value for Marvell Giga port #0

config  MV_ETH_0_MACADDR
        string "Giga port #0 MAC Address"
        depends on (MV_ETH_PORTS_NUM != 0)
        default "00:00:00:00:00:80"
        ---help---
        Default MAC address for Marvell Giga port #0 

config  MV_ETH_1_MTU
        int "Giga port #1 MTU value"
        depends on (MV_ETH_PORTS_NUM != 0) && (MV_ETH_PORTS_NUM != 1)
        default 1500
        ---help---
	Default MTU value for Marvell Giga port #1

config  MV_ETH_1_MACADDR
        string "Giga port #1 MAC Address"
        depends on (MV_ETH_PORTS_NUM != 0) && (MV_ETH_PORTS_NUM != 1)
        default "00:00:00:00:00:81"
        ---help---
        Default MAC address for Marvell Giga port #1

config  MV_ETH_2_MTU
        int "Giga port #2 MTU value"
        depends on (MV_ETH_PORTS_NUM != 0) && (MV_ETH_PORTS_NUM != 1) && (MV_ETH_PORTS_NUM != 2)
        default 1500
        ---help---
        Default MTU value for Marvell Giga port #2

config  MV_ETH_2_MACADDR
        string "Giga port #2 MAC Address"
        depends on (MV_ETH_PORTS_NUM != 0) && (MV_ETH_PORTS_NUM != 1) && (MV_ETH_PORTS_NUM != 2)
        default "00:00:00:00:00:82"
        ---help---
        Default MAC address for Marvell Giga port #2

config  MV_ETH_3_MTU
        int "Giga port #3 MTU value"
        depends on (MV_ETH_PORTS_NUM != 0) && (MV_ETH_PORTS_NUM != 1) && (MV_ETH_PORTS_NUM != 2) && (MV_ETH_PORTS_NUM != 3)
        default 1500
        ---help---
        Default MTU value for Marvell Giga port #3

config  MV_ETH_3_MACADDR
        string "Giga port #3 MAC Address"
        depends on (MV_ETH_PORTS_NUM != 0) && (MV_ETH_PORTS_NUM != 1) && (MV_ETH_PORTS_NUM != 2) && (MV_ETH_PORTS_NUM != 3)
        default "00:00:00:00:00:83"
        ---help---
        Default MAC address for Marvell Giga port #3

endmenu
endif

if MV_ETHERNET
menu "Rx/Tx Queue Configuration"

config  MV_ETH_RX_Q_NUM
        int "Number of RX queues"
        default 1
        ---help---
          Multiple RX queue support.

config  MV_ETH_TX_Q_NUM
        int "Number of TX queues"
        default 1
        ---help---
          Multiple TX queue support.
endmenu
endif

if MV_ETHERNET
menu "TCP/UDP Offloading"

config  MV_ETH_TSO
        bool "TSO Support for Marvell network interface"
	default y
        ---help---
        Adds TSO support for TCP segmentation offload on Marvell network interface.

config  MV_ETH_UFO
        bool "UFO Support for Marvell network interface"
        ---help---
        Adds UFO support for transmit UDP buffers larger than MTU size on 
        Marvell network interface.
        UFO stands for UDP Fragmentation Offload

config  MV_ETH_LRO_UDP
        bool "LRO UDP support for Marvell network interface"
	depends on INET_LRO
        ---help---
        Adds LRO support for receiving large UDP datagrams on Marvell network interface.
        LRO stands for Large Receive Offload

endmenu
endif

if MV_ETHERNET
menu "Control and Statistics"

config  MV_ETH_PROC
	bool "Support eth proc FS "
	default y
	---help---
	  Use mvEgigaTool proc FS.

config  MV_ETH_STATS
        bool "Collect statistics for Marvell network interface driver"
	default n
        ---help---
        Collect ethernet statistics. Can be displayed using mv_eth_tool.

endmenu
endif

if (MV_ETHERNET)
menu "Advanced Features"

config  MV_ETH_TIMER_PERIOD
        int "Periodical timer period"
        default 10
        ---help---
          Periodical timer period for clenup in [msec].

config  MV_SKB_HEADROOM
        int "SKB headroom size"
        default 16
        ---help---
          Customize SKB headroom size. Must be power of 2.

config	MV_SKB_REUSE
	bool "Try to reuse SKB"
	default y
	---help---
	  Reuse SKB from TX to RX

config  MV_ETH_NFP
        bool "Use Network Fast Processing (NFP)"
	default y
        ---help---
        Choosing this option will include NFP support in the image.

config MV_ETH_NFP_AGING_TIMER
        int "NFP aging timer interval"
        depends on MV_ETH_NFP
        default 15
        ---help---
        The NFP aging mechanism timer interval. If unsure, leave default value.

config MV_ETH_NFP_NAT_SUPPORT
        bool "Support NFP NAT"
        depends on MV_ETH_NFP && NF_CONNTRACK_ENABLED
        ---help---
        Choosing this option will enable NFP NAT support.

#config MV_ETH_NFP_FDB_SUPPORT
#	bool "Support NFP Bridging"
#	depends on MV_ETH_NFP && BRIDGE
#	default n
#	 ---help---
#	Choosing this option will enable NFP Bridging.

config  MV_NFP_STATS
        bool "Collect NFP statistics"
	depends on MV_ETH_NFP
        default n
        ---help---
        Collect NFP statistics. Can be displayed using mv_eth_tool.

endmenu
endif

config MV_GATEWAY
        bool "Gateway support"
	depends on MV_ETHERNET
        ---help---
	Choose this option to support Gigabit Ethernet Controller connected to 
        on-board QuarterDeck switch family

if MV_GATEWAY

menu "Gateway Interface Configuration"

config  MV_GTW_CONFIG
	string "Network interface configuration"
	default "(00:11:66:11:66:11,0)(00:22:77:22:77:22,1:2:3:4),mtu=1500"
	---help---
	 Set the network interface configuration. For each interface, define the interface 
	 name, MAC address and participating ports, at the end (optionally) set the 
         interfaces MTU. For example, the default configuration defines two interfaces, 
         eth0 and eth1, and sets the MTU to 1500.

endmenu

menu "Gateway Features"

config MV_GTW_FLOW_CONTROL
	bool "Use flow-control Mode"
	default n
	---help---
	  Use flow control between switch and MAC. If unsure say No.

config  MV_GTW_IGMP
        bool "L2 IGMP Snooping support"
        default y
        ---help---
          Support L2 IGMP snooping at the switch level, i.e. directing L3 routed multicast
          stream to the specific L2 port which originally received an IGMP Join message,
          instead of fluding all VLAN ports.

config  MV_GTW_LINK_STATUS
	bool "Link status change indications"
	default y
	---help---
	  Support Phy link status change indications.

endmenu

menu "Quality Of Service Configuration (Requires more than one Rx queue)"

config MV_GTW_QOS
        bool "ToS based QoS support"
        depends on (MV_ETH_RX_Q_NUM != 1)
        default y
        ---help---
          Priorities packets marked with predefined ToS in IP header comming from WAN interface. 

config MV_GTW_QOS_VOIP
        bool "VoIP QoS"
        depends on MV_GTW_QOS
        default y

config MV_GTW_QOS_VOIP_TOS
        string "VoIP ToS value"
        depends on MV_GTW_QOS_VOIP
        default "0xA0"

config MV_GTW_QOS_ROUTING
        bool "Routing QoS"
        depends on MV_GTW_QOS
        default y

config MV_GTW_QOS_ROUTING_TOS
        string "Routing ToS value"
        depends on MV_GTW_QOS_ROUTING
        default "0x11;0x22"

endmenu

endif
```

## src/linux/mv78xx/linux-2.6.23/arch/arm/plat-feroceon/mv_drivers_lsp/mv_phone/Kconfig
```kconfig
menu "Telephony options"
	depends on MV_INCLUDE_TDM

config  MV_PHONE
	tristate "Support for Marvell telephony support (VoIP)"
	depends on MV_INCLUDE_TDM && PHONE
	default y
	---help---
	  Choosing this option enables the Marvell telephony underlying 
	  support for various VoIP applications. 
	  Note, kernel Telephony subsystem must be chosen too.

choice 
	prompt "Sampling mode"
	depends on MV_PHONE

config MV_TDM_LINEAR_MODE
	bool "Linear (16-bit)"

config MV_TDM_ULAW_MODE
	bool "U-Law (8-bit)"

endchoice

endmenu
```

## src/linux/mv78xx/linux-2.6.23/arch/arm/plat-feroceon/mv_drivers_lsp/mv_sata/Kconfig
```kconfig
menu "Sata options"
	depends on SCSI_MVSATA
	
config  MV_SATA_SUPPORT_ATAPI
        bool "Support ATAPI (CR-ROM/DVD-ROM) devices"
        default n

config  MV_SATA_ENABLE_1MB_IOS
        bool "Enable 1 MByte requests"
        default n
        help
          Set the maximum io request size to 1 MByte for HDD's the support LBA48 feature,
          say No if you want to keep the maximum limit on 128KBytes.
choice
	prompt "Debug level"
	default SATA_NO_DEBUG

config SATA_NO_DEBUG
	bool "No Debug"

config SATA_DEBUG_ON_ERROR
	bool "Debug on errors"
	help
	  print debug messages when EDMA/System/HDD errors occur.

config SATA_FULL_DEBUG
	bool "Full debug"

endchoice

endmenu
```

## src/linux/mv78xx/linux-2.6.23/arch/arm/plat-feroceon/mv_drivers_lsp/mv_sdio/Kconfig
```kconfig
menu "Marvell SDIO\MMC driver"
	depends on MV_INCLUDE_SDIO


config MMC_MVSDMMC
	tristate "Marvell SDIO host driver"
	depends on MMC && MV_INCLUDE_SDIO
	---help---
	  This selects the Marvell SDIO host driver
	  say Y or M here.
	  If unsure, say N.

endmenu
```

## src/linux/mv78xx/linux-2.6.23/arch/arm/plat-feroceon/mv_drivers_lsp/mv_tsu/Kconfig
```kconfig
menu "TSU options"
	depends on MV_INCLUDE_TS

config  MV_TSU
	bool "Support for Marvell Transport Stream Interface"
#	depends on MV_INCLUDE_TS
	default n
choice
	prompt "TSU interface type"
	depends on MV_TSU
	default TSU_SERIAL_IF

config TSU_SERIAL_IF
	bool "Serial Interface"
	---help---
	The TSU will work in serial mode (2 ports).
	
config TSU_PARALLEL_IF
	bool "Parallel Interface"
	---help---
	The TSU will work in parallel mode (1 port).
endchoice


choice
	prompt "TSU Core-Clock"
	depends on MV_TSU
	default TSU_CORE_CLK_83MHZ

config TSU_CORE_CLK_71MHZ
	bool "71 MHz TSU Core Clock"

config TSU_CORE_CLK_83MHZ
	bool "83 MHz TSU Core Clock"

config TSU_CORE_CLK_91MHZ
	bool "91 MHz TSU Core Clock"
config TSU_CORE_CLK_100MHZ
	bool "100 MHz TSU Core Clock"

endchoice

config  MV_TSU_PKT_SIZE
        int "TSU packet size"
        depends on MV_TSU
	default 188
	range 188, 256
        ---help---
          Define the TS packet size to be used (Same for both ports)
	  Must be >= 188 and <= 256.

config  MV_TSU_PROC
	bool "Support for TSU proc interface"
	depends on MV_TSU
	default y
        ---help---
          Support Proc-fs interface to configuring the TS control driver.

endmenu

	  
```

## src/linux/mv78xx/linux-2.6.23/arch/arm/plat-feroceon/mv_drivers_lsp/mv_xor/Kconfig
```kconfig
config MV_USE_XOR_ENGINE
        bool "Use the XOR engines to offload CPU tasks"   
        depends on (MV_INCLUDE_XOR) && EXPERIMENTAL
        default n
        help
            Say Y of you want to use the XOR engine to offload some of the 
            CPU tasks.

config MV_RAID5_XOR_OFFLOAD
        bool "Use the XOR engine to perfom the xor calculation"
        depends on MV_USE_XOR_ENGINE
        default n
        help
          Say Y here if you want to use the XOR engine to perform
          the RAID4/5 xor calculation.

config MV_XORMEMCOPY
        bool "Use the XOR engine to accelerate memcpy and memmove"
        depends on MV_USE_XOR_ENGINE
        default n
        help
          Say Y here if you want to use the XOR engine to perform
          the memcpy and memmove.

config MV_XOR_MEMCOPY_THRESHOLD
        int "Minimum number of bytes to use XOR acceleration for memcpy()"
        depends on MV_XORMEMCOPY
        default "128"
        help
          This is the minimum buffer size needed in order to operate the XOR engine
          for accelerating the memcpy() and memmove() operations

config MV_XORMEMZERO
        bool "Use the XOR engine to accelerate memzero"
        depends on MV_USE_XOR_ENGINE
        default n
        help
          Say Y here if you want to use the XOR engine to perform
          the memzero.

config MV_XOR_MEMZERO_THRESHOLD
        int "Minimum number of bytes to use XOR acceleration for memzero()"
        depends on MV_XORMEMZERO
        default "192"
        help
          This is the minimum buffer size needed in order to operate the XOR engine
          for accelerating the memzero operation

config MV_USE_XOR_FOR_COPY_USER_BUFFERS
        bool "Use the XOR engine to accelerate copy_to_user and copy_from_user functions"
        depends on MV_USE_XOR_ENGINE
        default n
        help
          Say Y here if you want to accelerate the copy_to_user and copy_from_user functions
          using the XOR engine instead of the IDMA.

config MV_XOR_COPYUSER_THRESHOLD
        int "Minimum number of bytes to use XOR acceleration for copy_to_user() and copy_from_user()"
        depends on MV_USE_XOR_FOR_COPY_USER_BUFFERS
        default "1260"
        help
          This is the minimum buffer size needed in order to operate the XOR engine
          for accelerating the copy_to_user() and copy_from_user() operations
# support for interrupts mode disbaled
config ENABLE_XOR_INTERRUPTS
        bool "Activate the XOR in offloading mode (Enable XOR interrupts)."
        depends on MV_USE_XOR_ENGINE && NOT_SUPPRTED_FEATURE
        default n
        help
          Say Y here if you want to use the activate the XOR engine in interrupts
          mode (offloading).
# menu "Xor channels"
choice
	prompt "Number of XOR channels"
	default USE_TWO_ENGINES
	depends on MV_USE_XOR_ENGINE
	help
	  Select the number of XOR channels to be uses for kernel functions
	  accelerations.
	  
	config USE_TWO_ENGINES
	      bool "Two channels"

	config USE_FOUR_ENGINES
	       depends on ARCH_FEROCEON_KW
	      bool "Four channels"
endchoice


#endmenu
```

## src/linux/mv78xx/linux-2.6.23/drivers/spi/chips/Kconfig
```kconfig
#
# SPI devices configuration
#

menu "SPI chip support"
	depends on SPI

config SPI_KS8995M
	tristate "Kendin KS8995M Switch Controller"
	help
	  If you say yes here if you want to build the Kendin KS8995M Switch
	  controller device. 
	  
	  This driver can also be built as a module.  If so, the module
	  will be called spi_foo.	

endmenu
```

## src/linux/pb42/linux-2.6.22/drivers/spi/busses/Kconfig
```kconfig
#
# SPI adapter(s) configuration
#

menu "SPI Hardware Bus support"
	depends on SPI	
	
config SPI_IXP4XX
	tristate "IXP4xx GPIO-Based SPI Interface"
	depends on SPI && ARCH_IXP4XX
	select SPI_ALGOBIT
	help
	  Say Y here if you have an Intel IXP4xx(420,421,422,425) based
	  system and are using GPIO lines for an SPI bus.
	  
	  This support is also available as a module. If so, the module
	  will be called spi-ixp4xx.
										  
endmenu
```

## src/linux/rt2880/linux-2.6.23/arch/mips/Kconfig.diff
```kconfig
diff -urN SDK_3_1_0_0/RT288x_SDK/source/linux-2.6.21.x/arch/mips/Kconfig SDK_3_2_0_0/RT288x_SDK/source/linux-2.6.21.x//arch/mips/Kconfig
--- SDK_3_1_0_0/RT288x_SDK/source/linux-2.6.21.x/arch/mips/Kconfig	2008-08-06 05:28:24.000000000 +0200
+++ SDK_3_2_0_0/RT288x_SDK/source/linux-2.6.21.x//arch/mips/Kconfig	2008-10-24 08:20:15.000000000 +0200
@@ -17,6 +17,8 @@
 	bool
 config RALINK_RT2880_SHUTTLE
 	bool
+config RALINK_RT3052_MP2
+	bool
 choice
 	prompt "System type"
 
@@ -34,6 +36,20 @@
         help
          Ralink evaluation board based on RT2880
 
+config RALINK_RT2883
+        bool "Ralink RT2883 board"
+	select DMA_NONCOHERENT
+	select IRQ_CPU
+	select HW_HAS_PCI
+	select SWAP_IO_SPACE
+	select SYS_HAS_CPU_MIPS32_R1
+	select SYS_SUPPORTS_LITTLE_ENDIAN
+	select BOOT_ELF32
+	select SYS_SUPPORTS_32BIT_KERNEL
+	select RALINK_RT2883_MP
+        help
+         Ralink evaluation board based on RT2883
+
  config RALINK_RT3052
         bool "Ralink RT3052 board"
 	select DMA_NONCOHERENT
@@ -43,6 +59,7 @@
 	select SYS_SUPPORTS_LITTLE_ENDIAN
 	select BOOT_ELF32
 	select SYS_SUPPORTS_32BIT_KERNEL
+	select RALINK_RT3052_MP2
         help
          Ralink evaluation board based on RT3052
 
```
