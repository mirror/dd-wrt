## src/linux/universal/linux-3.15/drivers/net/ethernet/Kconfig.orig
```kconfig
#
# Ethernet LAN device configuration
#

menuconfig ETHERNET
	bool "Ethernet driver support"
	depends on NET
	default y
	---help---
	  This section contains all the Ethernet device drivers.

if ETHERNET

config MDIO
	tristate

config SUNGEM_PHY
	tristate

if RALINK_DEVICE
source "drivers/net/ethernet/raeth/Kconfig"
endif
source "drivers/net/ethernet/3com/Kconfig"
source "drivers/net/ethernet/adaptec/Kconfig"
source "drivers/net/ethernet/aeroflex/Kconfig"
source "drivers/net/ethernet/allwinner/Kconfig"
source "drivers/net/ethernet/alteon/Kconfig"
source "drivers/net/ethernet/amd/Kconfig"
source "drivers/net/ethernet/apple/Kconfig"
source "drivers/net/ethernet/arc/Kconfig"
source "drivers/net/ethernet/atheros/Kconfig"
source "drivers/net/ethernet/cadence/Kconfig"
source "drivers/net/ethernet/adi/Kconfig"
source "drivers/net/ethernet/broadcom/Kconfig"
source "drivers/net/ethernet/brocade/Kconfig"
source "drivers/net/ethernet/calxeda/Kconfig"
source "drivers/net/ethernet/chelsio/Kconfig"
source "drivers/net/ethernet/cirrus/Kconfig"
source "drivers/net/ethernet/cisco/Kconfig"
source "drivers/net/ethernet/davicom/Kconfig"


config AR2313
	tristate "AR2313 Ethernet support"
	depends on ETHERNET && ATHEROS
	select PHYLIB
	help
	  Support for the AR231x/531x ethernet controller

config AR2313_VLAN
	bool "AR2313 VLAN support"
	depends on AR2313
	help
	  Support for the AR231x/531x VLANs

config DNET
	tristate "Dave ethernet support (DNET)"
	depends on HAS_IOMEM
	select PHYLIB
	---help---
	  The Dave ethernet interface (DNET) is found on Qong Board FPGA.
	  Say Y to include support for the DNET chip.

	  To compile this driver as a module, choose M here: the module
	  will be called dnet.

source "drivers/net/ethernet/dec/Kconfig"
source "drivers/net/ethernet/dlink/Kconfig"
source "drivers/net/ethernet/emulex/Kconfig"
source "drivers/net/ethernet/neterion/Kconfig"
source "drivers/net/ethernet/faraday/Kconfig"
source "drivers/net/ethernet/freescale/Kconfig"
source "drivers/net/ethernet/fujitsu/Kconfig"
source "drivers/net/ethernet/hp/Kconfig"
source "drivers/net/ethernet/ibm/Kconfig"
source "drivers/net/ethernet/intel/Kconfig"
source "drivers/net/ethernet/i825xx/Kconfig"
source "drivers/net/ethernet/xscale/Kconfig"
source "drivers/net/ethernet/icplus/Kconfig"
source drivers/net/ethernet/ag934x/Kconfig


config IXP400_ETH
	tristate "Intel IXP400 Ethernet Device support"
	depends on ETHERNET && ARM && (ARCH_IXP4XX)
	---help---
	  If you select M here, the Intel IXP400 Ethernet driver will be
	  compiled as part of the build.
 
	  In order for the driver to build correctly you must set up some
	  environment variables before building the kernel. See the README
	  files that accompany the IXP400 software or Linux Ethernet Driver
	  distribution for details.
 
	  Note that this driver is Intel proprietary code and must be obtained
	  from Intel Corp. See the README files that accompany the IXP400
	  software or Linux Ethernet Driver distribution for details.
 
	  The driver can be compiled only as a module, as linking it
	  statically into the kernel would violate the GPL. The module will be
	  called ixp400_eth.ko
 
	  Select M if you have the IXP400 ethernet driver source code and wish
	  to include it in your build.

choice 
	prompt "Intel IXP400 Ethernet Device Driver NPE support"
	depends on IXP400_ETH
	default IXP400_ETH_ALL
	---help---
	  If you select 'All NPEs' option here, the Intel IXP400 Ethernet driver
	  will be compiled to configure all Ethernet NPEs and map "ixp0" device
	  to Ethernet NPE B, "ixp1" device to Ethernet NPE C, and "ixp2" device
	  to Ethernet NPE A (for IXP455 & IXP465 silicon only).
 
	  If you select 'NPEB-only' option here, the Intel IXP400 Ethernet driver
	  will be compiled to map "ixp0" device to Ethernet NPE B only.
 
	  If you select 'NPEC-only' option here, the Intel IXP400 Ethernet driver
	  will be compiled to map "ixp1" device to Ethernet NPE C only.
 
	  See the README files that accompany the IXP400
	  software or Linux Ethernet Driver distribution for details.

config IXP400_ETH_ALL
	bool "All_NPEs"

config IXP400_ETH_NPEB_ONLY
	bool "NPEB-Only"

config IXP400_ETH_NPEC_ONLY
	bool "NPEC-Only"

endchoice

config IXP400_ETH_SKB_RECYCLE
	depends on IXP400_ETH
	bool "Intel IXP400 Ethernet Device Driver Fast Skb Recycling support"
	---help---
	  If you select Y here, the Intel IXP400 Ethernet driver will be
	  compiled to internally recycle skbufs.
 
	  IMPORTANT: This option, if enabled, may NOT work with some
	  patched kernels.
 
	  If unsure select N here.
 
	  See the README files that accompany the IXP400
	  software or Linux Ethernet Driver distribution for details.

config IXP400_ETH_QDISC_ENABLED
	depends on IXP400_ETH
	bool "Intel IXP400 Ethernet Device Driver Fast QDisc support"
	---help---
	  If you select Y here, the Intel IXP400 Ethernet driver will be
	  compiled to internally use its own queueing discipline (qdisc).
 
	  IMPORTANT: This option may NOT work with some debug tools or
	  some kernel features.
 
	  If unsure select N here.
 
	  See the README files that accompany the IXP400
	  software or Linux Ethernet Driver distribution for details.

config IXP400_NAPI
	depends on IXP400_ETH
	bool "Intel IXP400 Ethernet Device Driver NAPI support"
	---help---
	  If you select Y here, the Intel IXP400 Ethernet driver will be
	  compiled to use the Linux kernel's NAPI polling interface.
 
	  If unsure select N here.
 
	  See the README files that accompany the IXP400
	  software or Linux Ethernet Driver distribution for details.



config JME
	tristate "JMicron(R) PCI-Express Gigabit Ethernet support"
	depends on PCI
	select CRC32
	select MII
	---help---
	  This driver supports the PCI-Express gigabit ethernet adapters
	  based on JMicron JMC250 chipset.

	  To compile this driver as a module, choose M here. The module
	  will be called jme.

config KORINA
	tristate "Korina (IDT RC32434) Ethernet support"
	depends on MIKROTIK_RB532
	---help---
	  If you have a Mikrotik RouterBoard 500 or IDT RC32434
	  based system say Y. Otherwise say N.

config LANTIQ_ETOP
	tristate "Lantiq SoC ETOP driver"
	depends on SOC_TYPE_XWAY
	---help---
	  Support for the MII0 inside the Lantiq SoC

config CNS3XXX_ETH
	tristate "Cavium CNS3xxx Ethernet support"
	depends on ARCH_CNS3XXX
	select PHYLIB
	help
	  Say Y here if you want to use built-in Ethernet ports
	  on CNS3XXX processor.

config AG7100
    tristate "Atheros AR7100 GigE"
    depends on MACH_AR7100
    help
        This enables the building of Atheros AR7100 gigE driver module.

choice
    prompt "port 0 interface"
    depends on (AG7100 || AG71XX) && !MACH_AR7240

config AG7100_GE0_MII
    bool "MII mode"

config AG7100_GE0_RMII
    bool "RMII mode"

config AG7100_GE0_RGMII
    bool "RGMII mode"

config AG7100_GE0_GMII
    bool "GMII mode"

endchoice

config  AG7100_GE1_IS_CONNECTED
    bool "port 1 is connected to a PHY"
    depends on (AG7100 || AG71XX)  && !MACH_AR7240

choice
    prompt "port 1 interface (depends on port0)"
    depends on AG7100_GE1_IS_CONNECTED
    
config AG7100_GE1_RMII
    bool "RMII mode"

config AG7100_GE1_RGMII
    bool "RGMII mode"

endchoice

config AG7240
    tristate "Atheros AR7240 GigE"
    depends on MACH_AR7240 || MACH_HORNET
    help
        This enables the building of Atheros AR7240 gigE driver module.

config AR7240_S26_VLAN_IGMP
    bool "Support vlan and igmp functions in AR7240-S26 switch"
    depends on AG7240

config ATHEROS_HEADER_EN
    bool "Add two bytes atheros header before the ethernet packet."
    depends on AG7240


config  AG7240_GE0_IS_CONNECTED
    bool "port 0 is connected to a PHY"
    depends on (AG7240 || AG71XX) && !MACH_AR7100

choice
    prompt "port 0 interface"
    depends on (AG7240 || AG71XX) && !MACH_AR7100

config AG7240_GE0_MII
    bool "MII mode"

config AG7240_GE0_GMII
    bool "GMII mode"

config AG7240_GE0_RGMII
    bool "RGMII mode"

endchoice

choice  
    prompt "PHY or switch used"
    depends on AG7240_GE0_IS_CONNECTED

config AR7242_RGMII_PHY
    bool "AR7242 RGMII Phy"

config AR7242_S16_PHY
    bool "AR7242 S16 Switch"

config WZRG450
    bool "WZRG450 Vlan Mapping"
    depends on AR7242_S16_PHY

config AR7242_VIR_PHY
    bool "AR7242 Vitual Switch"

config AR7242_RTL8309G_PHY
    bool "Realtek RTL8309G Switch"

endchoice

config  ATHRS_QOS
    bool "Enable MAC 0 QOS "
    depends on AG7240

config  AG7240_GE1_IS_CONNECTED
    bool "port 1 is connected to a PHY"
    depends on (AG7240 || AG71XX) && !MACH_AR7100

choice
    prompt "port 1 interface (depends on port0)"
    depends on AG7240_GE1_IS_CONNECTED
    
config AG7240_GE1_MII
    bool "MII mode"

endchoice

choice  
    prompt "PHY or switch used"
    depends on AG7240

config AR7240_S26_PHY
    bool "Atheros S26 Phy"
    depends on AG7240

config S26_SWITCH_ONLY_MODE
    bool "Enable switch only mode"
    depends on AR7240_S26_PHY

config AR8021_PHY
    bool "Atheros AR8021 Phy"

endchoice


choice  
    prompt "PHY or switch used"
    depends on (AG7100 || AG71XX) && !MACH_AR7240

config ATHR_PHY
    bool "Atheros F1 GigE Phy"

config ATHRS26_PHY
    bool "Atheros S26 Phy"

config ATHRS16_PHY
    bool "Atheros S16 Phy"

config PORT0_AS_SWITCH
    bool "Atheros S16 Phy"
    depends on ATHRS16_PHY

config ATHR_VITESSE_PHY
    bool "Vitesse GigE Phy 8201"

config PHY_LAYER
    bool "use linux phy layer"
    depends on PHYLIB

config CAMEO_REALTEK_PHY
    bool "Cameo Realtek Phy"

        
config VITESSE_8601_PHY
    bool "Vitesse Gige Phy 8601 on MAC0 and optionally on MAC1"
	
config VITESSE_8601_7395_PHY
    bool "Vitesse Gige Phy 8601 on MAC0 / VSC73XX Switch on MAC1"

config  ATHR_ICPLUS_PHY
    bool "IP Icplus Phy"

config ATHR_REALTEK_PHY
    bool "Rtl8201"

config ADM6996FC_PHY
    bool "AdmTek 6996FC"

endchoice

config BUFFALO
    bool "WHR G300NH support"
    depends on CAMEO_REALTEK_PHY

config TPLINK
    bool "TPLink Support"
    depends on BUFFALO

config DIR825
    bool "DIR825 Support"
    depends on CAMEO_REALTEK_PHY

config WNDR3700
    bool "WNDR3700 Support"
    depends on CAMEO_REALTEK_PHY

config WP543
    bool "WP543 Support"
    depends on MACH_AR7100



config  AG7240_LEN_PER_TX_DS 
        int "Len per tx descriptor" 
        default "1536" 
	depends on (REALTEK_PHY ||  ADM6996FC_PHY || ICPLUS_PHY) && AG7240

config  AG7240_LEN_PER_TX_DS 
        int "Len per tx descriptor" 
	default "512" 	
	depends on !(REALTEK_PHY ||  ADM6996FC_PHY || ICPLUS_PHY) && AG7240

config  AG7240_NUMBER_TX_PKTS
        int "Number tx pkts"   
        default "100"
        depends on AG7240

config  AG7240_NUMBER_RX_PKTS
        int "Number rx pkts"       
        default "252"
        depends on AG7240

config  AG7240_MAC_LOCATION 
    hex "Memory location of MAC addresses (in flash)" 
	default "0xbfff0000" 	
	help
	  This is the physical address in memory that contains
	  the MAC addresses for the board Ethernet interfaces.  They
	  are stored sequentially in 6 byte groups, for the total number
	  of interfaces supported on the board.
	depends on AG7240

config  AG7240_USE_TRC
	bool "Print realtime trace on asserts, this will negatively affect performance"
	default 0
	depends on AG7240



config  AG7100_LEN_PER_TX_DS 
        int "Len per tx descriptor" 
        default "1536" 
	depends on (REALTEK_PHY ||  ADM6996FC_PHY || ICPLUS_PHY) && AG7100

config  AG7100_LEN_PER_TX_DS 
        int "Len per tx descriptor" 
	default "512" 	
	depends on !(REALTEK_PHY ||  ADM6996FC_PHY || ICPLUS_PHY) && AG7100

config  AG7100_NUMBER_TX_PKTS
        int "Number tx pkts"   
        default "100"
        depends on AG7100

config  AG7100_NUMBER_RX_PKTS
        int "Number rx pkts"       
        default "252"
        depends on AG7100

config  AG7100_USE_TRC
	bool "Print realtime trace on asserts, this will negatively affect performance"
	default 0
	depends on AG7100

source "drivers/net/ethernet/ag71xx/Kconfig"

source "drivers/net/ethernet/marvell/Kconfig"
source "drivers/net/ethernet/mellanox/Kconfig"
source "drivers/net/ethernet/micrel/Kconfig"
source "drivers/net/ethernet/microchip/Kconfig"
source "drivers/net/ethernet/moxa/Kconfig"
source "drivers/net/ethernet/myricom/Kconfig"

config FEALNX
	tristate "Myson MTD-8xx PCI Ethernet support"
	depends on PCI
	select CRC32
	select MII
	---help---
	  Say Y here to support the Myson MTD-800 family of PCI-based Ethernet
	  cards. <http://www.myson.com.tw/>

source "drivers/net/ethernet/natsemi/Kconfig"
source "drivers/net/ethernet/8390/Kconfig"

config NET_NETX
	tristate "NetX Ethernet support"
	select MII
	depends on ARCH_NETX
	---help---
	  This is support for the Hilscher netX builtin Ethernet ports

	  To compile this driver as a module, choose M here. The module
	  will be called netx-eth.

source "drivers/net/ethernet/nuvoton/Kconfig"
source "drivers/net/ethernet/nvidia/Kconfig"
source "drivers/net/ethernet/nxp/Kconfig"
source "drivers/net/ethernet/octeon/Kconfig"
source "drivers/net/ethernet/oki-semi/Kconfig"

config ETHOC
	tristate "OpenCores 10/100 Mbps Ethernet MAC support"
	depends on HAS_IOMEM && HAS_DMA
	select MII
	select PHYLIB
	select CRC32
	select BITREVERSE
	---help---
	  Say Y here if you want to use the OpenCores 10/100 Mbps Ethernet MAC.

source "drivers/net/ethernet/packetengines/Kconfig"
source "drivers/net/ethernet/pasemi/Kconfig"
source "drivers/net/ethernet/qlogic/Kconfig"
source "drivers/net/ethernet/ralink/Kconfig"
source "drivers/net/ethernet/realtek/Kconfig"
source "drivers/net/ethernet/renesas/Kconfig"
source "drivers/net/ethernet/rdc/Kconfig"

config S6GMAC
	tristate "S6105 GMAC ethernet support"
	depends on XTENSA_VARIANT_S6000
	select PHYLIB
	---help---
	  This driver supports the on chip ethernet device on the
	  S6105 xtensa processor.

	  To compile this driver as a module, choose M here. The module
	  will be called s6gmac.

source "drivers/net/ethernet/seeq/Kconfig"
source "drivers/net/ethernet/silan/Kconfig"
source "drivers/net/ethernet/sis/Kconfig"
source "drivers/net/ethernet/sfc/Kconfig"
source "drivers/net/ethernet/sgi/Kconfig"
source "drivers/net/ethernet/smsc/Kconfig"
source "drivers/net/ethernet/stmicro/Kconfig"
source "drivers/net/ethernet/sun/Kconfig"
source "drivers/net/ethernet/tehuti/Kconfig"
source "drivers/net/ethernet/ti/Kconfig"
source "drivers/net/ethernet/tile/Kconfig"
source "drivers/net/ethernet/toshiba/Kconfig"
source "drivers/net/ethernet/tundra/Kconfig"
source "drivers/net/ethernet/via/Kconfig"
source "drivers/net/ethernet/wiznet/Kconfig"
source "drivers/net/ethernet/xilinx/Kconfig"
source "drivers/net/ethernet/xircom/Kconfig"

endif # ETHERNET
```

## src/linux/universal/linux-3.18/drivers/soc/qcom/Kconfig
```kconfig
#
# QCOM Soc drivers
#
config QCOM_GSBI
        tristate "QCOM General Serial Bus Interface"
        depends on ARCH_QCOM
        select MFD_SYSCON
        help
          Say y here to enable GSBI support.  The GSBI provides control
          functions for connecting the underlying serial UART, SPI, and I2C
          devices to the output pins.

config QCOM_SMEM
	tristate "Qualcomm Shared Memory Manager (SMEM)"
	depends on ARCH_QCOM
	help
	  Say y here to enable support for the Qualcomm Shared Memory Manager.
	  The driver provides an interface to items in a heap shared among all
	  processors in a Qualcomm platform.
```

## src/linux/universal/linux-3.19/drivers/mtd/ralink/Kconfig
```kconfig
menu "Ralink Non-volatile Device Drivers"
	depends on MTD!=n

config MTD_NAND_RALINK
	tristate "NAND Flash Support"
	select MTD_PARTITIONS
	depends on RALINK_RT3352
	help
	  support Ralink 3052 nand flash controller.

config MTD_SPI_RALINK
	tristate "SPI Flash Support"
	select MTD_PARTITIONS
	depends on RALINK_RT3352 || RALINK_RT3350 || RALINK_RT3052 || RALINK_RT5350
	help
	  supoort Ralink 3052 serial spi controller with SPI flash.

endmenu
```
