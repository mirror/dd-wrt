## src/linux/universal/linux-4.14/Documentation/devicetree/bindings/mfd/gsc.txt
```
Gateworks System Controller multi-function device

The GSC is a Multifunction I2C slave device with the following submodules:
- WDT
- GPIO
- Pushbutton controller
- HWMON

Required properties:
- compatible : Must be "gw,gsc_v1", "gw,gsc_v2", "gw,gsc_v3"
- reg: I2C address of the device
- interrupts: interrupt triggered by GSC_IRQ# signal
- interrupt-parent: Interrupt controller GSC is connected to
- #interrupt-cells: should be <1>, index of the interrupt within the
  controller, in accordance with the "one cell" variant of
  <devicetree/bindings/interrupt-controller/interrupt.txt>

Optional nodes:
* watchdog:
The GSC provides a Watchdog monitor which can power cycle the board's
primary power supply on most board models when tripped.

Required properties:
- compatible: must be "gw,gsc-watchdog"

* input:
The GSC provides an input device capable of dispatching Linux Input events
for user pushbutton events, tamper switch events, etc.

Required properties:
- compatible: must be "gw,gsc-input"

* hwmon:
The GSC provides a set of Analog to Digitcal Converter (ADC) pins used for
temperature and/or voltage monitoring.

Required properties:
- compatible: must be "gw,gsc-hwmon"

Example:

	gsc@20 {
		compatible = "gw,gsc_v3";
		reg = <0x20>;
		interrupt-parent = <&gpio1>;
		interrupts <4 2>;
		interrupt-controller;
		#interrupt-cells = <1>;

		watchdog {
			compatible = "gw,gsc-watchdog";
		};

		hwmon {
			compatible = "gw,gsc-hwmon";

			vin: adc1 {
				label = "vin";
				min-microvolt = <725000>;
				max-microvolt = <2075000>;
			}

			adc-channel@c {
				reg = <0x00 0x0c>;
			}

			hwmon@1 {
			};
		};
```

## src/linux/universal/linux-4.14/Documentation/devicetree/bindings/mtd/nand.txt
```
* NAND chip and NAND controller generic binding

NAND controller/NAND chip representation:

The NAND controller should be represented with its own DT node, and all
NAND chips attached to this controller should be defined as children nodes
of the NAND controller. This representation should be enforced even for
simple controllers supporting only one chip.

Mandatory NAND controller properties:
- #address-cells: depends on your controller. Should at least be 1 to
		  encode the CS line id.
- #size-cells: depends on your controller. Put zero unless you need a
	       mapping between CS lines and dedicated memory regions

Optional NAND controller properties
- ranges: only needed if you need to define a mapping between CS lines and
	  memory regions

Optional NAND chip properties:

- nand-ecc-mode : String, operation mode of the NAND ecc mode.
		  Supported values are: "none", "soft", "hw", "hw_syndrome",
		  "hw_oob_first", "on-die".
		  Deprecated values:
		  "soft_bch": use "soft" and nand-ecc-algo instead
- nand-ecc-algo: string, algorithm of NAND ECC.
		 Supported values are: "hamming", "bch".
- nand-bus-width : 8 or 16 bus width if not present 8
- nand-on-flash-bbt: boolean to enable on flash bbt option if not present false

- nand-ecc-strength: integer representing the number of bits to correct
		     per ECC step.

- nand-ecc-step-size: integer representing the number of data bytes
		      that are covered by a single ECC step.

- nand-ecc-maximize: boolean used to specify that you want to maximize ECC
		     strength. The maximum ECC strength is both controller and
		     chip dependent. The controller side has to select the ECC
		     config providing the best strength and taking the OOB area
		     size constraint into account.
		     This is particularly useful when only the in-band area is
		     used by the upper layers, and you want to make your NAND
		     as reliable as possible.

- linux,part-probe: list of name as strings of the partition parser
		    which should be used to parse the partition table.
		    They will be tried in the specified ordering and
		    the next one will be used if the previous one
		    failed.

		    Example: linux,part-probe = "cmdlinepart", "ofpart";

		    This is also the default value, which will be used
		    if this attribute is not specified. It could be
		    that the flash driver in use overwrote the default
		    value and uses some other default.

		    Possible values are: bcm47xxpart, afs, ar7part,
		    ofoldpart, ofpart, bcm63xxpart, RedBoot, cmdlinepart

The ECC strength and ECC step size properties define the correction capability
of a controller. Together, they say a controller can correct "{strength} bit
errors per {size} bytes".

The interpretation of these parameters is implementation-defined, so not all
implementations must support all possible combinations. However, implementations
are encouraged to further specify the value(s) they support.

Example:

	nand-controller {
		#address-cells = <1>;
		#size-cells = <0>;

		/* controller specific properties */

		nand@0 {
			reg = <0>;
			nand-ecc-mode = "soft";
			nand-ecc-algo = "bch";

			/* controller specific properties */
		};
	};
```

## src/linux/universal/linux-4.14/drivers/clk/qcom/Kconfig
```kconfig
config QCOM_GDSC
	bool
	select PM_GENERIC_DOMAINS if PM

config COMMON_CLK_QCOM
	tristate "Support for Qualcomm's clock controllers"
	depends on OF
	depends on ARCH_QCOM || COMPILE_TEST
	select REGMAP_MMIO
	select RESET_CONTROLLER

config APQ_GCC_8084
	tristate "APQ8084 Global Clock Controller"
	select QCOM_GDSC
	depends on COMMON_CLK_QCOM
	help
	  Support for the global clock controller on apq8084 devices.
	  Say Y if you want to use peripheral devices such as UART, SPI,
	  i2c, USB, SD/eMMC, SATA, PCIe, etc.

config APQ_MMCC_8084
	tristate "APQ8084 Multimedia Clock Controller"
	select APQ_GCC_8084
	select QCOM_GDSC
	depends on COMMON_CLK_QCOM
	help
	  Support for the multimedia clock controller on apq8084 devices.
	  Say Y if you want to support multimedia devices such as display,
	  graphics, video encode/decode, camera, etc.

config IPQ_GCC_4019
	tristate "IPQ4019 Global Clock Controller"
	depends on COMMON_CLK_QCOM
	help
	  Support for the global clock controller on ipq4019 devices.
	  Say Y if you want to use peripheral devices such as UART, SPI,
	  i2c, USB, SD/eMMC, etc.

config IPQ_ADCC_4019
	tristate "IPQ4019 Audio Clock Controller"
	depends on COMMON_CLK_QCOM
	help
	  Say Y if you need support for audio clock controller on IPQ4019 devices.
	  Audio clocks TXM, RXM, TXB and RXB depend on ADCC. ADCC also is used for
	  selecting the pad's as the source for the ADSS [audio subsystem] clocks.

config IPQ_GCC_806X
	tristate "IPQ806x Global Clock Controller"
	depends on COMMON_CLK_QCOM
	select MFD_QCOM_RPM
	select QCOM_RPM_CLK
	help
	  Support for the global clock controller on ipq806x devices.
	  Say Y if you want to use peripheral devices such as UART, SPI,
	  i2c, USB, SD/eMMC, etc.

config IPQ_LCC_806X
	tristate "IPQ806x LPASS Clock Controller"
	select IPQ_GCC_806X
	depends on COMMON_CLK_QCOM
	help
	  Support for the LPASS clock controller on ipq806x devices.
	  Say Y if you want to use audio devices such as i2s, pcm,
	  S/PDIF, etc.

config IPQ_ADSS_807x
	tristate "IPQ807x ADSS Clock Controller"
	select IPQ_GCC_807x
	depends on COMMON_CLK_QCOM
	help
	  Support for ADSS clock controller on ipq807x devices.
	  Say Y if you want to use ADSS clocks for Audio.

config IPQ_APSS_807x
	tristate "IPQ807x APSS Clock Controller"
	select IPQ_GCC_807x
	depends on COMMON_CLK_QCOM
	help
	  Support for APSS clock controller on ipq807x devices.
	  Say Y if you want to use APSS clocks such as CPU.

config IPQ_GCC_807x
	tristate "IPQ807x Global Clock Controller"
	depends on COMMON_CLK_QCOM
	help
	  Support for global clock controller on ipq807x devices.
	  Say Y if you want to use peripheral devices such as UART, SPI,
	  i2c, USB, SD/eMMC, etc. Select this for the root clock
	  of ipq807x.

config MSM_GCC_8660
	tristate "MSM8660 Global Clock Controller"
	depends on COMMON_CLK_QCOM
	help
	  Support for the global clock controller on msm8660 devices.
	  Say Y if you want to use peripheral devices such as UART, SPI,
	  i2c, USB, SD/eMMC, etc.

config MSM_GCC_8916
	tristate "MSM8916 Global Clock Controller"
	select QCOM_GDSC
	depends on COMMON_CLK_QCOM
	help
	  Support for the global clock controller on msm8916 devices.
	  Say Y if you want to use devices such as UART, SPI i2c, USB,
	  SD/eMMC, display, graphics, camera etc.

config MSM_GCC_8960
	tristate "APQ8064/MSM8960 Global Clock Controller"
	depends on COMMON_CLK_QCOM
	help
	  Support for the global clock controller on apq8064/msm8960 devices.
	  Say Y if you want to use peripheral devices such as UART, SPI,
	  i2c, USB, SD/eMMC, SATA, PCIe, etc.

config MSM_LCC_8960
	tristate "APQ8064/MSM8960 LPASS Clock Controller"
	select MSM_GCC_8960
	depends on COMMON_CLK_QCOM
	help
	  Support for the LPASS clock controller on apq8064/msm8960 devices.
	  Say Y if you want to use audio devices such as i2s, pcm,
	  SLIMBus, etc.

config MSM_MMCC_8960
	tristate "MSM8960 Multimedia Clock Controller"
	select MSM_GCC_8960
	depends on COMMON_CLK_QCOM
	help
	  Support for the multimedia clock controller on msm8960 devices.
	  Say Y if you want to support multimedia devices such as display,
	  graphics, video encode/decode, camera, etc.

config MSM_GCC_8974
	tristate "MSM8974 Global Clock Controller"
	select QCOM_GDSC
	depends on COMMON_CLK_QCOM
	help
	  Support for the global clock controller on msm8974 devices.
	  Say Y if you want to use peripheral devices such as UART, SPI,
	  i2c, USB, SD/eMMC, SATA, PCIe, etc.

config MSM_MMCC_8974
	tristate "MSM8974 Multimedia Clock Controller"
	select MSM_GCC_8974
	select QCOM_GDSC
	depends on COMMON_CLK_QCOM
	help
	  Support for the multimedia clock controller on msm8974 devices.
	  Say Y if you want to support multimedia devices such as display,
	  graphics, video encode/decode, camera, etc.

config QCOM_HFPLL
	tristate "High-Frequency PLL (HFPLL) Clock Controller"
	depends on COMMON_CLK_QCOM
	help
	  Support for the high-frequency PLLs present on Qualcomm devices.
	  Say Y if you want to support CPU frequency scaling on devices
	  such as MSM8974, APQ8084, etc.

config QCOM_RPM_CLK
	tristate "RPM Clock Controller"
	depends on COMMON_CLK_QCOM && MFD_QCOM_RPM
	help
	  If you say yes to this option, support will be included for the
	  clocks exposed by the Resource Power Manager (RPM) found in the
	  QCA based devices such as ipq806x.

config KPSS_XCC
	tristate "KPSS Clock Controller"
	depends on COMMON_CLK_QCOM
	help
	  Support for the Krait ACC and GCC clock controllers. Say Y
	  if you want to support CPU frequency scaling on devices such
	  as MSM8960, APQ8064, etc.

config KRAITCC
	tristate "Krait Clock Controller"
	depends on COMMON_CLK_QCOM && ARM
	select KRAIT_CLOCKS
	help
	  Support for the Krait CPU clocks on Qualcomm devices.
	  Say Y if you want to support CPU frequency scaling.

config KRAIT_CLOCKS
	bool
	select KRAIT_L2_ACCESSORS
```

## src/linux/universal/linux-4.14/lib/crypto/Kconfig
```kconfig
# SPDX-License-Identifier: GPL-2.0

menu "Crypto library routines"

config CRYPTO_LIB_UTILS
	tristate

config CRYPTO_LIB_AES
	tristate


config CRYPTO_LIB_POLY1305_RSIZE
	int
	default 2 if MIPS
	default 11 if X86_64
	default 9 if ARM || ARM64
	default 1

config CRYPTO_ARCH_HAVE_LIB_POLY1305
	tristate
	help
	  Declares whether the architecture provides an arch-specific
	  accelerated implementation of the Poly1305 library interface,
	  either builtin or as a module.

config CRYPTO_LIB_POLY1305_GENERIC
	tristate
	help
	  This symbol can be depended upon by arch implementations of the
	  Poly1305 library interface that require the generic code as a
	  fallback, e.g., for SIMD implementations. If no arch specific
	  implementation is enabled, this implementation serves the users
	  of CRYPTO_LIB_POLY1305.

config CRYPTO_LIB_POLY1305
	tristate "Poly1305 library interface"
	depends on CRYPTO_ARCH_HAVE_LIB_POLY1305 || !CRYPTO_ARCH_HAVE_LIB_POLY1305
	select CRYPTO_LIB_POLY1305_GENERIC
	help
	  Enable the Poly1305 library interface. This interface may be fulfilled
	  by either the generic implementation or an arch-specific one, if one
	  is available and enabled.

endmenu
```

## src/linux/universal/linux-4.4/arch/arm/mach-alpine/Kconfig
```kconfig
config ARCH_ALPINE
        bool "AnnapurnaLabs Alpine SOCs with Device Tree support"
        select ARCH_WANT_OPTIONAL_GPIOLIB
        select ARM_AMBA
		select SPARSE_IRQ
        select ARM_TIMER_SP804
        select CLKDEV_LOOKUP
        select GENERIC_CLOCKEVENTS
		select GENERIC_IRQ_CHIP
        select HAVE_CLK
        select HAVE_SMP 
        select HAVE_ARM_ARCH_TIMER
        select HAVE_SCHED_CLOCK
        select ARCH_SCHED_CLOCK
        select ICST
        select CPU_V7
        select ARM_GIC
        select HAVE_ARCH_TIMERS
        select COMMON_CLK
        select PCI
	select PCI_DOMAINS
        select ARCH_SUPPORTS_MSI
	select ARM_HWCC_FLAG
	select ARCH_LONG_LONG_ATOMIC
	select ARM_HAS_SG_CHAIN
	select ARCH_SUPPORTS_BIG_ENDIAN
        help
          This enables support for the AnnapurnaLabs SoC Gen1 boards.

menu "Annapurna Labs Alpine Soc Device Tree"
	depends on ARCH_ALPINE

config AL_PCIE_RMN_1010
	bool "Annapurna Labs PCIe RMN 1010 fix"
	depends on AL_DMA
	help
		Use the DMA engine to access pcie memory instead of the CPU.

endmenu
```

## src/linux/universal/linux-4.4/arch/arm/mach-qcom/Kconfig
```kconfig
menuconfig ARCH_QCOM
	bool "Qualcomm Support" if ARCH_MULTI_V7
	select ARCH_SUPPORTS_BIG_ENDIAN
	select ARM_GIC
	select ARM_AMBA
	select PINCTRL
	select QCOM_SCM if SMP
	select PCI_DOMAINS if PCI
	help
	  Support for Qualcomm's devicetree based systems.

config MSM_PCIE
	bool "MSM PCIe Controller driver"
	depends on PCI && PCI_MSI
	select PCI_DOMAINS
	help
	  Enables the PCIe functionality by configures PCIe core on
	  MSM chipset and by enabling the ARM PCI framework extension.

if ARCH_QCOM

config ARCH_MSM8X60
	bool "Enable support for MSM8X60"
	select CLKSRC_QCOM

config ARCH_MSM8960
	bool "Enable support for MSM8960"
	select CLKSRC_QCOM

config ARCH_MSM8974
	bool "Enable support for MSM8974"
	select HAVE_ARM_ARCH_TIMER

endif
```

## src/linux/universal/linux-4.4/arch/mips/brcm-boards/Kconfig
```kconfig
menu "Support for Broadcom MIPS based boards"

config BCM947XX
        bool "Support for Broadcom BCM947XX"
        depends on MIPS_BRCM
#	select CPU_MIPSR2_IRQ_VI
	default y

config BCM47XX
        bool "Support for Broadcom BCM47XX processors"
        depends on BCM947XX

config BCM80211AC
	bool "802.11AC wireless driver support"
	depends on BCM47XX

config NVRAM_60K
	bool "Nvram size 60k"
	depends on BCM947XX && !BCM80211AC
	
config NVRAM_64K
	bool "Nvram size 64k"
	depends on BCM947XX && !BCM80211AC


config BCMIPDSCP
        bool "Support for Using DSCP based IP forwarding"
        depends on BCM947XX

config HND_BMIPS3300_PROF
        bool "Support for performance profiling"
        depends on BCM947XX

config RAM_SIZE
        int "Memory size (in megabytes)"
        depends on BCM947XX

config SHRINKMEM
        bool "Support for shrink memory"
        depends on BCM947XX
        select PM

config GENERIC_GPIO
        bool "Generic GPIO"
        default n

config CROSS_COMPILE
	default "mipsel-uclibc-linux26-"

endmenu
```

## src/linux/universal/linux-4.4/arch/mips/crypto/Kconfig
```kconfig
# SPDX-License-Identifier: GPL-2.0

menu "Accelerated Cryptographic Algorithms for CPU (mips)"

config CRYPTO_POLY1305_MIPS
	tristate "Hash functions: Poly1305"
	depends on MIPS
	select CRYPTO_ARCH_HAVE_LIB_POLY1305
	select CRYPTO_LIB_POLY1305
	help
	  Poly1305 authenticator algorithm (RFC7539)

	  Architecture: mips

config CRYPTO_CHACHA20_MIPS
	tristate "Ciphers: ChaCha20 (MIPS32r2)"
	depends on CPU_MIPS32_R2 
	help
	  Length-preserving cipher: ChaCha20
	  stream cipher algorithms

	  Architecture: MIPS32r2

endmenu
```
