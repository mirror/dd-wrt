## src/linux/universal/linux-4.4/drivers/mtd/devices/Kconfig
```kconfig
menu "Self-contained MTD device drivers"
	depends on MTD!=n
	depends on HAS_IOMEM

config MTD_PMC551
	tristate "Ramix PMC551 PCI Mezzanine RAM card support"
	depends on PCI
	---help---
	  This provides a MTD device driver for the Ramix PMC551 RAM PCI card
	  from Ramix Inc. <http://www.ramix.com/products/memory/pmc551.html>.
	  These devices come in memory configurations from 32M - 1G.  If you
	  have one, you probably want to enable this.

	  If this driver is compiled as a module you get the ability to select
	  the size of the aperture window pointing into the devices memory.
	  What this means is that if you have a 1G card, normally the kernel
	  will use a 1G memory map as its view of the device.  As a module,
	  you can select a 1M window into the memory and the driver will
	  "slide" the window around the PMC551's memory.  This was
	  particularly useful on the 2.2 kernels on PPC architectures as there
	  was limited kernel space to deal with.

config MTD_PMC551_BUGFIX
	bool "PMC551 256M DRAM Bugfix"
	depends on MTD_PMC551
	help
	  Some of Ramix's PMC551 boards with 256M configurations have invalid
	  column and row mux values.  This option will fix them, but will
	  break other memory configurations.  If unsure say N.

config MTD_PMC551_DEBUG
	bool "PMC551 Debugging"
	depends on MTD_PMC551
	help
	  This option makes the PMC551 more verbose during its operation and
	  is only really useful if you are developing on this driver or
	  suspect a possible hardware or driver bug.  If unsure say N.

config MTD_MS02NV
	tristate "DEC MS02-NV NVRAM module support"
	depends on MACH_DECSTATION
	help
	  This is an MTD driver for the DEC's MS02-NV (54-20948-01) battery
	  backed-up NVRAM module.  The module was originally meant as an NFS
	  accelerator.  Say Y here if you have a DECstation 5000/2x0 or a
	  DECsystem 5900 equipped with such a module.

	  If you want to compile this driver as a module ( = code which can be
	  inserted in and removed from the running kernel whenever you want),
	  say M here and read <file:Documentation/kbuild/modules.txt>.
	  The module will be called ms02-nv.

config MTD_DATAFLASH
	tristate "Support for AT45xxx DataFlash"
	depends on SPI_MASTER
	help
	  This enables access to AT45xxx DataFlash chips, using SPI.
	  Sometimes DataFlash chips are packaged inside MMC-format
	  cards; at this writing, the MMC stack won't handle those.

config MTD_DATAFLASH_WRITE_VERIFY
	bool "Verify DataFlash page writes"
	depends on MTD_DATAFLASH
	help
	  This adds an extra check when data is written to the flash.
	  It may help if you are verifying chip setup (timings etc) on
	  your board.  There is a rare possibility that even though the
	  device thinks the write was successful, a bit could have been
	  flipped accidentally due to device wear or something else.

config MTD_DATAFLASH_OTP
	bool "DataFlash OTP support (Security Register)"
	depends on MTD_DATAFLASH
	help
	  Newer DataFlash chips (revisions C and D) support 128 bytes of
	  one-time-programmable (OTP) data.  The first half may be written
	  (once) with up to 64 bytes of data, such as a serial number or
	  other key product data.  The second half is programmed with a
	  unique-to-each-chip bit pattern at the factory.

config MTD_M25P80
	tristate "Support most SPI Flash chips (AT26DF, M25P, W25X, ...)"
	depends on SPI_MASTER && MTD_SPI_NOR
	help
	  This enables access to most modern SPI flash chips, used for
	  program and data storage.   Series supported include Atmel AT26DF,
	  Spansion S25SL, SST 25VF, ST M25P, and Winbond W25X.  Other chips
	  are supported as well.  See the driver source for the current list,
	  or to add other chips.

	  Note that the original DataFlash chips (AT45 series, not AT26DF),
	  need an entirely different driver.

	  Set up your spi devices with the right board-specific platform data,
	  if you want to specify device partitioning or to use a device which
	  doesn't support the JEDEC ID instruction.

config MTD_SPEAR_SMI
	tristate "SPEAR MTD NOR Support through SMI controller"
	depends on PLAT_SPEAR
	default y
	help
	  This enable SNOR support on SPEAR platforms using SMI controller

config MTD_SST25L
	tristate "Support SST25L (non JEDEC) SPI Flash chips"
	depends on SPI_MASTER
	help
	  This enables access to the non JEDEC SST25L SPI flash chips, used
	  for program and data storage.

	  Set up your spi devices with the right board-specific platform data,
	  if you want to specify device partitioning.

config MTD_BCM47XXSFLASH
	tristate "R/O support for serial flash on BCMA bus"
	depends on BCMA_SFLASH
	help
	  BCMA bus can have various flash memories attached, they are
	  registered by bcma as platform devices. This enables driver for
	  serial flash memories (only read-only mode is implemented).

config MTD_SLRAM
	tristate "Uncached system RAM"
	help
	  If your CPU cannot cache all of the physical memory in your machine,
	  you can still use it for storage or swap by using this driver to
	  present it to the system as a Memory Technology Device.

config MTD_PHRAM
	tristate "Physical system RAM"
	help
	  This is a re-implementation of the slram driver above.

	  Use this driver to access physical memory that the kernel proper
	  doesn't have access to, memory beyond the mem=xxx limit, nvram,
	  memory on the video card, etc...

config MTD_LART
	tristate "28F160xx flash driver for LART"
	depends on SA1100_LART
	help
	  This enables the flash driver for LART. Please note that you do
	  not need any mapping/chip driver for LART. This one does it all
	  for you, so go disable all of those if you enabled some of them (:

config MTD_MTDRAM
	tristate "Test driver using RAM"
	help
	  This enables a test MTD device driver which uses vmalloc() to
	  provide storage.  You probably want to say 'N' unless you're
	  testing stuff.

config MTDRAM_TOTAL_SIZE
	int "MTDRAM device size in KiB"
	depends on MTD_MTDRAM
	default "4096"
	help
	  This allows you to configure the total size of the MTD device
	  emulated by the MTDRAM driver.  If the MTDRAM driver is built
	  as a module, it is also possible to specify this as a parameter when
	  loading the module.

config MTDRAM_ERASE_SIZE
	int "MTDRAM erase block size in KiB"
	depends on MTD_MTDRAM
	default "128"
	help
	  This allows you to configure the size of the erase blocks in the
	  device emulated by the MTDRAM driver.  If the MTDRAM driver is built
	  as a module, it is also possible to specify this as a parameter when
	  loading the module.

#If not a module (I don't want to test it as a module)
config MTDRAM_ABS_POS
	hex "SRAM Hexadecimal Absolute position or 0"
	depends on MTD_MTDRAM=y
	default "0"
	help
	  If you have system RAM accessible by the CPU but not used by Linux
	  in normal operation, you can give the physical address at which the
	  available RAM starts, and the MTDRAM driver will use it instead of
	  allocating space from Linux's available memory. Otherwise, leave
	  this set to zero. Most people will want to leave this as zero.

config MTD_BLOCK2MTD
	tristate "MTD using block device"
	depends on BLOCK
	help
	  This driver allows a block device to appear as an MTD. It would
	  generally be used in the following cases:

	  Using Compact Flash as an MTD, these usually present themselves to
	  the system as an ATA drive.
	  Testing MTD users (eg JFFS2) on large media and media that might
	  be removed during a write (using the floppy drive).

config MTD_POWERNV_FLASH
	tristate "powernv flash MTD driver"
	depends on PPC_POWERNV
	help
	  This provides an MTD device to access flash on powernv OPAL
	  platforms from Linux. This device abstracts away the
	  firmware interface for flash access.

comment "Disk-On-Chip Device Drivers"

config MTD_DOCG3
	tristate "M-Systems Disk-On-Chip G3"
	select BCH
	select BCH_CONST_PARAMS
	select BITREVERSE
	---help---
	  This provides an MTD device driver for the M-Systems DiskOnChip
	  G3 devices.

	  The driver provides access to G3 DiskOnChip, distributed by
	  M-Systems and now Sandisk. The support is very experimental,
	  and doesn't give access to any write operations.

config MTD_ST_SPI_FSM
	tristate "ST Microelectronics SPI FSM Serial Flash Controller"
	depends on ARCH_STI
	help
	  This provides an MTD device driver for the ST Microelectronics
	  SPI Fast Sequence Mode (FSM) Serial Flash Controller and support
	  for a subset of connected Serial Flash devices.

if MTD_DOCG3
config BCH_CONST_M
	default 14
config BCH_CONST_T
	default 4
endif

config COMFAST_WATCHDOG
	bool

config MTD_SPIFLASH
	tristate "Atheros AR2315/6/7 SPI Flash support"
	depends on MTD && ATHEROS
	
config MTD_SPIFLASH_SELFMAP
	tristate "Atheros AR2315/6/7 SPI Flash support (dd-wrt selfmap)"
	depends on MTD && ATHEROS

config MTD_SPIFLASH_PP
	bool	"Page Programming mode support"
	depends on MTD && ATHEROS
	
config MTD_SPIFLASH_PP_GPIO
	depends on MTD_SPIFLASH_PP
	int	"Chip Select GPIO for Page Programming mode support"
	default "0"


config MTD_AR7100_SPI_FLASH
	bool "Support for ar7100 spi flash"
	depends on MTD && MACH_AR7100
config MTD_FLASH_16MB
	bool "Support for 16MB Flash"
	depends on MTD_AR7100_SPI_FLASH || MTD_AR7240_SPI_FLASH
config MTD_PB44
	bool "Support for PB44 Flash"
	depends on MTD_AR7100_SPI_FLASH
config MTD_FLASH_8MB
	bool "Support for 8MB Flash"
	depends on MTD_AR7100_SPI_FLASH || MTD_AR7240_SPI_FLASH
config MTD_AR9100_PARALLEL_FLASH
        bool "Support for ar9100 parallel flash"
        depends on MTD && AR9100
config WZR_HP_G300NH 
	bool "support for buffalo WZR G300NH"
	depends on MTD_AR9100_PARALLEL_FLASH
config WZRAG300NH 
	bool "support for buffalo WZR HP AG G300NH"
	depends on MACH_AR7100
config UBNTFIX
	bool "ubnt flash unblock support"
	depends on MACH_AR7240 
config DIR825C1
	bool "support for DIR825C1"
	depends on MACH_AR7240 
config MMS344
	bool "support for MMS344"
	depends on DIR825C1
config WILLY
	bool "support for WILLY"
	depends on DIR825C1
config JWAP606
	bool "support for JWAP606"
	depends on DIR825C1
config DIR862
	bool "support for DIR862"
	depends on DIR825C1
config DIR859
	bool "support for DIR859"
	depends on DIR825C1
config WR650AC
	bool "support for WR650AC"
	depends on DIR859
	select COMFAST_WATCHDOG
config WR615N
	bool "support for WR615N"
	depends on DIR859
	select COMFAST_WATCHDOG
config E355AC
	bool "support for E355AC"
	depends on DIR859
	select COMFAST_WATCHDOG
config E380AC
	bool "support for E380AC"
	depends on DIR859
	select COMFAST_WATCHDOG
config XD3200
	bool "support for XD3200"
	depends on DIR859
config E325N
	bool "support for E325N"
	depends on DIR859
	select COMFAST_WATCHDOG
config AP120C
	bool "support for AP120C"
	depends on DIR825C1
config WDR4300
	bool "support for WDR4300"
	depends on DIR825C1
config WDR3500
	bool "support for WDR3500/3500"
	depends on WDR4300
config AP135
	bool "support for AP135/WHR450HP"
	depends on DIR825C1
config UBNTXW
	bool "support for UBNT XW devices"
	depends on DIR825C1
config XWLOCO
	bool "loco phy support"
	depends on UBNTXW
config XWM400
	bool "nanobridge xw M400"
	depends on UBNTXW
config UAPAC
	bool "support for UBNT UAP AC"
	depends on UBNTXW
config DAP3310
	bool "support for Dlink DAP3310"
	depends on UBNTXW
config WR710
	bool "support for TPLink WR710"
	depends on MACH_HORNET && WR741
config GL150
	bool "support for AR-GL-150"
	depends on MACH_HORNET && WR710
config ERC
	bool "support for ERC Device"
	depends on MACH_HORNET && !WR741
config WR841V9
	bool "support for TPLink WR841V9"
	depends on WR841V8
config LIMA
	bool "support for 8devices Lima"
	depends on WR841V8
config RAMBUTAN
	bool "support for 8devices Rambutan"
	depends on WR841V8
config WR810N
	bool "support for TPLink WR810N"
	depends on WASP_SUPPORT
config WR941V6
	bool "support for TPLink WR941V6"
	depends on WR841V9
config WR1043V2
	bool "support for WR1043 V2"
	depends on AP135
config ARCHERC7
	bool "support for ARCHER C7"
	depends on WR1043V2
config ARCHERC7V4
	bool "support for ARCHER C7 V4"
	depends on WR1043V2
config DAP3662
	bool "support for DAP3662"
	depends on WR1043V2
config DAP2330
	bool "support for DAP2330"
	depends on WR1043V2
config DAP2230
	bool "support for DAP2230"
	depends on WR841V8
config WDR2543
	bool "support for WDR2543"
	depends on MACH_AR7240
config WZRG450NH 
	bool "support for buffalo WZR HP G450NH"
	depends on MACH_AR7240 
config WZRG300NH2
	bool "support for buffalo WZR HP G300NH2"
	depends on WZRG450NH
config MTD_AR7240_SPI_FLASH
	bool "Support for ar7240 spi flash"
	depends on MTD && (MACH_AR7240 || MACH_HORNET)

endmenu
```

## src/linux/universal/linux-4.4/drivers/net/wireless/rt3352/rt2860v2_sta/Kconfig
```kconfig
config RT2860V2_STA
	tristate "Ralink RT2860 802.11n STA support"
	depends on WLAN || WLAN_80211

config  RT2860V2_STA_WPA_SUPPLICANT
	bool "WPA Supplicant"
	depends on RT2860V2_STA

#config  RT2860V2_STA_WMM_ACM
#	bool "WMM ACM Support"
#	depends on RT2860V2_STA

config  RT2860V2_STA_LED
	bool "LED Support"
	depends on RT2860V2_STA

#config  RT2860V2_STA_IDS
#        bool "IDS (Intrusion Detection System) Support"
#        depends on RT2860V2_STA

config  RT2860V2_STA_WSC
	bool "WSC (WiFi Simple Config)"
	depends on RT2860V2_STA

config  RT2860V2_STA_WSC_V2
	bool "WSC 2.0(WiFi Simple Config 2.0)"
	depends on RT2860V2_STA_WSC

#config  RT2860V2_STA_CARRIER
#	bool "Carrier Sense Support"
#	depends on RT2860V2_STA
#	select RALINK_TIMER_DFS

config  RT2860V2_STA_DLS
	bool "DLS ((Direct-Link Setup) Support"
	depends on RT2860V2_STA

#config  RT2860V2_RT3XXX_STA_ANTENNA_DIVERSITY
#	bool "Antenna Diversity Support"
#	depends on RT2860V2_STA

#config  RT2860V2_STA_WAPI
#        bool "WAPI Support"
#        depends on RT2860V2_STA

config  RT2860V2_STA_VIDEO_TURBINE
	bool "Video Turbine support"
	depends on RT2860V2_STA

config  RT2860V2_STA_RTMP_INTERNAL_TX_ALC
        bool "TSSI Compensation"
        depends on RT2860V2_STA
        depends on RALINK_RT3350 || RALINK_RT3352 || RALINK_RT5350

#config  RT2860V2_STA_80211N_DRAFT3
#        bool "802.11n Draft3"
#        depends on RT2860V2_STA

#config  RT2860V2_EXT_CHANNEL_LIST
#        bool "Extension Channel List"
#        depends on RT2860V2_STA

#config  RT2860V2_SNMP
#	bool "Net-SNMP Support"
#	depends on RT2860V2_STA

#config  RT2860V2_STA_P2P
#        bool "Wireless Direct(P2P)"
#        depends on RT2860V2_STA
```
