## src/linux/universal/linux-3.2/arch/mips/ralink/Kconfig
```kconfig
if MIPS_RALINK

choice
	prompt "Ralink SoC selection"
	default SOC_RT288X
	help
	  Select Ralink MIPS SoC type.

	config RALINK_RT288X
		bool "RT288x"
		select SOC_RT288X

	config RALINK_RT305X
		bool "RT305x"
		select SOC_RT305X

endchoice

source "arch/mips/ralink/rt305x/Kconfig"

config SOC_RT288X
	bool
	select CEVT_R4K
	select CSRC_R4K
	select DMA_NONCOHERENT
	select IRQ_CPU
	select ARCH_REQUIRE_GPIOLIB
	select SYS_HAS_CPU_MIPS32_R1
	select SYS_HAS_CPU_MIPS32_R2
	select SYS_SUPPORTS_32BIT_KERNEL
	select SYS_SUPPORTS_LITTLE_ENDIAN
	select SYS_HAS_EARLY_PRINTK
	select RALINK_DEVICE
	select RALINK_RT2880
	select HW_HAS_PCI

config SOC_RT305X
	bool
	select CEVT_R4K
	select CSRC_R4K
	select RALINK_RT3052_MP2 if !RALINK_RT3350
	select DMA_NONCOHERENT
	select IRQ_CPU
	select ARCH_REQUIRE_GPIOLIB
	select SYS_HAS_CPU_MIPS32_R1
	select SYS_HAS_CPU_MIPS32_R2
	select SYS_SUPPORTS_32BIT_KERNEL
	select SYS_SUPPORTS_LITTLE_ENDIAN
	select SYS_HAS_EARLY_PRINTK
	select RALINK_DEVICE
	select RALINK_RT3052
	select USB_ARCH_HAS_HCD

config RALINK_DEV_GPIO_BUTTONS
	def_bool n

config RALINK_DEV_GPIO_LEDS
	def_bool n

endif
```

## src/linux/universal/linux-3.2/arch/mips/rt2880/Kconfig
```kconfig
if RALINK_RT2880

choice
        prompt "Soc Hardware Type"
	default RT2880_ASIC

config  RT2880_ASIC 
        bool "RT2880-ASIC"
endchoice

endif
#-----------------------------

if RALINK_RT3052

choice
        prompt "Soc Hardware Type"
	default RT3052_ASIC

config  RT3052_ASIC 
        bool "RT305x/RT3350-ASIC"
endchoice

config RALINK_RT3350
	bool "Ralink RT3350 chipset"

endif


config  RT2860V2_2850
        bool "Dual Band"
        depends on RALINK_RT2880

choice
        prompt "RF Type"
        depends on RALINK_RT5350 
        default RALINK_RT5350_1T1R

        config  RALINK_RT5350_1T1R
        bool "1T1R"
endchoice

choice
        prompt "RF Type"
        depends on RALINK_RT3052
        default RALINK_RT3052_2T2R

        config  RALINK_RT3050_1T1R
        bool "1T1R"

        config  RALINK_RT3051_1T2R
        bool "1T2R"

        config  RALINK_RT3052_2T2R
        bool "2T2R"
endchoice

choice
        prompt "RF Type"
        depends on  RALINK_RT3352 

        config  RALINK_RT3352_2T2R
        bool "2T2R"
endchoice

choice
	prompt "RF Type"
	depends on RALINK_RT3883

	config  RALINK_RT3662_2T2R
	bool "2T3R (RT3662)"

	config  RALINK_RT3883_3T3R
	bool "3T3R (RT3883)"
endchoice

if RALINK_RT3352

choice
        prompt "Soc Hardware Type"
	default RT3352_ASIC

config  RT3352_ASIC 
	bool "RT3352-ASIC"
	select USB_ARCH_HAS_OHCI
	select USB_ARCH_HAS_EHCI

endchoice

endif

#--------------------------

if RALINK_RT3883

choice
        prompt "Soc Hardware Type"
	default RT3883_ASIC

config  RT3883_ASIC 
	bool "RT3883/RT3662-ASIC"
	select USB_ARCH_HAS_OHCI
	select USB_ARCH_HAS_EHCI
endchoice

choice
        prompt "RT3883 PCI architecture"
	default PCIE_PCI_CONCURRENT

config PCIE_PCI_CONCURRENT
        bool "PCIE RC and PCI HOST CONCURRENT"
config PCIE_ONLY
        bool "PCIE RC ONLY"
config PCI_ONLY
        bool "PCI HOST ONLY"
config PCIE_PCI_NONE
        bool "Non-support PCI/PCIe"
endchoice

endif

#---------------------------

if RALINK_RT5350

choice
	prompt "Soc Hardware Type"
	default RT5350_ASIC

config	RT5350_ASIC 
	bool "RT5350-ASIC"
	select USB_ARCH_HAS_OHCI
	select USB_ARCH_HAS_EHCI

endchoice

endif

#--------------------------

config FLASH_REMAP_NEED
       bool
       default y if (RALINK_RT2880)
choice
       prompt "DRAM Size"
       default RT2880_DRAM_16M

config RT2880_DRAM_8M
       bool "8M"

config RT2880_DRAM_16M
       bool "16M"

config RT2880_DRAM_32M
       bool "32M"

config RT2880_DRAM_64M
       bool "64M"

endchoice

choice
       prompt "Flash Size"
       default RT2880_FLASH_4M
       depends on  FLASH_REMAP_NEED

config RT2880_FLASH_2M
       bool "2M"

config RT2880_FLASH_4M
       bool "4M"

config RT2880_FLASH_8M
       bool "8M"

config RT2880_FLASH_16M
       bool "16M"

endchoice

config  RT2880_FLASH_32M
        bool "Flash Size 32MB Support"
	depends on (RALINK_RT3052_MP2 || RALINK_RT3350) && !MTD_SPI_RALINK
	select MTD_CONCAT if RT2880_FLASH_32M

config  RALINK_RAM_SIZE
	int 
	default 8 if RT2880_DRAM_8M
	default 16 if RT2880_DRAM_16M
	default 32 if RT2880_DRAM_32M
	default 64 if RT2880_DRAM_64M

config MTD_PHYSMAP_START
       hex 'Physmap start'
       default 0xBF000000 if !FLASH_REMAP_NEED && RALINK_RT3052

config MTD_PHYSMAP_LEN
       hex 
       default 0x200000 if RT2880_FLASH_2M
       default 0x400000 if RT2880_FLASH_4M
       default 0x800000 if RT2880_FLASH_8M
       default 0x1000000 if RT2880_FLASH_16M
       default 0x2000000 if RT2880_FLASH_32M
       default 0x1000000 if !FLASH_REMAP_NEED

config MTD_PHYSMAP_BUSWIDTH
       int 
       default 2

choice
	prompt "Root File System Type"
	default RT2880_ROOTFS_IN_RAM

config  RT2880_ROOTFS_IN_RAM
        bool "RootFS_in_RAM"
	select BLK_DEV_INITRD 
	select BLK_DEV_RAM 

config  RT2880_ROOTFS_IN_FLASH
        bool "RootFS_in_FLASH"
endchoice

config BLK_DEV_RAM_SIZE
	int 'Default RAM disk size'
	default 8192
	depends on RT2880_ROOTFS_IN_RAM

config	INITRAMFS_LZMA
	bool "Compress ramdisk by lzma instead of gzip"
	depends on RT2880_ROOTFS_IN_RAM

config MTD_KERNEL_PART_SIZ
	hex 'MTD Kernel Partition Size (Unit:Bytes)'
	default 0xD0000
	depends on RT2880_ROOTFS_IN_FLASH

config  RALINK_TIMER
	tristate 'Ralink WatchDog' 

config  RALINK_TIMER_WDG
        bool "Ralink WatchDog Timer"
        depends on RALINK_TIMER

config  RALINK_TIMER_WDG_RESET_OUTPUT
        bool "Ralink WatchDog Reset Output"
        depends on RALINK_TIMER_WDG

config  EAP9550
	bool "EAP 9550 watchdog workaround"
	depends on RALINK_RT3052

config  RALINK_WDG_TIMER
        int "WatchDog Timer (Unit:1Sec, Max=30Sec)"
        default 10
        depends on RALINK_TIMER_WDG

config  RALINK_WDG_REFRESH_INTERVAL
        int "WatchDog Refresh Interval (Unit:1Sec, Max=30Sec)"
        default 4
        depends on RALINK_TIMER_WDG

config  RALINK_TIMER_DFS
        bool "Ralink DFS Timer"
        depends on RALINK_TIMER


config RT3XXX_EHCI_OHCI
	bool "Ralink USB EHCI/OHCI controller support"
        depends on (RALINK_RT3883 || RALINK_RT3352)
	select USB_ARCH_HAS_OHCI
	select USB_ARCH_HAS_EHCI

#config RALINK_EXTERNAL_TIMER
#	bool "Ralink External Timer"
#	depends on RALINK_RT3352 || RALINK_RT5350

config TIXI
	bool "Tixi Board support"
	depends on RALINK_RT3352
```

## src/linux/universal/linux-3.3/drivers/net/ethernet/raeth/Kconfig
```kconfig
config RAETH
        tristate "Ralink GMAC"
        depends on RALINK_DEVICE
        ---help---
          This driver supports Ralink gigabit ethernet family of
          adapters.


config RAETH_NAPI
        bool "Use Rx Polling (NAPI)"
        depends on RAETH

choice
	prompt "Network BottomHalves"	
	depends on RAETH
	default RA_NETWORK_TASKLET_BH

	config RA_NETWORK_TASKLET_BH
	bool "Tasklet"

	config RA_NETWORK_WORKQUEUE_BH
	bool "Work Queue"

endchoice

config RAETH_SPECIAL_TAG
        bool "Ralink Special Tag (0x810x)"
        depends on RALINK_RT3052 || RALINK_RT3352 || RALINK_RT5350

config RAETH_JUMBOFRAME
        bool "Jumbo Frame up to 4K bytes"
        depends on RAETH && !(RALINK_RT3052 || RALINK_RT3352 || RALINK_RT5350)

config RAETH_QOS
        bool "QoS Feature"
        depends on RAETH && !RALINK_RT2880

config RAETH_GMAC2
        bool "GMAC2 Support"
        depends on RAETH && RALINK_RT2883


config  RAETH_ROUTER
        bool "IC+"
        depends on !RALINK_RT3052

config  RAETH_ICPLUS_PHY
        bool "ICPLUS 100PHY"
        depends on !RALINK_RT3052

config  RTL8366_SWITCH
        bool "RTL8366 Switch"
        depends on !RALINK_RT3052

config  RTL8366RB_SWITCH
        bool "RTL8366RB Switch"
        depends on RALINK_RT3052

config  AR690W
        bool "RTL config for AR690W"
        depends on RTL8366_SWITCH

config  RT15N
        bool "RTL config for Asus RT-15N"
        depends on RTL8366_SWITCH


config RAETH_CHECKSUM_OFFLOAD
        bool "TCP/UDP/IP checksum offload"
	default y
        depends on RAETH && !RALINK_RT2880

#config RAETH_QOS
#        bool "QoS Feature"
#        depends on RAETH && (RALINK_RT3052 || RALINK_RT3352 || RALINK_RT5350)

choice
        prompt "QoS Type"
        depends on RAETH_QOS
        default DSCP_QOS_DSCP

config  RAETH_QOS_DSCP_BASED
        bool "DSCP-based"
        depends on RAETH_QOS 

config  RAETH_QOS_PORT_BASED
        bool "Port-based"
        depends on RAETH_QOS

endchoice

choice
        prompt "GMAC is connected to"
        depends on RAETH
        default GE1_RGMII_FORCE_1000

config  GE1_MII_FORCE_100
        bool "MII_FORCE_100 (10/100M Switch)"
        depends on !RALINK_RT3052 && !RALINK_RT3352 && !RALINK_RT5350

config  GE1_MII_AN
        bool "MII_AN (100Phy)"
        depends on !RALINK_RT3052 && !RALINK_RT3352 && !RALINK_RT5350

config  GE1_RVMII_FORCE_100
        bool "RvMII_FORCE_100 (CPU)"
        depends on !RALINK_RT3052 && !RALINK_RT3352 && !RALINK_RT5350

config  GE1_RGMII_FORCE_1000
        bool "RGMII_FORCE_1000 (GigaSW, CPU)"
        depends on !RALINK_RT3052 && !RALINK_RT3352 && !RALINK_RT5350
	select RALINK_SPI

config  GE1_RGMII_AN
        bool "RGMII_AN (GigaPhy)"
        depends on !RALINK_RT3052 && !RALINK_RT3352 && !RALINK_RT5350

config  RT_3052_ESW
        bool "Ralink Embedded Switch(10/100Mbps)"
        depends on RALINK_RT3052 || RALINK_RT3352 || RALINK_RT5350


endchoice


config	RALINK_VISTA_BASIC
	bool 'Vista Basic Logo for IC+ 175C'
        depends on LAN_WAN_SUPPORT && !RALINK_RT3052 && !RALINK_RT3352 && !RALINK_RT5350

config	ESW_DOUBLE_VLAN_TAG
	bool
	default y if RT_3052_ESW

config RAETH_HAS_PORT5
        bool "Port 5 Support"
        depends on RAETH && (RALINK_RT3052 || RALINK_RT3352)
choice
        prompt "Target Mode"
        depends on RAETH_HAS_PORT5
	default P5_RGMII_TO_MAC_MODE

	config P5_MAC_TO_PHY_MODE
		bool "Giga_Phy (RGMII)"
	config P5_RGMII_TO_MAC_MODE
		bool "Giga_SW/iNIC (RGMII)"
	config P5_MII_TO_MAC_MODE
		bool "External_CPU (MII_RvMII)"
	config P5_RMII_TO_MAC_MODE
		bool "External_CPU (RvMII_MII)"
endchoice

config  MAC_TO_GIGAPHY_MODE_ADDR
        hex "Phy Address"
	default 0x0 if RT3052_FPGA || RT3352_FPGA
	default 0x1F if !RT3052_FPGA && !RT3352_FPGA
        depends on GE1_MII_AN || GE1_RGMII_AN || P5_MAC_TO_PHY_MODE

config RAETH_GMAC2
        bool "GMAC2 Support"
        depends on RAETH && RALINK_RT3883

choice
        prompt "GMAC2 is connected to"
        depends on RAETH_GMAC2
        default GE2_RGMII_AN

config  GE2_MII_FORCE_100
        bool "MII_FORCE_100 (10/100M Switch)"
        depends on !RALINK_RT3052 && !RALINK_RT3352 && !RALINK_RT5350

config  GE2_MII_AN
        bool "MII_AN (100Phy)"
        depends on !RALINK_RT3052 && !RALINK_RT3352 && !RALINK_RT5350

config  GE2_RVMII_FORCE_100
        bool "RvMII_FORCE_100 (CPU)"
        depends on !RALINK_RT3052 && !RALINK_RT3352 && !RALINK_RT5350

config  GE2_RGMII_FORCE_1000
        bool "RGMII_FORCE_1000 (GigaSW, CPU)"
        depends on !RALINK_RT3052 && !RALINK_RT3352 && !RALINK_RT5350
	select RALINK_SPI

config  GE2_RGMII_AN
        bool "RGMII_AN (GigaPhy)"
        depends on !RALINK_RT3052 && !RALINK_RT3352 && !RALINK_RT5350

endchoice

config  MAC_TO_GIGAPHY_MODE_ADDR2
        hex "Phy Address"
	default 0x1E
        depends on GE2_MII_AN || GE2_RGMII_AN 

config LAN_WAN_SUPPORT
        bool "LAN/WAN Partition"
        depends on RAETH_ROUTER || RT_3052_ESW

choice
        prompt "Switch Board Layout Type"
        depends on LAN_WAN_SUPPORT || P5_RGMII_TO_MAC_MODE ||  GE1_RGMII_FORCE_1000 || GE2_RGMII_FORCE_1000
	default WAN_AT_P0

	config  WAN_AT_P4
	        bool "LLLL/W"
		
	config  WAN_AT_P0
	        bool "W/LLLL"
endchoice

#force 100M
config RAETH_ROUTER
bool
default y if GE1_MII_FORCE_100 || GE2_MII_FORCE_100 || GE1_RVMII_FORCE_100 || GE2_RVMII_FORCE_100

#force 1000M
config MAC_TO_MAC_MODE
bool
default y if GE1_RGMII_FORCE_1000 || GE2_RGMII_FORCE_1000

#AN
config GIGAPHY
bool
default y if GE1_RGMII_AN || GE2_RGMII_AN

#AN
config 100PHY
bool
default y if GE1_MII_AN || GE2_MII_AN

config  RAETH_ROUTER
        bool "IC+"
        depends on !RALINK_RT3052

config  RAETH_ICPLUS_PHY
        bool "100PHY"
        depends on !RALINK_RT3052

config  RTL8366_SWITCH
        bool "100PHY"
        depends on !RALINK_RT3052

config  RTL8366RB_SWITCH
        bool "100PHY"
        depends on RALINK_RT3052

config  AR690W
        bool "RTL config for AR690W"
        depends on RTL8366_SWITCH

config  RT15N
        bool "RTL config for Asus RT-15N"
        depends on RTL8366_SWITCH

config RTL8367M
	tristate "Realtek RTL8367 Support"
	default y

config AR8316
        tristate "Atheros AR8316 Support"
        default n
```

## src/linux/universal/linux-3.6/arch/mips/lantiq/falcon/Kconfig
```kconfig
if SOC_FALCON

menu "MIPS Machine"

config LANTIQ_MACH_EASY98000
	bool "Easy98000"
	default y

config LANTIQ_MACH_EASY98020
	bool "Easy98020"
	default y

config LANTIQ_MACH_95C3AM1
	bool "95C3AM1"
	default y

endmenu

endif
```

## src/linux/universal/linux-3.6/arch/mips/lantiq/xway/Kconfig
```kconfig
if SOC_XWAY

menu "MIPS Machine"

config LANTIQ_MACH_EASY50712
	bool "Easy50712 - Danube"
	default y

config LANTIQ_MACH_ARV45XX
	bool "ARV45XX"
	default y

config LANTIQ_MACH_NETGEAR
	bool "Netgear"
	default y

config LANTIQ_MACH_GIGASX76X
	bool "GIGASX76X"
	default y

config LANTIQ_MACH_WBMR
	bool "WBMR-HP-G300H"
	default y

endmenu

endif

if SOC_AMAZON_SE

menu "MIPS Machine"

config LANTIQ_MACH_EASY50601
	bool "Easy50601 - Amazon SE"
	default y

endmenu

endif

if SOC_VR9

menu "MIPS Machine"

config LANTIQ_MACH_FRITZ3370
	bool "Fritz!Box 3370"
	default y

endmenu

endif
```

## src/linux/universal/linux-3.8/arch/arm/mach-cns3xxx/Kconfig
```kconfig
menu "CNS3XXX platform type"
	depends on ARCH_CNS3XXX

config MACH_CNS3420VB
	bool "Support for CNS3420 Validation Board"
	help
	  Include support for the Cavium Networks CNS3420 MPCore Platform
	  Baseboard.
	  This is a platform with an on-board ARM11 MPCore and has support
	  for USB, USB-OTG, MMC/SD/SDIO, SATA, PCI-E, etc.

config MACH_GW2388
	bool "Support for Gateworks Laguna Platform"
	select MIGHT_HAVE_PCI
	help
	  Include support for the Gateworks Laguna Platform

	  This is a platform with an on-board ARM11 MPCore and has support
	  for USB, USB-OTG, MMC/SD/SDIO, SATA, PCI-E, I2C, GIG, etc.

config CPU_FREQ_CNS3XXX
	tristate "CPUfreq support for Cavium CNS3XXX CPUs"
	depends on CPU_FREQ && ARCH_CNS3XXX

endmenu
```

## src/linux/universal/linux-3.8/arch/mips/atheros/Kconfig
```kconfig
config ATHEROS_AR5312
	bool "Atheros 5312/2312+ support"
	depends on ATHEROS
	default y

config ATHEROS_AR5315
	bool "Atheros 2315+ support"
	depends on ATHEROS
	select DMA_NONCOHERENT
	select CEVT_R4K
	select CSRC_R4K
	select IRQ_CPU
	select SYS_HAS_CPU_MIPS32_R1
	select SYS_SUPPORTS_32BIT_KERNEL
	select SYS_SUPPORTS_BIG_ENDIAN
	select GENERIC_GPIO
	default y

config ATHEROS_AR2315_PCI
	bool "PCI support"
	depends on ATHEROS_AR5315
	select HW_HAS_PCI
	select PCI
	select USB_ARCH_HAS_HCD
	select USB_ARCH_HAS_OHCI
	select USB_ARCH_HAS_EHCI
	default y
```

## src/linux/universal/linux-4.1/drivers/base/regmap/Kconfig
```kconfig
# Generic register map support.  There are no user servicable options here,
# this is an API intended to be used by other kernel subsystems.  These
# subsystems should select the appropriate symbols.

config REGMAP
	select LZO_COMPRESS
	select LZO_DECOMPRESS
	select IRQ_DOMAIN if REGMAP_IRQ
	tristate "Regmap"

config REGMAP_AC97
	select REGMAP
	tristate "Remap AC97"

config REGMAP_I2C
	depends on I2C
	tristate "Regmap I2C"

config REGMAP_SPI
	select REGMAP
	depends on SPI_MASTER && SPI
	tristate "Regmap SPI"

config REGMAP_SPMI
	select REGMAP
	depends on SPMI
	tristate "Regmap SPMI"

config REGMAP_MMIO
	select REGMAP
	tristate "Remap MMIO"

config REGMAP_IRQ
	select REGMAP
	bool "REGMAP_IRQ"
```
