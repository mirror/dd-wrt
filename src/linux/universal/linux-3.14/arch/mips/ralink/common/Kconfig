## src/linux/universal/linux-3.14/arch/mips/ralink/common/Kconfig
```kconfig
config FLASH_REMAP_NEED
       bool
       default y if (RALINK_RT2880)

choice
       prompt "DRAM Size"
       default RT2880_DRAM_16M

config RT2880_DRAM_8M
       bool "8M"

config RT2880_DRAM_16M
       bool "16M"

config RT2880_DRAM_32M
       bool "32M"

config RT2880_DRAM_64M
       bool "64M"

endchoice

choice
       prompt "Flash Size"
       default RT2880_FLASH_4M
       depends on  FLASH_REMAP_NEED

config RT2880_FLASH_2M
       bool "2M"

config RT2880_FLASH_4M
       bool "4M"

config RT2880_FLASH_8M
       bool "8M"

config RT2880_FLASH_16M
       bool "16M"

endchoice

config  RT2880_FLASH_32M
        bool "Flash Size 32MB Support"
	depends on (RALINK_RT305X || RALINK_RT3350) && !MTD_SPI_RALINK
	select MTD_CONCAT if RT2880_FLASH_32M

config  RALINK_RAM_SIZE
	int 
	default 8 if RT2880_DRAM_8M
	default 16 if RT2880_DRAM_16M
	default 32 if RT2880_DRAM_32M
	default 64 if RT2880_DRAM_64M

config MTD_PHYSMAP_START
       hex 'Physmap start'
       default 0xBF000000 if !FLASH_REMAP_NEED && RALINK_RT305X

config MTD_PHYSMAP_LEN
       hex 
       default 0x200000 if RT2880_FLASH_2M
       default 0x400000 if RT2880_FLASH_4M
       default 0x800000 if RT2880_FLASH_8M
       default 0x1000000 if RT2880_FLASH_16M
       default 0x2000000 if RT2880_FLASH_32M
       default 0x1000000 if !FLASH_REMAP_NEED

config MTD_PHYSMAP_BUSWIDTH
       int 
       default 2

choice
	prompt "Root File System Type"
	default RT2880_ROOTFS_IN_RAM

config  RT2880_ROOTFS_IN_RAM
        bool "RootFS_in_RAM"
	select BLK_DEV_INITRD 
	select BLK_DEV_RAM 

config  RT2880_ROOTFS_IN_FLASH
        bool "RootFS_in_FLASH"

endchoice

config BLK_DEV_RAM_SIZE
	int 'Default RAM disk size'
	default 8192
	depends on RT2880_ROOTFS_IN_RAM

config	INITRAMFS_LZMA
	bool "Compress ramdisk by lzma instead of gzip"
	depends on RT2880_ROOTFS_IN_RAM

config MTD_KERNEL_PART_SIZ
	hex 'MTD Kernel Partition Size (Unit:Bytes)'
	default 0xD0000
	depends on RT2880_ROOTFS_IN_FLASH

config  RALINK_TIMER
	tristate 'Ralink WatchDog' 

config  RALINK_TIMER_WDG
        bool "Ralink WatchDog Timer"
        depends on RALINK_TIMER

config  RALINK_TIMER_WDG_RESET_OUTPUT
        bool "Ralink WatchDog Reset Output"
        depends on RALINK_TIMER_WDG

config  EAP9550
	bool "EAP 9550 watchdog workaround"
	depends on RALINK_RT305X

config  RALINK_WDG_TIMER
        int "WatchDog Timer (Unit:1Sec, Max=30Sec)"
        default 10
        depends on RALINK_TIMER_WDG

config  RALINK_WDG_REFRESH_INTERVAL
        int "WatchDog Refresh Interval (Unit:1Sec, Max=30Sec)"
        default 4
        depends on RALINK_TIMER_WDG

config  RALINK_TIMER_DFS
        bool "Ralink DFS Timer"
        depends on RALINK_TIMER


config RT3XXX_EHCI_OHCI
	bool "Ralink USB EHCI/OHCI controller support"
        depends on (RALINK_RT3883 || RALINK_RT3352)
	select USB_ARCH_HAS_OHCI
	select USB_ARCH_HAS_EHCI

#config RALINK_EXTERNAL_TIMER
#	bool "Ralink External Timer"
#	depends on RALINK_RT3352 || RALINK_RT5350

config TIXI
	bool "Tixi Board support"
	depends on RALINK_RT3352
```

## src/linux/universal/linux-3.15/arch/mips/lantiq/Kconfig
```kconfig
if LANTIQ

config LANTIQ_PCIE
	bool

config SOC_TYPE_XWAY
	bool
	select PINCTRL_XWAY
	default n

choice
	prompt "SoC Type"
	default SOC_XWAY

config SOC_AMAZON_SE
	bool "Amazon SE"
	select SOC_TYPE_XWAY

config SOC_XWAY
	bool "XWAY"
	select SOC_TYPE_XWAY
	select HW_HAS_PCI

config SOC_VR9
	bool "VR9"
	select SOC_TYPE_XWAY
	select HW_HAS_PCI
	select LANTIQ_PCIE

config SOC_FALCON
	bool "FALCON"
endchoice

config AR9
	bool "AR9 DSL Driver extensions"

source "arch/mips/lantiq/xway/Kconfig"
source "arch/mips/lantiq/falcon/Kconfig"

config XRX200_PHY_FW
	bool "XRX200 PHY firmware loader"
	depends on SOC_XWAY

endif
```

## src/linux/universal/linux-3.15/arch/mips/ralink/Kconfig
```kconfig
if MIPS_RALINK

config CLKEVT_RT3352
	bool
	depends on SOC_RT305X || SOC_MT7620
	default y
	select CLKSRC_OF
	select CLKSRC_MMIO

choice
	prompt "Ralink SoC selection"
	default SOC_RT288X
	help
	  Select Ralink MIPS SoC type.

	config RALINK_RT288X
		bool "RT288x"
		select MIPS_L1_CACHE_SHIFT_4	
		select SOC_RT288X

	config RALINK_RT305X
		bool "RT305x"
		select SOC_RT305X

endchoice


config SOC_RT288X
	bool
	select CEVT_R4K
	select CSRC_R4K
	select DMA_NONCOHERENT
	select IRQ_CPU
	select ARCH_REQUIRE_GPIOLIB
	select SYS_HAS_CPU_MIPS32_R1
	select SYS_HAS_CPU_MIPS32_R2
	select SYS_SUPPORTS_32BIT_KERNEL
	select SYS_SUPPORTS_LITTLE_ENDIAN
	select SYS_HAS_EARLY_PRINTK
	select RALINK_DEVICE
	select HW_HAS_PCI
	select HAVE_CLK

config RALINK_RT2880
	bool "RT2880"
	depends on SOC_RT288X
	select MIPS_L1_CACHE_SHIFT_4
	select RALINK_RT2880_MP

config RALINK_RT2883
	bool "RT2883"
	depends on SOC_RT288X
	select RALINK_RT2883_MP


config SOC_RT305X
	bool
	select CEVT_R4K
	select CSRC_R4K
	select DMA_NONCOHERENT
	select IRQ_CPU
	select ARCH_REQUIRE_GPIOLIB
	select SYS_HAS_CPU_MIPS32_R1
	select SYS_HAS_CPU_MIPS32_R2
	select SYS_SUPPORTS_32BIT_KERNEL
	select SYS_SUPPORTS_LITTLE_ENDIAN
	select SYS_HAS_EARLY_PRINTK
	select RALINK_DEVICE
	select USB_ARCH_HAS_HCD
	select USB_ARCH_HAS_OHCI
	select USB_ARCH_HAS_EHCI
	select HAVE_CLK

config RALINK_RT3052
	bool "RT3052"
	depends on SOC_RT305X
	select RALINK_RT3052_MP2 if !RALINK_RT3350

config RALINK_RT3352
	bool "RT3352"
	depends on SOC_RT305X
	select RALINK_RT3352_MP

config RALINK_RT3350
	bool "RT3350"
	depends on SOC_RT305X

config RALINK_RT5350
	bool "RT5350"
	depends on SOC_RT305X


config RALINK_DEV_GPIO_BUTTONS
	def_bool n

config RALINK_DEV_GPIO_LEDS
	def_bool n

source "arch/mips/ralink/rt288x/Kconfig"
source "arch/mips/ralink/rt305x/Kconfig"
source "arch/mips/ralink/common/Kconfig"


endif
```

## src/linux/universal/linux-3.15/drivers/base/regmap/Kconfig
```kconfig
# Generic register map support.  There are no user servicable options here,
# this is an API intended to be used by other kernel subsystems.  These
# subsystems should select the appropriate symbols.

config REGMAP
	select LZO_COMPRESS
	select LZO_DECOMPRESS
	select IRQ_DOMAIN if REGMAP_IRQ
	tristate "Regmap"

config REGMAP_I2C
	select REGMAP
	tristate "Regmap I2C"

config REGMAP_SPI
	select REGMAP
	depends on SPI_MASTER
	tristate "Regmap SPI"

config REGMAP_SPMI
	select REGMAP
	tristate

config REGMAP_MMIO
	select REGMAP
	tristate

config REGMAP_IRQ
	select REGMAP
	bool
```
