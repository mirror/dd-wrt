## src/linux/universal/linux-6.6/arch/mips/cavium-octeon/Kconfig
```kconfig
# SPDX-License-Identifier: GPL-2.0
if CPU_CAVIUM_OCTEON

config CAVIUM_CN63XXP1
	bool "Enable CN63XXP1 errata workarounds"
	default "n"
	help
	  The CN63XXP1 chip requires build time workarounds to
	  function reliably, select this option to enable them.  These
	  workarounds will cause a slight decrease in performance on
	  non-CN63XXP1 hardware, so it is recommended to select "n"
	  unless it is known the workarounds are needed.

endif # CPU_CAVIUM_OCTEON

if CAVIUM_OCTEON_SOC

config CAVIUM_OCTEON_EXTRA_CVMSEG
	int "Number of extra L1 cache lines reserved for CVMSEG memory"
	range 0 50
	default 0
	help
	  CVMSEG LM is a segment that accesses portions of the dcache
	  as a local memory; the larger CVMSEG is, the smaller the
	  cache is.  The kernel uses two or three blocks (one for TLB
	  exception handlers, one for driver IOBDMA operations, and on
	  models that need it, one for LMTDMA operations). This
	  selects an optional extra number of CVMSEG lines for use by
	  other software.

	  Normally no extra lines are required, and this parameter
	  should be set to zero.

config CAVIUM_OCTEON_LOCK_L2
	bool "Lock often used kernel code in the L2"
	default "y"
	help
	  Enable locking parts of the kernel into the L2 cache.

config CAVIUM_OCTEON_LOCK_L2_TLB
	bool "Lock the TLB handler in L2"
	depends on CAVIUM_OCTEON_LOCK_L2
	default "y"
	help
	  Lock the low level TLB fast path into L2.

config CAVIUM_OCTEON_LOCK_L2_EXCEPTION
	bool "Lock the exception handler in L2"
	depends on CAVIUM_OCTEON_LOCK_L2
	default "y"
	help
	  Lock the low level exception handler into L2.

config CAVIUM_OCTEON_LOCK_L2_LOW_LEVEL_INTERRUPT
	bool "Lock the interrupt handler in L2"
	depends on CAVIUM_OCTEON_LOCK_L2
	default "y"
	help
	  Lock the low level interrupt handler into L2.

config CAVIUM_OCTEON_LOCK_L2_INTERRUPT
	bool "Lock the 2nd level interrupt handler in L2"
	depends on CAVIUM_OCTEON_LOCK_L2
	default "y"
	help
	  Lock the 2nd level interrupt handler in L2.

config CAVIUM_OCTEON_LOCK_L2_MEMCPY
	bool "Lock memcpy() in L2"
	depends on CAVIUM_OCTEON_LOCK_L2
	default "y"
	help
	  Lock the kernel's implementation of memcpy() into L2.

config CAVIUM_RESERVE32
	int "Memory to reserve for user processes shared region (MB)"
	range 0 1536
	default "0"
	help
	  Reserve a shared memory region for user processes to use for hardware
	  memory buffers. This is required for 32bit applications to be able to
	  send and receive packets directly. Applications access this memory by
	  memory mapping /dev/mem for the addresses in /proc/octeon_info. For
	  optimal performance with HugeTLBs, keep this size an even number of
	  megabytes.

config OCTEON_ILM
	tristate "Module to measure interrupt latency using Octeon CIU Timer"
	help
	  This driver is a module to measure interrupt latency using the
	  the CIU Timers on Octeon.

	  To compile this driver as a module, choose M here.  The module
	  will be called octeon-ilm

config OCTEON_FPA3
	tristate "Octeon III fpa driver"
	default "n"
	depends on CPU_CAVIUM_OCTEON
	help
	  This option enables a Octeon III driver for the Free Pool Unit (FPA).
	  The FPA is a hardware unit that manages pools of pointers to free
	  L2/DRAM memory. This driver provides an interface to reserve,
	  initialize, and fill fpa pools.

endif # CAVIUM_OCTEON_SOC
```

## src/linux/universal/linux-6.6/drivers/net/ethernet/cavium/Kconfig
```kconfig
# SPDX-License-Identifier: GPL-2.0-only
#
# Cavium ethernet device configuration
#

config NET_VENDOR_CAVIUM
	bool "Cavium ethernet drivers"
	default y
	help
	  Select this option if you want enable Cavium network support.

	  If you have a Cavium SoC or network adapter, say Y.

if NET_VENDOR_CAVIUM

config THUNDER_NIC_PF
	tristate "Thunder Physical function driver"
	depends on 64BIT && PCI
	select THUNDER_NIC_BGX
	help
	  This driver supports Thunder's NIC physical function.
	  The NIC provides the controller and DMA engines to
	  move network traffic to/from the memory. The NIC
	  works closely with TNS, BGX and SerDes to implement the
	  functions replacing and virtualizing those of a typical
	  standalone PCIe NIC chip.

config THUNDER_NIC_VF
	tristate "Thunder Virtual function driver"
	imply CAVIUM_PTP
	depends on 64BIT && PCI
	help
	  This driver supports Thunder's NIC virtual function

config	THUNDER_NIC_BGX
	tristate "Thunder MAC interface driver (BGX)"
	depends on 64BIT && PCI
	select PHYLIB
	select MDIO_THUNDER if PCI
	select THUNDER_NIC_RGX
	help
	  This driver supports programming and controlling of MAC
	  interface from NIC physical function driver.

config	THUNDER_NIC_RGX
	tristate "Thunder MAC interface driver (RGX)"
	depends on 64BIT && PCI
	select PHYLIB
	select MDIO_THUNDER if PCI
	help
	  This driver supports configuring XCV block of RGX interface
	  present on CN81XX chip.

config CAVIUM_PTP
	tristate "Cavium PTP coprocessor as PTP clock"
	depends on 64BIT && PCI
	depends on PTP_1588_CLOCK
	help
	  This driver adds support for the Precision Time Protocol Clocks and
	  Timestamping coprocessor (PTP) found on Cavium processors.
	  PTP provides timestamping mechanism that is suitable for use in IEEE 1588
	  Precision Time Protocol or other purposes.  Timestamps can be used in
	  BGX, TNS, GTI, and NIC blocks.

config LIQUIDIO_CORE
	tristate

config LIQUIDIO
	tristate "Cavium LiquidIO support"
	depends on 64BIT && PCI
	depends on PCI
	depends on PTP_1588_CLOCK_OPTIONAL
	select FW_LOADER
	select LIBCRC32C
	select LIQUIDIO_CORE
	select NET_DEVLINK
	help
	  This driver supports Cavium LiquidIO Intelligent Server Adapters
	  based on CN66XX, CN68XX and CN23XX chips.

	  To compile this driver as a module, choose M here: the module
	  will be called liquidio.  This is recommended.

config OCTEON_MGMT_ETHERNET
	tristate "Octeon Management port ethernet driver (CN5XXX, CN6XXX)"
	depends on CAVIUM_OCTEON_SOC
	select PHYLIB
	select MDIO_OCTEON
	select OCTEON_ETHERNET_COMMON
	select OCTEON_BGX_PORT
	default y
	help
	  Enable the ethernet driver for the management
	  port on Cavium Networks' Octeon CN57XX, CN56XX, CN55XX,
	  CN54XX, CN52XX, and CN6XXX chips.

config OCTEON_ETHERNET
	tristate "OCTEON Ethernet support"
	depends on CAVIUM_OCTEON_SOC
	select PHYLIB
	select MDIO_OCTEON
	select OCTEON_ETHERNET_MEM
	select OCTEON_ETHERNET_COMMON
	help
	  This driver supports the builtin ethernet ports on Cavium
	  Inc.' products in the Octeon family. This driver supports the
	  CN3XXX, CN5XXX, CN6XXX and CNF7XXX OCTEON processors.

	  To compile this driver as a module, choose M here.  The module
	  will be called octeon-ethernet.

config OCTEON3_ETHERNET
	tristate "OCTEON III PKI/PKO Ethernet support (not cn70xx)"
	depends on CAVIUM_OCTEON_SOC
	select OCTEON_BGX_PORT
	select OCTEON_FPA3
	help
	  Support for 'BGX' Ethernet via PKI/PKO units.  No support
	  for cn70xx chips (use OCTEON_ETHERNET for cn70xx).

config OCTEON3_ETHERNET_SRIO
	tristate "SRIO support for OCTEON III Ethernet driver"
	depends on (OCTEON3_ETHERNET && CAVIUM_OCTEON_RAPIDIO)
	select OCTEON_SRIO_NEXUS
	help
	  This driver adds 'SRIO' support to the Ethernet driver via PKI/PKO
	  units. It supports Caviums CNF75XX SOC. To compile this driver as a
	  module, choose M here. The module will be called
	  octeon3-ethernet-srio.

config OCTEON_ETHERNET_MEM
	tristate
	depends on CAVIUM_OCTEON_SOC

config OCTEON_POW_ONLY_ETHERNET
	tristate "POW based internal only ethernet driver"
	depends on CAVIUM_OCTEON_SOC
	depends on OCTEON_ETHERNET
	help
	  This option enables a very simple ethernet driver for internal core
	  to core traffic. It relies on another driver, octeon-ethernet,
	  to perform all hardware setup. This driver's purpose is to supply
	  basic networking between different Linux images running on the same
	  chip. A single core loads the octeon-ethernet module, all other cores
	  load this driver. On load, the driver waits for some other core to
	  perform hardware setup.

config OCTEON_ETHERNET_COMMON
	tristate

config OCTEON_BGX_NEXUS
	tristate
	depends on CAVIUM_OCTEON_SOC

config OCTEON_SRIO_NEXUS
	tristate

config OCTEON_COMMON_NEXUS
	tristate

config OCTEON_BGX_PORT
	tristate
	depends on CAVIUM_OCTEON_SOC
	select OCTEON_BGX_NEXUS
	select OCTEON_COMMON_NEXUS

config LIQUIDIO_VF
	tristate "Cavium LiquidIO VF support"
	depends on 64BIT && PCI_MSI
	depends on PTP_1588_CLOCK_OPTIONAL
	select LIQUIDIO_CORE
	help
	  This driver supports Cavium LiquidIO Intelligent Server Adapter
	  based on CN23XX chips.

	  To compile this driver as a module, choose M here: The module
	  will be called liquidio_vf. MSI-X interrupt support is required
	  for this driver to work correctly

endif # NET_VENDOR_CAVIUM
```

## src/linux/x86/linux-2.6.17/arch/mips/brcm-boards/bcm963xx/Kconfig
```kconfig
# Kernel and Driver configuration for Broadcom Commengine ADSL board
choice
	prompt "Broadcom Commengine ADSL board"
	depends on MIPS_BRCM
	default BCM96345
	help
	  Select different Broadcom ADSL board

config BCM96338
	bool "96338 ADSL board"
	select DMA_NONCOHERENT

config BCM96345
	bool "96345 ADSL board"
	select DMA_NONCOHERENT

config BCM96348
	bool "96348 ADSL board"
	select DMA_NONCOHERENT

endchoice

config BCM_BOARD
	bool "Support for Broadcom Board"
	depends on BCM96338 || BCM96345 || BCM96348

config BCM_SERIAL
	bool "Support for Serial Port"
	depends on BCM96338 || BCM96345 || BCM96348

config BCM_ENET
	tristate "Support for Ethernet"
	depends on BCM96338 || BCM96345 || BCM96348

config BCM_USB
	tristate "Support for USB"
	depends on BCM96338 || BCM96345 || BCM96348

config BCM_WLAN
	tristate "Support for Wireless"
	depends on BCM96338 || BCM96345 || BCM96348

config BCM_PCI
	bool "Support for PCI"
	depends on BCM96338 || BCM96345 || BCM96348
	select PCI

config BCM_ATMAPI
	tristate "Support for ATM"
	depends on BCM96338 || BCM96345 || BCM96348

config BCM_ATMTEST
	tristate "Support for ATM Diagnostic"
	depends on BCM96338 || BCM96345 || BCM96348

config BCM_ADSL
	tristate "Support for ADSL"
	depends on BCM96338 || BCM96345 || BCM96348

config BCM_ENDPOINT
	tristate "Support for VOICE"
	depends on BCM96338 || BCM96345 || BCM96348

config BCM_PROCFS
	tristate "Support for PROCFS"
	depends on BCM96338 || BCM96345 || BCM96348

config BCM_VDSL
	tristate "Support for VDSL"
	depends on BCM96338 || BCM96345 || BCM96348

config BCM_SECURITY
	tristate "Support for SECURITY"
	depends on BCM96338 || BCM96345 || BCM96348

config BCM_HPNA
	tristate "Support for HPNA"
	depends on BCM96338 || BCM96345 || BCM96348

config BCM_BOARD_IMPL
	int "Implementation index for ADSL Board"
	depends on BCM96338 || BCM96345 || BCM96348

config BCM_SERIAL_IMPL
	int "Implementation index for Serial"
	depends on BCM96338 || BCM96345 || BCM96348

config BCM_ENET_IMPL
	int "Implementation index for Ethernet"
	depends on BCM96338 || BCM96345 || BCM96348

config BCM_USB_IMPL
	int "Implementation index for USB"
	depends on BCM96338 || BCM96345 || BCM96348

config BCM_WLAN_IMPL
	int "Implementation index for WIRELESS"
	depends on BCM96338 || BCM96345 || BCM96348

config BCM_ATMAPI_IMPL
	int "Implementation index for ATM"
	depends on BCM96338 || BCM96345 || BCM96348

config BCM_ATMTEST_IMPL
	int "Implementation index for ATM Diagnostic"
	depends on BCM96338 || BCM96345 || BCM96348

config BCM_BLAA_IMPL
	int "Implementation index for BLAA"
	depends on BCM96338 || BCM96345 || BCM96348

config BCM_ADSL_IMPL
	int "Implementation index for ADSL"
	depends on BCM96338 || BCM96345 || BCM96348

config BCM_ENDPOINT_IMPL
	int "Implementation index for VOICE"
	depends on BCM96338 || BCM96345 || BCM96348

config BCM_PROCFS_IMPL
	int "Implementation index for PROCFS"
	depends on BCM96338 || BCM96345 || BCM96348

config BCM_VDSL_IMPL
	int "Implementation index for VDSL"
	depends on BCM96338 || BCM96345 || BCM96348

config BCM_SECURITY_IMPL
	int "Implementation index for SECURITY"
	depends on BCM96338 || BCM96345 || BCM96348

config BCM_HPNA_IMPL
	int "Implementation index for HPNA"
	depends on BCM96338 || BCM96345 || BCM96348

choice
	prompt "Root File System"
	depends on MIPS_BRCM
	default ROOTFS_SQUASHFS
	help
	  Select root file system on the board flash. 

config ROOTFS_SQUASHFS
        bool "SQUASHFS"
config ROOTFS_CRAMFS
        bool "CRAMFS"
config ROOTFS_JFFS2
        bool "JFFS2"
config ROOTFS_NFS
        bool "NFS"

endchoice

config ROOT_FLASHFS
	string "flash partition"
	depends on ROOTFS_SQUASHFS || ROOTFS_CRAMFS || ROOTFS_JFFS2
	default "root=31:0 ro noinitrd" if ROOTFS_SQUASHFS = y || ROOTFS_CRAMFS = y
	default "root=31:2 ro noinitrd" if ROOTFS_JFFS2 = y
	help
	  This is the root file system partition on flash memory

config ROOT_NFS_DIR
	string "NFS server path"
	depends on ROOTFS_NFS
	default "/opt/bcm96338/targets/96338R/fs" if BCM96338 = y
	default "/opt/bcm96345/targets/96345R/fs" if BCM96345 = y
	default "/opt/bcm96348/targets/96348R/fs" if BCM96348 = y  
	help
	  This is the path of NFS server (host system)
```
