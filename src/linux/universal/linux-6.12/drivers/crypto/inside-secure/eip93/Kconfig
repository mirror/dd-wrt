## src/router/mac80211/Kconfig.versions
```kconfig
config KERNEL_4_5
    def_bool y
config KERNEL_4_6
    def_bool y
config KERNEL_4_7
    def_bool y
config KERNEL_4_8
    def_bool y
config KERNEL_4_9
    def_bool y
config KERNEL_4_10
    def_bool y
config KERNEL_4_11
    def_bool y
config KERNEL_4_12
    def_bool y
config KERNEL_4_13
    def_bool y
config KERNEL_4_14
    def_bool y
config KERNEL_4_15
    def_bool y
config KERNEL_4_16
    def_bool y
config KERNEL_4_17
    def_bool y
config KERNEL_4_18
    def_bool y
config KERNEL_4_19
    def_bool y
config KERNEL_4_20
    def_bool y
config KERNEL_5_0
    def_bool y
config KERNEL_5_1
    def_bool y
config KERNEL_5_2
    def_bool y
config KERNEL_5_3
    def_bool y
config KERNEL_5_4
    def_bool y
config KERNEL_5_5
    def_bool y
config KERNEL_5_6
    def_bool y
config KERNEL_5_7
    def_bool y
config KERNEL_5_8
    def_bool y
config KERNEL_5_9
    def_bool y
config KERNEL_5_10
    def_bool y
config KERNEL_5_11
    def_bool y
config KERNEL_5_12
    def_bool y
config KERNEL_5_13
    def_bool y
config KERNEL_5_14
    def_bool y
config KERNEL_5_15
    def_bool y
config KERNEL_5_16
    def_bool y
config KERNEL_5_17
    def_bool y
config KERNEL_5_18
    def_bool y
config KERNEL_5_19
    def_bool y
config KERNEL_5_20
    def_bool y
config KERNEL_5_21
    def_bool y
config KERNEL_5_22
    def_bool y
config KERNEL_5_23
    def_bool y
config KERNEL_5_24
    def_bool y
config KERNEL_5_25
    def_bool y
config KERNEL_5_26
    def_bool y
config KERNEL_5_27
    def_bool y
config KERNEL_5_28
    def_bool y
config KERNEL_5_29
    def_bool y
config KERNEL_5_30
    def_bool y
config KERNEL_5_31
    def_bool y
config KERNEL_5_32
    def_bool y
config KERNEL_5_33
    def_bool y
config KERNEL_5_34
    def_bool y
config KERNEL_5_35
    def_bool y
config KERNEL_5_36
    def_bool y
config KERNEL_5_37
    def_bool y
config KERNEL_5_38
    def_bool y
config KERNEL_5_39
    def_bool y
config KERNEL_5_40
    def_bool y
config KERNEL_5_41
    def_bool y
config KERNEL_5_42
    def_bool y
config KERNEL_5_43
    def_bool y
config KERNEL_5_44
    def_bool y
config KERNEL_5_45
    def_bool y
config KERNEL_5_46
    def_bool y
config KERNEL_5_47
    def_bool y
config KERNEL_5_48
    def_bool y
config KERNEL_5_49
    def_bool y
config KERNEL_5_50
    def_bool y
config KERNEL_5_51
    def_bool y
config KERNEL_5_52
    def_bool y
config KERNEL_5_53
    def_bool y
config KERNEL_5_54
    def_bool y
config KERNEL_5_55
    def_bool y
config KERNEL_5_56
    def_bool y
config KERNEL_5_57
    def_bool y
config KERNEL_5_58
    def_bool y
config KERNEL_5_59
    def_bool y
config KERNEL_5_60
    def_bool y
config KERNEL_5_61
    def_bool y
config KERNEL_5_62
    def_bool y
config KERNEL_5_63
    def_bool y
config KERNEL_5_64
    def_bool y
config KERNEL_5_65
    def_bool y
config KERNEL_5_66
    def_bool y
config KERNEL_5_67
    def_bool y
config KERNEL_5_68
    def_bool y
config KERNEL_5_69
    def_bool y
config KERNEL_5_70
    def_bool y
config KERNEL_5_71
    def_bool y
config KERNEL_5_72
    def_bool y
config KERNEL_5_73
    def_bool y
config KERNEL_5_74
    def_bool y
config KERNEL_5_75
    def_bool y
config KERNEL_5_76
    def_bool y
config KERNEL_5_77
    def_bool y
config KERNEL_5_78
    def_bool y
config KERNEL_5_79
    def_bool y
config KERNEL_5_80
    def_bool y
config KERNEL_5_81
    def_bool y
config KERNEL_5_82
    def_bool y
config KERNEL_5_83
    def_bool y
config KERNEL_5_84
    def_bool y
config KERNEL_5_85
    def_bool y
config KERNEL_5_86
    def_bool y
config KERNEL_5_87
    def_bool y
config KERNEL_5_88
    def_bool y
config KERNEL_5_89
    def_bool y
config KERNEL_5_90
    def_bool y
config KERNEL_5_91
    def_bool y
config KERNEL_5_92
    def_bool y
config KERNEL_5_93
    def_bool y
config KERNEL_5_94
    def_bool y
config KERNEL_5_95
    def_bool y
config KERNEL_5_96
    def_bool y
config KERNEL_5_97
    def_bool y
config KERNEL_5_98
    def_bool y
config KERNEL_5_99
    def_bool y
```

## src/router/mac80211/compat/Kconfig
```kconfig
#
# backport Kconfig
#
# Some options are user-selectable ("BPAUTO_USERSEL_*")
#
# Most options, however, follow a few different schemes:
#
# A) An option that is selected by drivers ("select FOO") will be
#    changed to "select BPAUTO_FOO" (if the option BPAUTO_FOO
#    exists). The option BPAUTO_FOO then controls setting of the
#    BPAUTO_BUILD_FOO option, which is a module, like this:
#
# config BPAUTO_BUILD_FOO
#	tristate
#	# or bool
#
#	# not possible on kernel < X.Y, build will fail if any
#	# drivers are allowed to build on kernels < X.Y
#	depends on KERNEL_X_Y
#
#	# don't build the backport code if FOO is in the kernel
#	# already, but only if the kernel version is also >= X.Z;
#	# this is an example of backporting where the version of
#	# the FOO subsystem that we need is only available from
#	# kernel version X.Z
#	depends on !FOO || KERNEL_X_Z
#
#	# build if driver needs it (it selects BPAUTO_FOO)
#	default m if BPAUTO_FOO
#
#	# or for build-testing (BPAUTO_USERSEL_BUILD_ALL is enabled)
#	default m if BPAUTO_USERSEL_BUILD_ALL
#
# config BPAUTO_FOO
#	bool
#
# This only works as-is if the kernel code is usable on any version,
# otherwise the "&& !FOO" part needs to be different.
#
#
# B) An option for code always present on some kernels (e.g. KFIFO).
#    This simply depends on/sets the default based on the version:
#
# config BPAUTO_BUILD_KFIFO
#	def_bool y
#	depends on KERNEL_2_6_36
#
#
# C) similarly, a kconfig symbol for an option, e.g.
#    BPAUTO_OPTION_SOME_FIX (no examples provided) check git log
#
#
# Variations are obviously possible.
#

config BP_MODULES
	option modules
	bool
	default MODULES

	help
	This symbol is necessary for the newer kconf tool, it looks
	for the "option modules" to control the 'm' state.

config BPAUTO_BUILD_CORDIC
	tristate
	depends on m
	depends on !CORDIC
	depends on KERNEL_3_1
	default m if BPAUTO_CORDIC
	default m if BPAUTO_USERSEL_BUILD_ALL
	#module-name cordic
	#c-file lib/cordic.c

config BPAUTO_CORDIC
	bool

config BPAUTO_MII
	bool

config BPAUTO_BUILD_LEDS
	bool
	depends on !NEW_LEDS || LEDS_CLASS=n || !LEDS_TRIGGERS
	default y if BPAUTO_NEW_LEDS
	default y if BPAUTO_LEDS_CLASS
	default y if BPAUTO_LEDS_TRIGGERS

config BPAUTO_NEW_LEDS
	bool

config BPAUTO_LEDS_CLASS
	bool

config BPAUTO_LEDS_TRIGGERS
	bool

config BPAUTO_USERSEL_BUILD_ALL
	bool "Build all compat code"
	help
	  This option selects all the compat code options
	  that would otherwise only be selected by drivers.

	  It's only really useful for compat testing, so
	  you probably shouldn't enable it.

config BPAUTO_CRYPTO_CCM
	depends on CRYPTO_AEAD
	depends on CRYPTO_CTR
	bool

config BPAUTO_BUILD_CRYPTO_CCM
	bool
	default n if CRYPTO_CCM
	default y if BPAUTO_CRYPTO_CCM
	#c-file crypto/ccm.c

config BPAUTO_CRYPTO_SKCIPHER
	tristate
	depends on m
	depends on KERNEL_4_3
	default y if MAC802154
	default y if LIB80211_CRYPT_WEP
	default y if LIB80211_CRYPT_TKIP
	default y if BT
	#c-file crypto/skcipher.c
	#module-name skcipher

config BPAUTO_WANT_DEV_COREDUMP
	bool

config BPAUTO_BUILD_WANT_DEV_COREDUMP
	bool
	default n if DEV_COREDUMP
	default n if DISABLE_DEV_COREDUMP
	default y if BPAUTO_WANT_DEV_COREDUMP
	#h-file linux/devcoredump.h
	#c-file drivers/base/devcoredump.c

config BPAUTO_RHASHTABLE
	bool
	# current API of rhashtable was introduced in version 4.1
	depends on KERNEL_4_8
	# not very nice - but better than always having it
	default y if MAC80211
	#h-file linux/rhashtable.h
	#c-file lib/rhashtable.c

config BPAUTO_BUILD_HDMI
	bool
	# the hdmi driver got some new apis like hdmi_infoframe_unpack() in
	# kernel 4.0 which are used by some drivers
	depends on KERNEL_4_0
	#h-file linux/hdmi.h
	#c-file drivers/video/hdmi.c

config BPAUTO_HDMI
	bool
	select BPAUTO_BUILD_HDMI if KERNEL_4_0
	# these drivers are using the new features of the hdmi driver.
	default y if VIDEO_ADV7511
	default y if VIDEO_ADV7604
	default y if VIDEO_ADV7842

config BPAUTO_FRAME_VECTOR
	bool

config BPAUTO_BUILD_FRAME_VECTOR
	bool
	default n if FRAME_VECTOR
	default y if BPAUTO_FRAME_VECTOR
	#c-file mm/frame_vector.c

config BPAUTO_REFCOUNT
	bool
	default y
	depends on KERNEL_4_11
	#h-file linux/refcount.h
	#c-file lib/refcount.c
```
