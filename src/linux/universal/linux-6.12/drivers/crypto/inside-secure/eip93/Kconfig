## src/linux/xscale/linux-2.6.34.6/arch/arm/mach-ixp4xx/Kconfig
```kconfig
if ARCH_IXP4XX

config ARCH_SUPPORTS_BIG_ENDIAN
	bool
	default y

menu "Intel IXP4xx Implementation Options"

comment "IXP4xx Platforms"

config MACH_NSLU2
	bool
	prompt "Linksys NSLU2"
	select PCI
	help
	  Say 'Y' here if you want your kernel to support Linksys's
	  NSLU2 NAS device. For more information on this platform,
	  see http://www.nslu2-linux.org

config MACH_AVILA
	bool "Avila"
	select PCI
	help
	  Say 'Y' here if you want your kernel to support the Gateworks
	  Avila Network Platform. For more information on this platform,
	  see <file:Documentation/arm/IXP4xx>.

config MACH_CAMBRIA
	bool "Cambria"
	select PCI
	help
	  Say 'Y' here if you want your kernel to support the Gateworks
	  Avila Network Platform. For more information on this platform,
	  see <file:Documentation/arm/IXP4xx>.

config MACH_LOFT
    bool "Loft"
    depends on MACH_AVILA
    help
	  Say 'Y' here if you want your kernel to support the Giant
	  Shoulder Inc Loft board (a minor variation on the standard
	  Gateworks Avila Network Platform).

config ARCH_LOFT
	bool "Loft"
	depends on ARCH_AVILA
	help
	  Say 'Y' here if you want your kernel to support the Giant
	  Shoulder Inc Loft board (a minor variation on the standard
	  Gateworks Avila Network Platform).  


config ARCH_ADI_COYOTE
	bool "Coyote"
	select PCI
	help
	  Say 'Y' here if you want your kernel to support the ADI 
	  Engineering Coyote Gateway Reference Platform. For more
	  information on this platform, see <file:Documentation/arm/IXP4xx>.

config ARCH_ADI_COYOTE_WRT300N
	bool "Coyote (WRT300N)"
	select PCI
	depends on ARCH_ADI_COYOTE
	help
	  Say 'Y' here if you want your kernel to support the ADI 
	  Engineering Coyote Gateway Reference Platform. For more
	  information on this platform, see <file:Documentation/arm/IXP4xx>.


config MACH_GATEWAY7001
	bool "Gateway 7001"
	select PCI
	help
	  Say 'Y' here if you want your kernel to support Gateway's
	  7001 Access Point. For more information on this platform,
	  see http://openwrt.org

config MACH_WG302V1
	bool "Netgear WG302 v1 / WAG302 v1"
	select PCI
	help
	  Say 'Y' here if you want your kernel to support Netgear's
	  WG302 v1 or WAG302 v1 Access Points. For more information
	  on this platform, see http://openwrt.org


config MACH_WG302V2
	bool "Netgear WG302 v2 / WAG302 v2"
	select PCI
	help
	  Say 'Y' here if you want your kernel to support Netgear's
	  WG302 v2 or WAG302 v2 Access Points. For more information
	  on this platform, see http://openwrt.org

config MACH_WRT300NV2
	bool "Linksys WRT300N v2"
	select PCI
	help
	  Say 'Y' here if you want your kernel to support Linksys' 
	  WRT300N v2 router. For more information on this
	  platform, see http://openwrt.org

config MACH_USR8200
	bool "USRobotics USR8200"
	select PCI
	help
	  Say 'Y' here if you want your kernel to support the USRobotics
	  USR8200 router board. For more information on this platform, see
	  http://openwrt.org


config MACH_COMPEX
	bool "Compex WP18 / NP18A"
	select PCI
	help
	  Say 'Y' here if you want your kernel to support Compex' 
	  WP18 or NP18A boards. For more information on this
	  platform, see http://openwrt.org

config MACH_WG302V2
	bool "Netgear WG302 v2 / WAG302 v2"
	select PCI
	help
	  Say 'Y' here if you want your kernel to support Netgear's 
	  WG302 v2 or WAG302 v2 Access Points. For more information
	  on this platform, see http://openwrt.org

config MACH_GATEWAY7001
	bool "Gateway 7001"
	select PCI
	help
	  Say 'Y' here if you want your kernel to support Gateway's 
	  7001 Access Point. For more information on this platform,
	  see http://openwrt.org

config MACH_PRONGHORNMETRO
	bool "Pronghorn Metro"
	select PCI
	help
	  Say 'Y' here if you want your kernel to support the ADI 
	  Engineering Pronghorn Metro Platform. For more
	  information on this platform, see <file:Documentation/arm/IXP4xx>.

config ARCH_IXDP425
	bool "IXDP425"
	help
	  Say 'Y' here if you want your kernel to support Intel's 
	  IXDP425 Development Platform (Also known as Richfield).  
	  For more information on this platform, see <file:Documentation/arm/IXP4xx>.

config TONZE
	bool "TONZE IXP425"
	depends on ARCH_IXDP425

config NOP8670
	bool "NOP8670 (quirks)"
	depends on ARCH_IXDP425

config MACH_IXDPG425
	bool "IXDPG425"
	help
	  Say 'Y' here if you want your kernel to support Intel's
	  IXDPG425 Development Platform (Also known as Montajade).
	  For more information on this platform, see <file:Documentation/arm/IXP4xx>.

config MACH_IXDP465
	bool "IXDP465"
	help
	  Say 'Y' here if you want your kernel to support Intel's
	  IXDP465 Development Platform (Also known as BMP).
	  For more information on this platform, see <file:Documentation/arm/IXP4xx>.

config MACH_KIXRP435
	bool "KIXRP435"
	help
	  Say 'Y' here if you want your kernel to support Intel's
	  KIXRP435 Reference Platform.
	  For more information on this platform, see <file:Documentation/arm/IXP4xx>.

#
# IXCDP1100 is the exact same HW as IXDP425, but with a different machine 
# number from the bootloader due to marketing monkeys, so we just enable it 
# by default if IXDP425 is enabled.
#
config ARCH_IXCDP1100
	bool 
	depends on ARCH_IXDP425
	default y

config ARCH_PRPMC1100
	bool "PrPMC1100"
	help
	  Say 'Y' here if you want your kernel to support the Motorola
	  PrPCM1100 Processor Mezanine Module. For more information on
	  this platform, see <file:Documentation/arm/IXP4xx>.

config MACH_NAS100D
	bool
	prompt "NAS100D"
	select PCI
	help
	  Say 'Y' here if you want your kernel to support Iomega's
	  NAS 100d device. For more information on this platform,
	  see http://www.nslu2-linux.org/wiki/NAS100d/HomePage

config MACH_DSMG600
	bool
	prompt "D-Link DSM-G600 RevA"
	select PCI
	help
	  Say 'Y' here if you want your kernel to support D-Link's
	  DSM-G600 RevA device. For more information on this platform,
	  see http://www.nslu2-linux.org/wiki/DSMG600/HomePage

config	ARCH_IXDP4XX
	bool
	depends on ARCH_IXDP425 || MACH_IXDP465 || MACH_KIXRP435
	default y

#
# Certain registers and IRQs are only enabled if supporting IXP465 CPUs
#
config CPU_IXP46X
	bool
	depends on MACH_IXDP465
	default y

config CPU_IXP43X
	bool
	depends on MACH_KIXRP435 || MACH_CAMBRIA
	default y

config MACH_GTWX5715
	bool "Gemtek WX5715 (Linksys WRV54G)"
	depends on ARCH_IXP4XX
	select PCI
	help
		This board is currently inside the Linksys WRV54G Gateways.

		IXP425 - 266mhz
		32mb SDRAM
		8mb Flash
		miniPCI slot 0 does not have a card connector soldered to the board
		miniPCI slot 1 has an ISL3880 802.11g card (Prism54)
		npe0 is connected to a Kendin KS8995M Switch (4 ports)
		npe1 is the "wan" port
		"Console" UART is available on J11 as console
		"High Speed" UART is n/c (as far as I can tell)
		20 Pin ARM/Xscale JTAG interface on J2

config MACH_MI424WR
	bool "Actiontec MI424WR"
	depends on ARCH_IXP4XX
	select PCI
	help
		Add support for the Actiontec MI424-WR.



comment "IXP4xx Options"

config DMABOUNCE
	bool
	default y
	depends on PCI

config DMABOUNCE_DEBUG
	bool "Enable DMABounce debuging"
	default n
	depends on DMABOUNCE

config IXP4XX_INDIRECT_PCI
	bool "Use indirect PCI memory access"
	depends on PCI
	help
          IXP4xx provides two methods of accessing PCI memory space:

          1) A direct mapped window from 0x48000000 to 0x4bffffff (64MB).
             To access PCI via this space, we simply ioremap() the BAR
             into the kernel and we can use the standard read[bwl]/write[bwl]
             macros. This is the preferred method due to speed but it
             limits the system to just 64MB of PCI memory. This can be 
             problematic if using video cards and other memory-heavy devices.
          
          2) If > 64MB of memory space is required, the IXP4xx can be 
	     configured to use indirect registers to access PCI This allows 
	     for up to 128MB (0x48000000 to 0x4fffffff) of memory on the bus. 
	     The disadvantage of this is that every PCI access requires 
	     three local register accesses plus a spinlock, but in some 
	     cases the performance hit is acceptable. In addition, you cannot 
	     mmap() PCI devices in this case due to the indirect nature
	     of the PCI window.

	  By default, the direct method is used. Choose this option if you
	  need to use the indirect method instead. If you don't know
	  what you need, leave this option unselected.

config IXP4XX_LEGACY_DMABOUNCE
	bool "legacy PCI DMA bounce support"
	depends on PCI
	default n
	select DMABOUNCE
	help
	  The IXP4xx is limited to a 64MB window for PCI DMA, which
	  requires that PCI accesses above 64MB are bounced via buffers
	  below 64MB. Furthermore the IXP4xx has an erratum where PCI
	  read prefetches just below the 64MB limit can trigger lockups.

	  The kernel has traditionally handled these two issue by using
	  ARM specific DMA bounce support code for all accesses >= 64MB.
	  That code causes problems of its own, so it is desirable to
	  disable it. As the kernel now has a workaround for the PCI read
	  prefetch erratum, it no longer requires the ARM bounce code.

	  Enabling this option makes IXP4xx continue to use the problematic
	  ARM DMA bounce code. Disabling this option makes IXP4xx use the
	  kernel's generic bounce code.

	  Say 'N'.

config IXP4XX_ZONE_DMA
	bool "Support > 64MB RAM"
	depends on !IXP4XX_LEGACY_DMABOUNCE
	default y
	select ZONE_DMA
	help
	  The IXP4xx is limited to a 64MB window for PCI DMA, which
	  requires that PCI accesses above 64MB are bounced via buffers
	  below 64MB.

	  Disabling this option allows you to omit the support code for
	  DMA-able memory allocations and DMA bouncing, but the kernel
	  will then not work properly if more than 64MB of RAM is present.

	  Say 'Y' unless your platform is limited to <= 64MB of RAM.



config IXP400_LIB
	tristate 'Build IXP400 Access Library' 
	depends on ARCH_IXP4XX
	default m
	help
	  IXP400 Access Library:

	  If you select M here, the Intel IXP400 Access Library will be
	  compiled as part of the build.
	
	  In order for the library to build correctly you must set up some
	  environment variables before building the kernel. See the README
	  files included in the IXP400 software distribution for details.
	
	  Note that this library is Intel proprietary code and must be
	  obtained from Intel Corp. See the README files included in the
	  IXP400 software distribution for details.
	
	  The library can be compiled only as a module, as linking it
	  statically into the kernel would violate the GPL. The library module
	  will be called ixp400.o. The demo codelets included with the library
	  will be built in seperate modules. See the documentation included in
	  the IXP400 software distribution for details.
	
	  Note that the access library build is not compatible with the
	  CONFIG_MODVERSIONS option (Controlled by the "set version information
	  on all symbols" option in the "loadable module support" section).
	
	  Select M if you have the IXP400 source code and wish to include it
	  in your build.


endmenu

endif
```
