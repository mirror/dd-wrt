## src/linux/universal/linux-6.12/drivers/crypto/inside-secure/eip93/Kconfig
```kconfig
# SPDX-License-Identifier: GPL-2.0
config CRYPTO_DEV_EIP93
	tristate "Support for EIP93 crypto HW accelerators"
	depends on SOC_MT7621 || ARCH_AIROHA ||COMPILE_TEST
	select CRYPTO_LIB_AES
	select CRYPTO_LIB_DES
	select CRYPTO_SKCIPHER
	select CRYPTO_AEAD
	select CRYPTO_AUTHENC
	select CRYPTO_MD5
	select CRYPTO_SHA1
	select CRYPTO_SHA256
	help
	  EIP93 have various crypto HW accelerators. Select this if
	  you want to use the EIP93 modules for any of the crypto algorithms.

	  If the IP supports it, this provide offload for AES - ECB, CBC and
	  CTR crypto. Also provide DES and 3DES ECB and CBC.

	  Also provide AEAD authenc(hmac(x), cipher(y)) for supported algo.

config CRYPTO_DEV_EIP93_GENERIC_SW_MAX_LEN
	int "Max skcipher software fallback length"
	depends on CRYPTO_DEV_EIP93
	default 256
	help
	  Max length of crypt request which
	  will fallback to software crypt of skcipher *except* AES-128.

config CRYPTO_DEV_EIP93_AES_128_SW_MAX_LEN
	int "Max AES-128 skcipher software fallback length"
	depends on CRYPTO_DEV_EIP93
	default 512
	help
	  Max length of crypt request which
	  will fallback to software crypt of AES-128 skcipher.
```

## src/linux/universal/linux-6.6-nss/Documentation/devicetree/bindings/block/block-device.yaml
```yaml
# SPDX-License-Identifier: GPL-2.0-only OR BSD-2-Clause
%YAML 1.2
---
$id: http://devicetree.org/schemas/block/block-device.yaml#
$schema: http://devicetree.org/meta-schemas/core.yaml#

title: block storage device

description: |
  This binding is generic and describes a block-oriented storage device.

maintainers:
  - Daniel Golle <daniel@makrotopia.org>

properties:
  partitions:
    $ref: /schemas/block/partitions.yaml

  nvmem-layout:
    $ref: /schemas/nvmem/layouts/nvmem-layout.yaml#

unevaluatedProperties: false
```

## src/linux/universal/linux-6.6-nss/Documentation/devicetree/bindings/mmc/mmc-card.yaml
```yaml
# SPDX-License-Identifier: GPL-2.0
%YAML 1.2
---
$id: http://devicetree.org/schemas/mmc/mmc-card.yaml#
$schema: http://devicetree.org/meta-schemas/core.yaml#

title: MMC Card / eMMC Generic

maintainers:
  - Ulf Hansson <ulf.hansson@linaro.org>

description: |
  This documents describes the devicetree bindings for a mmc-host controller
  child node describing a mmc-card / an eMMC.

properties:
  compatible:
    const: mmc-card

  reg:
    const: 0

  broken-hpi:
    $ref: /schemas/types.yaml#/definitions/flag
    description:
      Use this to indicate that the mmc-card has a broken hpi
      implementation, and that hpi should not be used.

  block:
    $ref: /schemas/block/block-device.yaml#
    description:
      Represents the block storage provided by an SD card or the
      main hardware partition of an eMMC.

patternProperties:
  '^boot[0-9]+':
    $ref: /schemas/block/block-device.yaml#
    description:
      Represents a boot hardware partition on an eMMC.

required:
  - compatible
  - reg

additionalProperties: false

examples:
  - |
    mmc {
        #address-cells = <1>;
        #size-cells = <0>;

        card@0 {
            compatible = "mmc-card";
            reg = <0>;
            broken-hpi;

            block {
                partitions {
                    cal_data: block-partition-rf {
                        partnum = <3>;
                        partname = "rf";

                        nvmem-layout {
                            compatible = "fixed-layout";
                            #address-cells = <1>;
                            #size-cells = <1>;

                            eeprom@0 {
                                reg = <0x0 0x1000>;
                            };
                        };
                    };
                };
            };

            boot1 {
                nvmem-layout {
                    compatible = "fixed-layout";
                    #address-cells = <1>;
                    #size-cells = <1>;

                    macaddr: macaddr@a {
                        compatible = "mac-base";
                        reg = <0xa 0x6>;
                        #nvmem-cell-cells = <1>;
                    };
                };
            };
        };
    };

...
```

## src/linux/universal/linux-6.6-nss/Documentation/devicetree/bindings/phy/qcom,ipq5018-uniphy-pcie.yaml
```yaml
# SPDX-License-Identifier: (GPL-2.0 OR BSD-2-Clause)
%YAML 1.2
---
$id: http://devicetree.org/schemas/phy/qcom,ipq5018-uniphy-pcie.yaml#
$schema: http://devicetree.org/meta-schemas/core.yaml#

title: Qualcomm IPQ5018 UNIPHY PCIe PHY driver

maintainers:
  - Nitheesh Sekar <quic_nsekar@quicinc.com>
  - Sricharan Ramabadhran <quic_srichara@quicinc.com>

properties:
  compatible:
    enum:
      - qcom,ipq5018-uniphy-pcie-gen2x1
      - qcom,ipq5018-uniphy-pcie-gen2x2

  reg:
    maxItems: 1

  clocks:
    maxItems: 1

  clock-names:
    items:
      - const: pipe_clk

  resets:
    maxItems: 2

  reset-names:
    items:
      - const: phy
      - const: phy_phy

  "#phy-cells":
    const: 0

  "#clock-cells":
    const: 0

  clock-output-names:
    maxItems: 1

required:
  - compatible
  - reg
  - resets
  - reset-names
  - clocks
  - clock-names
  - "#phy-cells"
  - "#clock-cells"
  - clock-output-names

additionalProperties: false

examples:
  - |
    #include <dt-bindings/clock/qcom,gcc-ipq5018.h>
    #include <dt-bindings/reset/qcom,gcc-ipq5018.h>

    phy@86000 {
        compatible = "qcom,ipq5018-uniphy-pcie-gen2x2";
        reg = <0x86000 0x800>;
        #phy-cells = <0>;
        #clock-cells = <0>;
        clocks = <&gcc GCC_PCIE0_PIPE_CLK>;
        clock-names = "pipe_clk";
        clock-output-names = "pcie0_pipe_clk";
        assigned-clocks = <&gcc GCC_PCIE1_PIPE_CLK>;
        assigned-clock-rates = <125000000>;
        resets = <&gcc GCC_PCIE0_PHY_BCR>,
                 <&gcc GCC_PCIE0PHY_PHY_BCR>;
        reset-names = "phy", "phy_phy";
    };
```

## src/linux/universal/linux-6.6-nss/Documentation/devicetree/bindings/phy/qcom,ipq5332-usb-ss-uniphy.yaml
```yaml
# SPDX-License-Identifier: (GPL-2.0 OR BSD-2-Clause)
%YAML 1.2
---
$id: http://devicetree.org/schemas/phy/qcom,ipq5332-usb-ss-uniphy.yaml#
$schema: http://devicetree.org/meta-schemas/core.yaml#

title: Qualcomm USB Super-Speed UNIPHY

maintainers:
  - Praveenkumar I <quic_ipkumar@quicinc.com>
  - Varadarajan Narayanan <quic_varada@quicinc.com>

description:
  USB Super-Speed UNIPHY found in Qualcomm IPQ5332, IPQ5018 SoCs.

properties:
  compatible:
    - enum:
      - qcom,ipq5018-usb-ss-uniphy
      - qcom,ipq5332-usb-ss-uniphy

  reg:
    maxItems: 1

  clocks:
    maxItems: 3

  clock-names:
    items:
      - const: ahb
      - const: cfg_ahb
      - const: pipe

  resets:
    maxItems: 1

  vdd-supply:
    description:
      Phandle to 5V regulator supply to PHY digital circuit.

  qcom,phy-usb-mux-sel:
    description: PHY Mux Selection for USB
    $ref: /schemas/types.yaml#/definitions/phandle-array
    items:
      - items:
          - description: phandle of TCSR syscon
          - description: offset of PHY Mux selection register

  "#clock-cells":
    const: 0

  clock-output-names:
    maxItems: 1

  "#phy-cells":
    const: 0

additionalProperties: false

examples:
  - |
    #include <dt-bindings/clock/qcom,ipq5332-gcc.h>
    usb-phy@4b0000 {
        compatible = "qcom,ipq5332-usb-uniphy";
        reg = <0x4b0000 0x800>;

        clocks = <&gcc GCC_PCIE3X1_PHY_AHB_CLK>,
                 <&gcc GCC_USB0_PHY_CFG_AHB_CLK>,
                 <&gcc GCC_USB0_PIPE_CLK>;
        clock-names = "ahb",
                      "cfg_ahb",
                      "pipe";

        resets =  <&gcc GCC_USB0_PHY_BCR>;

        #clock-cells = <0>;
        clock-output-names = "usb0_pipe_clk_src";

        #phy-cells = <0>;

        qcom,phy-usb-mux-sel = <&tcsr 0x10540>;

        vdd-supply = <&regulator_fixed_5p0>;
    };
```

## src/linux/universal/linux-6.6-nss/drivers/base/regmap/Kconfig
```kconfig
# SPDX-License-Identifier: GPL-2.0
# Generic register map support.  There are no user servicable options here,
# this is an API intended to be used by other kernel subsystems.  These
# subsystems should select the appropriate symbols.

config REGMAP
	tristate
	select IRQ_DOMAIN if REGMAP_IRQ
	select MDIO_BUS if REGMAP_MDIO
	help
	  Enable support for the Register Map (regmap) access API.

	  Usually, this option is automatically selected when needed.
	  However, you may want to enable it manually for running the regmap
	  KUnit tests.

	  If unsure, say N.

config REGMAP_KUNIT
	tristate "KUnit tests for regmap"
	depends on KUNIT
	default KUNIT_ALL_TESTS
	select REGMAP_RAM

config REGMAP_BUILD
	bool "Enable regmap build"
	depends on KUNIT
	select REGMAP
	help
	  This option exists purely to allow the regmap KUnit tests to
	  be enabled without having to enable some driver that uses
	  regmap due to unfortunate issues with how KUnit tests are
	  normally enabled.

config REGMAP_AC97
	select REGMAP
	tristate

config REGMAP_I2C
	select REGMAP
	tristate
	depends on I2C

config REGMAP_SLIMBUS
	select REGMAP
	tristate
	depends on SLIMBUS

config REGMAP_SPI
	select REGMAP
	tristate
	depends on SPI

config REGMAP_SPMI
	select REGMAP
	tristate
	depends on SPMI

config REGMAP_W1
	select REGMAP
	tristate
	depends on W1

config REGMAP_MDIO
	select REGMAP
	tristate

config REGMAP_MMIO
	select REGMAP
	tristate

config REGMAP_IRQ
	select REGMAP
	bool

config REGMAP_RAM
	select REGMAP
	tristate

config REGMAP_SOUNDWIRE
	select REGMAP
	tristate
	depends on SOUNDWIRE

config REGMAP_SOUNDWIRE_MBQ
	select REGMAP
	tristate
	depends on SOUNDWIRE

config REGMAP_SCCB
	select REGMAP
	tristate
	depends on I2C

config REGMAP_I3C
	select REGMAP
	tristate
	depends on I3C

config REGMAP_SPI_AVMM
	select REGMAP
	tristate
	depends on SPI

config REGMAP_FSI
	select REGMAP
	tristate
	depends on FSI
```

## src/linux/universal/linux-6.6-nss/drivers/net/pcs/Kconfig
```kconfig
# SPDX-License-Identifier: GPL-2.0-only
#
# PCS Layer Configuration
#

menu "PCS device drivers"

config PCS_XPCS
	tristate
	select PHYLINK
	help
	  This module provides helper functions for Synopsys DesignWare XPCS
	  controllers.

config PCS_LYNX
	tristate
	help
	  This module provides helpers to phylink for managing the Lynx PCS
	  which is part of the Layerscape and QorIQ Ethernet SERDES.

config PCS_MTK_LYNXI
	tristate
	select REGMAP
	help
	  This module provides helpers to phylink for managing the LynxI PCS
	  which is part of MediaTek's SoC and Ethernet switch ICs.

config PCS_MTK_USXGMII
	tristate "MediaTek USXGMII PCS"
	select PCS_MTK_LYNXI
	select PHY_MTK_PEXTP
	select PHYLINK
	help
	  This module provides a driver for MediaTek's USXGMII PCS supporting
	  10GBase-R, 5GBase-R and USXGMII interface modes.
	  1000Base-X, 2500Base-X and Cisco SGMII are supported on the same
	  differential pairs via an embedded LynxI PHY.

config PCS_RZN1_MIIC
	tristate "Renesas RZ/N1 MII converter"
	depends on OF && (ARCH_RZN1 || COMPILE_TEST)
	help
	  This module provides a driver for the MII converter that is available
	  on RZ/N1 SoCs. This PCS converts MII to RMII/RGMII or can be set in
	  pass-through mode for MII.

endmenu
```

## src/linux/universal/linux-6.6/Documentation/devicetree/bindings/block/partition.yaml
```yaml
# SPDX-License-Identifier: GPL-2.0-only OR BSD-2-Clause
%YAML 1.2
---
$id: http://devicetree.org/schemas/block/partition.yaml#
$schema: http://devicetree.org/meta-schemas/core.yaml#

title: Partition on a block device

description: |
  This binding describes a partition on a block device.
  Partitions may be matched by a combination of partition number, name,
  and UUID.

maintainers:
  - Daniel Golle <daniel@makrotopia.org>

properties:
  $nodename:
    pattern: '^block-partition-.+$'

  partnum:
    description:
      Matches partition by number if present.

  partname:
    "$ref": "/schemas/types.yaml#/definitions/string"
    description:
      Matches partition by PARTNAME if present.

  uuid:
    "$ref": "/schemas/types.yaml#/definitions/string"
    description:
      Matches partition by PARTUUID if present.

  nvmem-layout:
    $ref: /schemas/nvmem/layouts/nvmem-layout.yaml#
    description:
      This container may reference an NVMEM layout parser.

anyOf:
  - required:
    - partnum

  - required:
    - partname

  - required:
    - uuid

unevaluatedProperties: false
```

## src/linux/universal/linux-6.6/Documentation/devicetree/bindings/net/realtek,rtl8152.yaml
```yaml
# SPDX-License-Identifier: GPL-2.0
%YAML 1.2
---
$id: http://devicetree.org/schemas/net/realtek,rtl8152.yaml#
$schema: http://devicetree.org/meta-schemas/core.yaml#

title: Realtek RTL8152/RTL8153 series USB ethernet

maintainers:
  - David Bauer <mail@david-bauer.net>

properties:
  compatible:
    oneOf:
      - items:
          - enum:
              - realtek,rtl8152
              - realtek,rtl8153

  reg:
    description: The device number on the USB bus

  realtek,led-data:
    description: Value to be written to the LED configuration register.

required:
  - compatible
  - reg

examples:
  - |
    usb-eth@2 {
      compatible = "realtek,rtl8153";
      reg = <2>;
      realtek,led-data = <0x87>;
    };
```
