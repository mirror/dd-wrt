## src/linux/xscale/linux-2.6.17/drivers/net/ixp400/Kconfig
```kconfig
config IXP400_ETH
	tristate "Intel IXP400 Ethernet Device support"
	depends on NET_ETHERNET && IXP400_LIB
	default m
	help
	  If you select M here, the Intel IXP400 Ethernet driver will be
	  compiled as part of the build.

	  To enable this option you must enable 'IXP400 Access Library' in the
	  'System Type' section.

	  In order for the driver to build correctly you must set up some
	  environment variables before building the kernel. See the README
	  files that accompany the IXP400 software or Linux Ethernet Driver
	  distribution for details.

	  Note that this driver is Intel proprietary code and must be obtained
	  from Intel Corp. See the README files that accompany the IXP400
	  software or Linux Ethernet Driver distribution for details.

	  The driver can be compiled only as a module, as linking it
	  statically into the kernel would violate the GPL. The module will be
	  called ixp400_eth.o

	  Select M if you have the IXP400 ethernet driver source code and wish
	  to include it in your build.

choice
	prompt "Intel IXP400 Ethernet Device Driver NPE support"
	depends IXP400_ETH
	default IXP400_ETH_ALL
	help
	  If you select 'All NPEs' option here, the Intel IXP400 Ethernet driver
	  will be compiled to configure all Ethernet NPEs and map "ixp0" device
	  to Ethernet NPE B and "ixp1" device to Ethernet NPE C
	  
	  If you select 'NPEB-only' option here, the Intel IXP400 Ethernet driver
	  will be compiled to map "ixp0" device to Ethernet NPE B.

	  If you select 'NPEC-only' option here, the Intel IXP400 Ethernet driver
	  will be compiled to map "ixp0" device to Ethernet NPE C.

	  See the README files that accompany the IXP400
	  software or Linux Ethernet Driver distribution for details.
		
config IXP400_ETH_ALL
	bool "All-NPEs"

config IXP400_ETH_NPEB_ONLY
	bool "NPEB-only"
	
config IXP400_ETH_NPEC_ONLY
	bool "NPEC-only"

endchoice

config IXP400_ETH_SKB_RECYCLE
	bool "Intel IXP400 Ethernet Device Driver Fast Skb Recycling support"
	depends IXP400_ETH
	default n
	help
	  If you select Y here, the Intel IXP400 Ethernet driver will be
	  compiled to internally recycle skbufs.

	  IMPORTANT: This option, if enabled, may NOT work with some
	  patched kernels.

	  If unsure select N here.

	  See the README files that accompany the IXP400
	  software or Linux Ethernet Driver distribution for details.
	
config IXP400_ETH_QDISC_ENABLED	
	bool "Intel IXP400 Ethernet Device Driver Fast QDisc support"
	depends IXP400_ETH
	default n
	help
	  If you select Y here, the Intel IXP400 Ethernet driver will be
	  compiled to internally use its own queueing discipline (qdisc).

	  IMPORTANT: This option may NOT work with some debug tools or
	  some kernel features.

	  If unsure select N here.

	  See the README files that accompany the IXP400
	  software or Linux Ethernet Driver distribution for details.

config IXP400_NAPI
	bool "IXP400 Ethernet Device Driver NAPI support"
	depends IXP400_ETH
	default n
	help
	  If you select Y here, the Intel IXP400 Ethernet driver will be
	  compiled to use the Linux kernel's NAPI polling interface.

	  See the README files that accompany the IXP400
	  software or Linux Ethernet Driver distribution for details.
```

## src/linux/xscale/linux-2.6.23/drivers/net/ixp4xx/Kconfig
```kconfig
config IXP4XX_QMGR
	tristate "IXP4xx Queue Manager support"
	depends on ARCH_IXP4XX
	depends on NET_ETHERNET
	help
	  The IXP4XX Queue manager is a configurable hardware ringbuffer.
	  It is used by the NPEs to exchange data from and to the CPU.
	  You can either use this OR the Intel Access Library (IAL)

config IXP4XX_NPE
	tristate "IXP4xx NPE support"
	depends on ARCH_IXP4XX
	depends on NET_ETHERNET
	help
	  The IXP4XX NPE driver supports the 3 CPU co-processors called
	  "Network Processing Engines" (NPE). It adds support fo downloading
	  the Microcode (firmware) via Hotplug or  character-special-device.
	  More about this at: Documentation/networking/ixp4xx/README.
	  You can either use this OR the Intel Access Library (IAL)

config IXP4XX_FW_LOAD
	bool "Use Firmware hotplug for Microcode download"
	depends on IXP4XX_NPE
	select HOTPLUG
	select FW_LOADER
	help
	  The default hotplug script will load the Firmware from
	  /usr/lib/hotplug/firmware/NPE-[ABC]
	  see Documentation/firmware_class/hotplug-script

config IXP4XX_MAC
	tristate "IXP4xx MAC support"
	depends on IXP4XX_NPE
	depends on IXP4XX_QMGR
	depends on NET_ETHERNET
	select MII
	help
	  The IXP4XX MAC driver supports the MACs on the IXP4XX CPUs.
	  There are 2 on ixp425 and up to 5 on ixdp465.
	  You can either use this OR the Intel Access Library (IAL)

config IXP4XX_CRYPTO
	tristate "IXP4xx crypto support"
	depends on IXP4XX_NPE
	depends on IXP4XX_QMGR
	help
	  This driver is a generic NPE-crypto access layer.
	  You need additional code in OCF for example.
```

## src/linux/xscale/linux-2.6.24/arch/arm/mach-mv88fxx81/LSP/Kconfig
```kconfig
if ARCH_MV88fxx81

menu "mv88fxx81 Options"
	depends on ARCH_MV88fxx81

choice
	prompt "system type (mv88f1181 / mv88f5181)"
	default ARCH_MV88f1181

config ARCH_MV88f1181
	bool "Support for mv88f1181"
	---help---
	  Choosing this option will generate a linux kernel for the mv88f1181

config ARCH_MV88f5181
	bool "Support for mv88f5181"
	---help---
	  Choosing this option will generate a linux kernel for the mv88f5181

endchoice

config  MV88F5182
        bool "Support for Orion-NAS"
        depends on ARCH_MV88f5181
        ---help---

config  VOIP_RD2
        bool "Support for Orion voip RD2 boards"
        depends on ARCH_MV88f5181
        ---help---
            Choosing this option will generate image for the Viop RD2 board.

config  VOIP_RD2_5181L
        bool "Support for Orion voip RD2 boards with the MV88f5181L chipset"
        depends on VOIP_RD2
        ---help---
            Choosing this option will generate image for the Viop RD2 board with 5181L support.  

config  MV_88W8660
        bool "Support for Shark"
        depends on ARCH_MV88f5181
        ---help---


config ARCH_SUPPORTS_BIG_ENDIAN
	bool
	 default y

config USE_DSP
        bool "use pld/ldrd/strd arm DSP instructions"
          default n

config MV_DMA_COPYUSER
       bool "Support DMA copy_to_user() and copy_from_user"
       depends on (ARCH_MV88f5181) && EXPERIMENTAL
         default n
       help
         Say Y here if you want to use the DMA engine to perform
         copy_to_user() and copy_from_user() functionality.

config  MV88fxx81_PROC
	bool "Support for MV-shell proc file system"
	depends on PROC_FS
	---help---	
	  Choosing this option will enable you to use the MV-shell through the Proc
	  File system.
	  The MV-shell is a debug utility which can be run from the shell.

config  UBOOT_STRUCT
	bool "Use UBoot Marvell tag structure"
	---help---
	  Choosing this option will cause the linux to extract the Tclk, Sysclk and
	  the uboot version from the Tag list passed by the uboot.

choice
	prompt "usb mode"
	depends on ARCH_MV88f5181 && !UBOOT_STRUCT
	default MV_USB_HOST

config MV_USB_HOST
	bool "Support for usb host"
	---help---
	Choosing this option will configure on chip USB Controller to work in Host mode

config MV_USB_DEVICE
	bool "Support for usb device"
	---help---
	Choosing this option will configure on chip USB Controller to work in Device mode

endchoice

config  MV_DBG_TRACE
	bool "Enable tracing utility"
	default n
	---help---
	  Choosing this debug option will cause some kernel modules to log operations into
	  a cyclic buffer and dump them on failures. Enabling this feature decreases performance.

menu "Networking options"

choice 
	prompt "Network driver"

config MV_EGIGA
	bool "egiga"

config MV_GATEWAY
	bool "gateway"
	---help---
	  Choose this option to support the on-board QuarterDeck switch family. 

endchoice

config  ETH_0_MACADDR
	string "Giga port MAC address"
	depends on MV_EGIGA
	default "000000000051"
	---help---
	  Set the Giga port MAC address.

config  EGIGA_PROC
	bool "egiga proc FS (for mvEgigaTool)"
	depends on MV_EGIGA
	---help---
	  Use mvEgigaTool proc FS.

config  EGIGA_STATIS
        bool "Collect egiga statistics"
        depends on ARCH_MV88f5181
        ---help---
          Collect egiga statistics. Can be displayed using mvEgigaTool.

config EGIGA_MULTI_Q
        bool "Multi Q Support"
        depends on ARCH_MV88f5181
        ---help---
          Use Multi Q.

config MV_GTW_QOS
	bool "ToS based QoS Support"
	depends on MV_GATEWAY
	default y
	---help---
	  Priorities packets marked with special ToS in IP header. 
	  Provides some level of QoS for VoIP packets marked with special ToS.

config MV_GTW_QOS_TOS
	string "ToS value"
	depends on MV_GTW_QOS
	default "0xA0"

config MV_GTW_BASE_MACADDR
	string "Giga port base MAC address"
	depends on MV_GATEWAY
	default "000051810000"
	---help---
	  The base MAC address will be used for the first (eth0) network interface.
	  Other interfaces (if exist) will be assign with consequent addresses.

config  MV_GTW_IGMP
	bool "L2 IGMP Snooping support"
	depends on MV_GATEWAY
	default y
	---help---
	  Support L2 IGMP snooping at the switch level, i.e. directing L3 routed multicast 
	  stream to the specific L2 port which originally received an IGMP Join message, 
	  instead of fluding all VLAN ports.

config  MV_GTW_PROC
	bool "mv_gateway /proc API support (for mvGtwTool)"
	depends on MV_GATEWAY
	---help---
	  Use mvGtwTool proc FS.

endmenu

menu "cesa options"
	depends on MV88F5182 || VOIP_RD2_5181L

config  MV_CESA
        bool
        default y

config	MV_CESA_OCF
	bool "Support for Marvell CESA OCF driver"
	depends on MV_CESA && OCF_OCF
	---help---
          Choosing this option will enable you to use the Marvell Cryptographic Engine and
	  Security Accelerator, under the OCF package.

config  MV_CESA_TOOL
        tristate "Support for Marvell CESA Tool"
        depends on MV_CESA
        ---help---

config  MV_CESA_TEST
	bool "Support for Marvell CESA test driver"
	depends on MV_CESA_TOOL && !MV_CESA_OCF
        ---help---
          Choosing this option will enable you to use the Marvell Cryptographic Engine and
          Security Accelerator, with the mv_cesa_tool in test mode.

endmenu

menu "Telephony options"
	depends on VOIP_RD2_5181L

config  MV_PHONE
	tristate "Support for Marvell telephony support (VoIP)"
	depends on VOIP_RD2_5181L && PHONE
	---help---
	  Choosing this option enables the Marvell telephony underlying 
	  support for various VoIP applications. 
	  Note, kernel Telephony subsystem must be chosen too.

choice 
	prompt "Sampling mode"
	depends on MV_PHONE

config MV_TDM_LINEAR_MODE
	bool "Linear (16-bit)"

config MV_TDM_ULAW_MODE
	bool "U-Law (8-bit)"

endchoice

endmenu

config  SCSI_MVSATA
        tristate "Support for Marvell Sata Adapters"
        depends on PCI && SCSI
        ---help---
          Choosing this option will enable you to use the Marvell Sata
          adapters support with emulation as SCSI adapters.
          Note that the kernel scsi subsystem must be chosen too.

menu "Sata options"
        depends on SCSI_MVSATA
choice
        prompt "Debug level"
        default SATA_NO_DEBUG

config SATA_NO_DEBUG
        bool "No Debug"

config SATA_DEBUG_ON_ERROR
        bool "Debug on errors"
        help
          print debug messages when EDMA/System/HDD errors occur.

config SATA_FULL_DEBUG
        bool "Full debug"

endchoice

endmenu

endmenu

endif
```
