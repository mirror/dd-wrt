// SPDX-License-Identifier: GPL-2.0-only OR MIT

/dts-v1/;

#include "mt7988a-bananapi-bpi-r4.dtsi"

/ {
	compatible = "bananapi,bpi-r4-2g5", "bananapi,bpi-r4", "mediatek,mt7988a";
	model = "Banana Pi BPI-R4 (1x SFP+, 1x 2.5GbE)";
	chassis-type = "embedded";
};

&gmac1 {
	phy-mode = "internal";
	phy-connection-type = "internal";
	phy = <&int_2p5g_phy>;
};

&int_2p5g_phy {
	pinctrl-names = "i2p5gbe-led";
	pinctrl-0 = <&i2p5gbe_led0_pins>;
};

&gmac1 {
	phy-mode = "internal";
	phy-connection-type = "internal";
	phy = <&int_2p5g_phy>;
	openwrt,netdev-name = "lan4";
	status = "okay";
};

&int_2p5g_phy {
	pinctrl-names = "i2p5gbe-led";
	pinctrl-0 = <&i2p5gbe_led0_pins>;
};
