// SPDX-License-Identifier: GPL-2.0-or-later

#include "rtl838x.dtsi"

#include <dt-bindings/input/input.h>
#include <dt-bindings/gpio/gpio.h>

/ {
/*	aliases {
		led-boot = &led_sys;
		led-failsafe = &led_sys;
		led-running = &led_sys;
		led-upgrade = &led_sys;
	};*/

	memory@0 {
		device_type = "memory";
		reg = <0x0 0x8000000>;
	};

/*	keys {
		compatible = "gpio-keys-polled";
		poll-interval = <20>;

		reset {
			label = "reset";
			gpios = <&gpio1 3 GPIO_ACTIVE_LOW>;
			linux,code = <KEY_RESTART>;
			debounce-interval = <100>;
		};
	};
*/
	leds {
		pinctrl-names = "default";
		pinctrl-0 = <&pinmux_disable_sys_led>;
		compatible = "gpio-leds";

		led_sys: sys {
			label = "green:sys";
			gpios = <&gpio0 0 GPIO_ACTIVE_HIGH>;
		};
	};
};

&spi0 {
	status = "okay";

	flash@0 {
		compatible = "jedec,spi-nor";
		reg = <0>;
		spi-max-frequency = <10000000>;

		partitions {
			compatible = "fixed-partitions";
			#address-cells = <1>;
			#size-cells = <1>;

			partition@0 {
				label = "u-boot";
				reg = <0x0 0x40000>;
			};
			partition@40000 {
				label = "u-boot-env";
				reg = <0x40000 0x10000>;
			};
			partition@50000 {
				label = "u-boot-env2";
				reg = <0x50000 0x10000>;
				read-only;
			};
			partition@60000 {
				label = "jffs";
				reg = <0x60000 0x100000>;
			};
			partition@160000 {
				label = "jffs2";
				reg = <0x160000 0x100000>;
			};
			partition@260000 {
				label = "linux";
				reg = <0x260000 0xd80000>;
				compatible = "openwrt,uimage", "denx,uimage";
				openwrt,ih-magic = <0x83800000>;
			};
			partition@fe0000 {
				label = "nvram";
				reg = <0xfe0000 0x20000>;
			};
			partition@fullflash {
				label = "fullflash";
				reg = <0x0 0x1000000>;
			};
		};
	};
};

&mdio_bus0 {
	INTERNAL_PHY(8)
	INTERNAL_PHY(9)
	INTERNAL_PHY(10)
	INTERNAL_PHY(11)
	INTERNAL_PHY(12)
	INTERNAL_PHY(13)
	INTERNAL_PHY(14)
	INTERNAL_PHY(15)
};

&switch0 {
	ports {
		#address-cells = <1>;
		#size-cells = <0>;

		SWITCH_PORT(8, 01, internal)
		SWITCH_PORT(9, 02, internal)
		SWITCH_PORT(10, 03, internal)
		SWITCH_PORT(11, 04, internal)
		SWITCH_PORT(12, 05, internal)
		SWITCH_PORT(13, 06, internal)
		SWITCH_PORT(14, 07, internal)
		SWITCH_PORT(15, 08, internal)

		port@28 {
			ethernet = <&ethernet0>;
			reg = <28>;
			phy-mode = "internal";

			fixed-link {
				speed = <1000>;
				full-duplex;
			};
		};
	};
};
