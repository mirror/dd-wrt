// SPDX-License-Identifier: GPL-2.0-or-later OR MIT

/dts-v1/;

#include "ipq8074-wxr.dtsi"

/ {
	model = "Buffalo WXR-5950AX12";
	compatible = "buffalo,wxr-5950ax12", "qcom,ipq8074", "qcom,ipq8078";

};

&wifi {
	status = "okay";

	qcom,ath11k-calibration-variant = "Buffalo-WXR-5950AX12";
};
