// SPDX-License-Identifier: GPL-2.0-or-later OR MIT

#include "qcom-ipq8065-nighthawk.dtsi"

/ {
	model = "Netgear Nighthawk XR450";
	compatible = "netgear,xr450", "qcom,ipq8065", "qcom,ipq8064";

};
