// SPDX-License-Identifier: GPL-2.0-or-later OR MIT

#include "qcom-ipq8065-nighthawk.dtsi"

/ {
	model = "Netgear Nighthawk XR500";
	compatible = "netgear,xr500", "qcom,ipq8065", "qcom,ipq8064";

};
