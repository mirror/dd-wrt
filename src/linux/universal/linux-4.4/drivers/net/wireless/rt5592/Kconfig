## src/linux/universal/linux-4.4/drivers/net/wireless/rt7612/rlt_wifi_common/os/linux/Kconfig.rlt_wifi
```kconfig
config WIFI_BASIC_FUNC
	bool "Basic Functions"
	select WIRELESS_EXT
	select WEXT_SPY
	select WEXT_PRIV
        
config WSC_INCLUDED
	bool "WSC(WiFi Simple Config)"
	depends on WIFI_DRIVER
    	default y

config WSC_V2_SUPPORT
	bool "WSC V2(WiFi Simple Config Version 2.0)"
	depends on WIFI_DRIVER
    	default y

config WSC_NFC_SUPPORT
	bool "WSC out-of-band(NFC)"
        depends on WIFI_DRIVER
    	default n

config DOT11N_DRAFT3
	bool "802.11n Draft3"
	depends on WIFI_DRIVER
    	default n
    
config DOT11_VHT_AC
	bool "802.11ac"
	depends on WIFI_DRIVER
    	default n
    
config DOT11W_PMF_SUPPORT
	bool "PMF Support"
	depends on WIFI_DRIVER
    	default n

config TXBF_SUPPORT
    	bool "Tx Bean Forming Support"
    	depends on WIFI_DRIVER
    	default n

#config WMM_ACM_SUPPORT
#	bool "WMM ACM"
#	depends on WIFI_DRIVER
#   	default n
	
config LLTD_SUPPORT
	bool "LLTD (Link Layer Topology Discovery Protocol)"
	depends on WIFI_DRIVER
    	default n

config QOS_DLS_SUPPORT
	bool "802.11e DLS ((Direct-Link Setup) Support"
	depends on WIFI_DRIVER
    	default n

config WAPI_SUPPORT
	bool "WAPI Support"
	depends on WIFI_DRIVER
    	default n

config CARRIER_DETECTION_SUPPORT
	bool "Carrier Detect"
	depends on WIFI_DRIVER
    	default n

config ED_MONITOR_SUPPORT
        bool "ED CCA Monitor Support"
        depends on WIFI_DRIVER
        default n

config IGMP_SNOOP_SUPPORT
	bool "IGMP Snooping"
	depends on WIFI_DRIVER
    	default n

config BLOCK_NET_IF
	bool "NETIF Block"
	depends on WIFI_DRIVER
    	default n

#config VIDEO_TURBINE_SUPPORT
#	bool "Video Turbine support"
#	depends on WIFI_DRIVER
#   	default n

#config RA_CLASSIFIER
#	tristate "Ralink Flow Classifier"
#	depends on WIFI_DRIVER
#	default n

config RATE_ADAPTION
    	bool "New Rate Adaptation Support"
    	depends on WIFI_DRIVER
    	default n

config NEW_RATE_ADAPT_SUPPORT
    	bool "Intelligent Rate Adaption"
	depends on RATE_ADAPTION
    	depends on WIFI_DRIVER
    	default y

config AGS_SUPPORT
	bool "Adaptive Group Switching"
	depends on RATE_ADAPTION
	depends on WIFI_DRIVER
    	default n
    
config IDS_SUPPORT
	bool "IDS(Intrusion Detection System) Support"
	depends on WIFI_DRIVER
    	default n

config WIFI_WORK_QUEUE
	bool "Work Queue"
	depends on WIFI_DRIVER
    	default n

config WIFI_SKB_RECYCLE
    	bool "SKB Recycle(Linux)"
    	depends on WIFI_DRIVER
    	default n

config RTMP_FLASH_SUPPORT
	bool "Flash Support"
	depends on WIFI_DRIVER
    	default n

config LED_CONTROL_SUPPORT
	bool "LED Control Support"
	depends on WIFI_DRIVER
    	default n

config SINGLE_SKU_V2
    	bool "Single SKU V2"
    	depends on WIFI_DRIVER || RALINK_RT6352
    	default n

config HW_ANTENNA_DIVERSITY
	bool "Antenna Diversity Support"
	depends on RLT_AP_SUPPORT || RLT_STA_SUPPORT
	depends on RALINK_RT5350
    	default n

config ATE_SUPPORT
	bool "ATE/QA Support"
	depends on WIFI_DRIVER
    	default n

config  RT2860V2_AP_32B_DESC
	bool "32 Byte Descriptor Support"
	depends on WIFI_DRIVER
	depends on RALINK_RT6352 || RALINK_MT7620
	default n

config RT2860V2_AP_MEMORY_OPTIMIZATION
	bool "Memory Optimization"
	depends on WIFI_DRIVER
    	default n

config RTMP_INTERNAL_TX_ALC
    	bool "TSSI Compensation"
    	depends on WIFI_DRIVER
    	depends on RALINK_RT3350 || RALINK_RT3352 || RALINK_RT5350 || RALINK_RT6352
	default n
    
config RTMP_TEMPERATURE_CALIBRATION
    	bool "Temperature Calibration"
    	depends on WIFI_DRIVER
    	depends on RALINK_RT6352
    	default n

config HOTSPOT
	bool "Passpoint-R1 Support"
	depends on WIFI_DRIVER
    	default n

config CO_CLOCK_SUPPORT
        bool "co-clock Support"
        depends on WIFI_DRIVER
    	default n

menu "PA/LNA Settings of 1st Card"
config FIRST_CARD_EXTERNAL_PA
        bool "External Power Amplifier(PA)"
        depends on WIFI_DRIVER
    default n

config FIRST_CARD_EXTERNAL_LNA
        bool "External Low-Noise Amplifier(LNA)"
        depends on WIFI_DRIVER
    default n
endmenu

menu "PA/LNA Settings of 2nd Card"
config SECOND_CARD_EXTERNAL_PA
        bool "External Power Amplifier(PA)"
        depends on WIFI_DRIVER
    default n

config SECOND_CARD_EXTERNAL_LNA
        bool "External Low-Noise Amplifier(LNA)"
        depends on WIFI_DRIVER
    default n
endmenu

#
# Section for chip architectures
#
# "RLT MAC Support"
config RLT_MAC
	bool
	depends on WIFI_DRIVER
    	default n

config RLT_BBP
    	bool

config RLT_RF
    	bool

# "RTMP MAC Support"
config RTMP_MAC
	bool
	depends on WIFI_DRIVER
    	default n

config RTMP_BBP
    	bool

config RTMP_RF
    	bool

#
# Section for interfaces
#
config RTMP_PCI_SUPPORT
    	bool

config RTMP_USB_SUPPORT
    	bool

config RTMP_RBUS_SUPPORT
    	bool
```

## src/linux/universal/linux-4.4/drivers/net/wireless/rt7612/rlt_wifi_common/os/linux/Kconfig.rlt_wifi_ap
```kconfig
config RLT_AP_SUPPORT
	tristate "MediaTek RLT WiFi AP Support"
#	depends on NET_RADIO 
	select WIRELESS_EXT
	select WEXT_SPY
	select WEXT_PRIV

config WDS_SUPPORT
	bool "WDS"
	depends on RLT_AP_SUPPORT

config MBSS_SUPPORT
	bool "MBSSID"
	depends on RLT_AP_SUPPORT

config NEW_MBSSID_MODE
	bool "New MBSSID Mode"
	depends on RLT_AP_SUPPORT || RALINK_RT3883 || RALINK_RT3352 || RALINK_RT5350 || RALINK_RT6352 || RALINK_MT7620
	depends on MBSS_SUPPORT
	default n

config ENHANCE_NEW_MBSSID_MODE
    	bool "Enhanced MBSSID Mode"
    	depends on NEW_MBSSID_MODE
    	default n

config APCLI_SUPPORT
	bool "AP-Client Support"
	depends on RLT_AP_SUPPORT

config APCLI_CERT_SUPPORT
        bool "AP-Client TGn Cert Support"
	depends on RLT_AP_SUPPORT
        depends on APCLI_SUPPORT
        default n

config MAC_REPEATER_SUPPORT
	bool "MAC Repeater Support"
	depends on RLT_AP_SUPPORT || RALINK_RT6352 || RALINK_MT7620
	depends on APCLI_SUPPORT
	default n

config DFS_SUPPORT
	bool "DFS Support"
	depends on RLT_AP_SUPPORT
	select RALINK_TIMER_DFS

config LLTD_SUPPORT
	bool "LLTD (Link Layer Topology Discovery Protocol)"
	depends on RLT_AP_SUPPORT
	default n

config NINTENDO_AP
	bool "Nintendo AP Support"
	depends on RLT_AP_SUPPORT
	default n

config COC_SUPPORT
	bool "CoC Support"
	depends on RLT_AP_SUPPORT
	default n

config DELAYED_TCP_ACK_SUPPORT
        bool "Delayed TCP ACK Support"
        depends on RLT_AP_SUPPORT
        default n

#config MESH_SUPPORT
#       bool "MESH Support"
#       depends on RLT_AP_SUPPORT

#config DOT11R_FT_SUPPORT
#       bool "802.11r Fast BSS Transition"
#       depends on RLT_AP_SUPPORT

#config DOT11K_RRM_SUPPORT
#       bool "802.11k Radio Resource Management"
#       depends on RLT_AP_SUPPORT

#config RT2860V2_SNMP
#	bool "Net-SNMP Support"
#	depends on RLT_AP_SUPPORT

#config MCAST_RATE_SPECIFIC
#	bool "User specific tx rate of mcast pkt"
#	depends on RLT_AP_SUPPORT

#config EXT_BUILD_CHANNEL_LIST
#	bool "Extension Channel List"
#	depends on RLT_AP_SUPPORT

#config AUTO_CH_SELECT_ENHANCE
#	bool "Auto Channel Selection Enhancement"
#	depends on RLT_AP_SUPPORT
```

## src/linux/universal/linux-4.4/drivers/net/wireless/rt7612/rlt_wifi_common/os/linux/Kconfig.rlt_wifi_sta
```kconfig
config RLT_STA_SUPPORT
	tristate "MediaTek RLT WiFi STA support"
#	depends on NET_RADIO 
	select WIRELESS_EXT
	select WEXT_SPY
	select WEXT_PRIV

config DOT11Z_TDLS_SUPPORT
   	bool "802.11z TDLS support"
    	depends on RLT_STA_SUPPORT
	default n

#config RT2860V2_EXT_CHANNEL_LIST
#	bool "Extension Channel List"
#	depends on RLT_STA_SUPPORT

#config STA_AUTO_CH_SELECT_ENHANCE
#	bool "Auto Channel Selection Enhancement"
#	depends on RLT_STA_SUPPORT
```

## src/linux/universal/linux-4.4/drivers/net/wireless/rt7620/rt2860v2_ap/Kconfig
```kconfig
config RT2860V2_AP
	tristate "Ralink RT2860 802.11n AP support"
	depends on !SOC_MT7621_OPENWRT
	select WIRELESS_EXT
	select WEXT_SPY
	select WEXT_PRIV
	
config RT2860V2_AP_V24_DATA_STRUCTURE
	bool
	depends on RT2860V2_AP
	default y
	
config  RT2860V2_AP_LED
	bool "LED Support"
	depends on RT2860V2_AP

config  RT2860V2_AP_WSC
	bool "WSC (WiFi Simple Config)"
	depends on RT2860V2_AP

config  RT2860V2_AP_WSC_V2
        bool "WSC 2.0(WiFi Simple Config 2.0)"
        depends on RT2860V2_AP_WSC
        default y

config  RT2860V2_AP_LLTD
	bool "LLTD (Link Layer Topology Discovery Protocol)"
	depends on RT2860V2_AP

config  RT2860V2_AP_WDS
	bool "WDS"
	depends on RT2860V2_AP

#config  RT2860V2_AP_WMM_ACM
#	bool "WMM ACM"
#	depends on RT2860V2_AP

config  RT2860V2_AP_MBSS
	bool "MBSSID"
	depends on RT2860V2_AP

config	NEW_MBSSID_MODE
	bool "New MBSSID MODE"
	depends on RT2860V2_AP
	depends on RT2860V2_AP_MBSS
	depends on RALINK_RT3883 || RALINK_RT3352 || RALINK_RT5350 || RALINK_RT6352 || SOC_MT7620_OPENWRT
	default n

config  RT2860V2_AP_APCLI
	bool "AP-CLient Support"
	depends on RT2860V2_AP

config  RT2860V2_AP_MAC_REPEATER
	bool "MAC Repeater Support"
	depends on RT2860V2_AP
	depends on RT2860V2_AP_APCLI
	depends on RALINK_RT6352 || SOC_MT7620_OPENWRT
	default n

config  RT2860V2_AP_IGMP_SNOOP
	bool "IGMP snooping"
	depends on RT2860V2_AP

config  RT2860V2_AP_NETIF_BLOCK
	bool "NETIF Block"
	depends on RT2860V2_AP
	help
	Support Net interface block while Tx-Sw queue full

config  RT2860V2_AP_DFS
	bool "DFS"
	depends on RT2860V2_AP
	select RALINK_TIMER_DFS

config  RT2860V2_AP_CARRIER
	bool "Carrier Detect"
	depends on RT2860V2_AP

config  RT2860V2_AP_DLS
	bool "DLS ((Direct-Link Setup) Support"
	depends on RT2860V2_AP

config  RT2860V2_AP_IDS
	bool "IDS (Intrusion Detection System) Support"
	depends on RT2860V2_AP

config  RT2860V2_HW_ANTENNA_DIVERSITY
	bool "Antenna Diversity Support"
	depends on RT2860V2_AP
	depends on RALINK_RT5350

#config  RT2860V2_AP_WAPI
#	bool "WAPI Support"
#	depends on RT2860V2_AP

config  RT2860V2_AP_COC
	bool "CoC Support"
	depends on RT2860V2_AP
	default y

config  RT2860V2_AP_MEMORY_OPTIMIZATION
	bool "Memory Optimization"
	depends on RT2860V2_AP

config  RT2860V2_AP_VIDEO_TURBINE
	bool "Video Turbine support"
	depends on RT2860V2_AP

config  RA_CLASSIFIER
	tristate "Ralink Flow Classifier"
	depends on RT2860V2_AP_VIDEO_TURBINE
	default n

config  RT2860V2_AP_INTELLIGENT_RATE_ADAPTION
        bool "Intelligent Rate Adaption"
	depends on RT2860V2_AP
	depends on RALINK_RT2883 || RALINK_RT3883

config  RT2860V2_AP_TXBF
        bool "Tx Bean Forming Support (Only 3883)"
	depends on RT2860V2_AP
	depends on RALINK_RT2883 || RALINK_RT3883
	default y

#config  RT2860V2_EXT_CHANNEL_LIST
#	bool "Extension Channel List"
#	depends on RT2860V2_AP

#config  RT2860V2_KTHREAD
#	bool "Kernel Thread"
#	depends on RT2860V2_AP

#config  RT2860V2_AUTO_CH_SELECT_ENHANCE
#	bool "Auto Channel Selection Enhancement"
#	depends on RT2860V2_AP

config  RT2860V2_AP_80211N_DRAFT3
	bool "802.11n Draft3"
	depends on RT2860V2_AP

#config  RT2860V2_AP_RTMP_INTERNAL_TX_ALC
#        bool "TSSI Compensation"
#        depends on RT2860V2_AP
#        depends on RALINK_RT3350 || RALINK_RT3352 || RALINK_RT5350 || SOC_MT7620_OPENWRT || RALINK_RT6352
#	default n

config  RT2860V2_ADJ_PWR_CONSUMPTION_SUPPORT
        bool "Adjust Power Consumption Support"
        depends on RT2860V2_AP
        depends on SOC_MT7620_OPENWRT || RALINK_RT6352
	default n

config  RT2860V2_SINGLE_SKU
	bool "Single SKU"
	depends on RT2860V2_AP
	default n

choice
	prompt "Choose Power Design"
        depends on SOC_MT7620_OPENWRT || RALINK_RT6352
	default INTERNAL_PA_INTERNAL_LNA
	config  INTERNAL_PA_INTERNAL_LNA
	bool "Internal PA and Internal LNA"
	config  INTERNAL_PA_EXTERNAL_LNA
	bool "Internal PA and External LNA"		
	config  EXTERNAL_PA_EXTERNAL_LNA
	bool "External PA and External LNA"		
endchoice

config  RT2860V2_AP_RTMP_INTERNAL_TX_ALC
        bool "TSSI Compensation"
        depends on RT2860V2_AP
        depends on RALINK_RT3350 || RALINK_RT3352 || RALINK_RT5350 || SOC_MT7620_OPENWRT || RALINK_RT6352
        depends on INTERNAL_PA_INTERNAL_LNA || INTERNAL_PA_EXTERNAL_LNA
	default n

config  RT2860V2_AP_RTMP_TEMPERATURE_COMPENSATION
        bool "Temperature Compensation"
        depends on RT2860V2_AP
        depends on SOC_MT7620_OPENWRT || RALINK_RT6352
	default n

#config  RT2860V2_80211R_FT
#	bool "802.11r Fast BSS Transition"
#	depends on RT2860V2_AP

#config  RT2860V2_80211R_RR
#	bool "802.11k Radio Resource Management"
#	depends on RT2860V2_AP

#config  RT2860V2_MCAST_RATE_SPECIFIC
#	bool "User specific tx rate of mcast pkt"
#	depends on RT2860V2_AP

#config  RT2860V2_SNMP
#	bool "Net-SNMP Support"
#	depends on RT2860V2_AP
```

## src/linux/universal/linux-4.4_bcm4908/Documentation/devicetree/bindings/mmc/octeon-mmc.txt
```
* OCTEON SD/MMC Host Controller

This controller is present on some members of the Cavium OCTEON SoC
family, provide an interface for eMMC, MMC and SD devices.  There is a
single controller that may have several "slots" connected.  These
slots appear as children of the main controller node.
The DMA engine is an integral part of the controller block.

Required properties:
- compatible : Should be "cavium,octeon-6130-mmc" or "cavium,octeon-7890-mmc"
- reg : Two entries:
	1) The base address of the MMC controller register bank.
	2) The base address of the MMC DMA engine register bank.
- interrupts :
	For "cavium,octeon-6130-mmc": two entries:
	1) The MMC controller interrupt line.
	2) The MMC DMA engine interrupt line.
	For "cavium,octeon-7890-mmc": nine entries:
	1) The next block transfer of a multiblock transfer has completed (BUF_DONE)
	2) Operation completed successfully (CMD_DONE).
	3) DMA transfer completed successfully (DMA_DONE).
	4) Operation encountered an error (CMD_ERR).
	5) DMA transfer encountered an error (DMA_ERR).
	6) Switch operation completed successfully (SWITCH_DONE).
	7) Switch operation encountered an error (SWITCH_ERR).
	8) Internal DMA engine request completion interrupt (DONE).
	9) Internal DMA FIFO underflow (FIFO).
- #address-cells : Must be <1>
- #size-cells : Must be <0>

Required properties of child nodes:
- compatible : Should be "cavium,octeon-6130-mmc-slot".
- reg : The slot number.

Optional properties of child nodes:
- cd-gpios : Specify GPIOs for card detection
- wp-gpios : Specify GPIOs for write protection
- power-gpios : Specify GPIOs for power control
- cavium,bus-max-width : The number of data lines present in the slot.
	Default is 8.
- spi-max-frequency : The maximum operating frequency of the slot.
	Default is 52000000.
- cavium,cmd-clk-skew : the amount of delay (in pS) past the clock edge
	to sample the command pin.
- cavium,dat-clk-skew : the amount of delay (in pS) past the clock edge
	to sample the data pin.

Example:
	mmc@1180000002000 {
		compatible = "cavium,octeon-6130-mmc";
		reg = <0x11800 0x00002000 0x0 0x100>,
		      <0x11800 0x00000168 0x0 0x20>;
		#address-cells = <1>;
		#size-cells = <0>;
		/* EMM irq, DMA irq */
		interrupts = <1 19>, <0 63>;

		/* The board only has a single MMC slot */
		mmc-slot@0 {
			compatible = "cavium,octeon-6130-mmc-slot";
			reg = <0>;
			spi-max-frequency = <20000000>;
			/* bus width can be 1, 4 or 8 */
			cavium,bus-max-width = <8>;
			cd-gpios = <&gpio 9 0>;
			wp-gpios = <&gpio 10 0>;
			power-gpios = <&gpio 8 0>;
		};
	};
```

## src/linux/universal/linux-4.4_bcm4908/arch/arm/mach-alpine/Kconfig
```kconfig
menu "Annapurna Labs Alpine Soc Device Tree"
	depends on ARCH_ALPINE

config AL_PCIE_RMN_1010
	bool "Annapurna Labs PCIe RMN 1010 fix"
	depends on AL_DMA
	help
		Use the DMA engine to access pcie memory instead of the CPU.

endmenu
```

## src/linux/universal/linux-4.4_bcm4908/arch/mips/ralink/rt288x/Kconfig
```kconfig
if SOC_RT288X

choice
        prompt "Soc Hardware Type"
	default RT2880_ASIC

config  RT2880_ASIC 
        bool "RT2880-ASIC"

endchoice

endif

if SOC_RT288X

config  RT2860V2_2850
        bool "Dual Band"
        depends on RALINK_RT2880

endif
```
