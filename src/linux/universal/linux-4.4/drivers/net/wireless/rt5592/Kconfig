## src/linux/universal/linux-4.4/drivers/net/wireless/rt5592/Kconfig
```kconfig
config RTPCI_AP
	tristate "Ralink RTPCI 802.11n AP support"
	select WIRELESS_EXT
	select WEXT_SPY
	select WEXT_PRIV

config  RTPCI_AP_LED
	bool "LED Support"
	depends on RTPCI_AP

config  RTPCI_AP_WSC
	bool "WPS support including WPS2.0" 
	depends on RTPCI_AP
	default y

config  RTPCI_AP_WSC_V2
		bool "WSC 2.0(WiFi Simple Config 2.0)"
	depends on RTPCI_AP_WSC
	default y

config  RTPCI_AP_LLTD
	bool "LLTD (Link Layer Topology Discovery Protocol)"
	depends on RTPCI_AP

config  RTPCI_AP_WDS
	bool "WDS support"
	depends on RTPCI_AP

config RTPCI_AP_MBSS
	bool "MBSS support"
	depends on RTPCI_AP
	default y

config RTPCI_AP_NEW_MBSS_MODE
	bool "New MBSS support"
	depends on RTPCI_AP_MBSS
	default y

config  RTPCI_AP_APCLI
	bool "AP-Client Support"
	depends on RTPCI_AP

config RTPCI_AP_IGMP_SNOOP
	bool "IGMP snoop support"
	depends on RTPCI_AP

config  RTPCI_AP_NETIF_BLOCK
	bool "NETIF Block"
	depends on RTPCI_AP
	help
	Support Net interface block while Tx-Sw queue full

config  RTPCI_AP_DFS
	bool "DFS support"
	depends on RTPCI_AP
	#select RALINK_TIMER_DFS

config  RTPCI_AP_CARRIER
	bool "Carrier Detection support"
	depends on RTPCI_AP
	#select RALINK_TIMER_DFS

config  RTPCI_AP_DLS
	bool "DLS ((Direct-Link Setup) Support"
	depends on RTPCI_AP

config  RTPCI_AP_IDS
	bool "IDS (Intrusion Detection System) Support"
	depends on RTPCI_AP

config  RTPCI_AP_FLASH
	bool "Flash Support"
	depends on RTPCI_AP

config RTPCI_AP_WAPI
	bool "WAPI support"
	depends on RTPCI_AP

#config  RTPCI_GREENAP
#	bool "Green AP Support"
#	depends on RTPCI_AP

config RTPCI_80211N_DRAFT3
	bool "802.11n Draft3 support"
	depends on RTPCI_AP
	default y

config  RTPCI_MC_SUPPORT
    bool "Multiple Card Support"
    depends on RTPCI_AP

config  RTPCI_EXT_CHANNEL_LIST
	bool "Extension Channel List"
	depends on RTPCI_AP

# Chip related
config RT3090_AP_INCLUDE
	bool "RT3090 support"
	depends on RTPCI_AP

config RT3593_AP_INCLUDE
	bool "RT3593 support"
	depends on RTPCI_AP

config RTPCI_AP_HIGH_POWER
	bool "High Power Support"
	depends on RTPCI_AP && RT3593_AP_INCLUDE

config RTPCI_AP_VIDEO_TURBINE
	bool "Video Turbine support"
	depends on RTPCI_AP && RT3593_AP_INCLUDE

config RTPCI_TXBF_SUPPORT
	bool "Tx Beamforming support"
	depends on RTPCI_AP && RT3593_AP_INCLUDE

config RT5392_AP_INCLUDE
	bool "RT5392 support"
	depends on RTPCI_AP

config RT5592_AP_INCLUDE
	bool "RT5592 support"
	depends on RTPCI_AP
	default y

config RT5592_EP_SUPPORT
	bool "RT5592 External PA support"
	depends on RT5592_AP_INCLUDE

# ATE
config RTPCI_AP_ATE
	bool "ATE support"
	depends on RTPCI_AP

config RT3090_AP_ATE
	bool "RT3090 ATE support"
	depends on RTPCI_AP_ATE && RT3090_AP_INCLUDE

config RT3593_AP_ATE
	bool "RT3593 ATE support"
	depends on RTPCI_AP_ATE && RT3593_AP_INCLUDE

config RT5392_AP_ATE
	bool "RT5392 ATE support"
	depends on RTPCI_AP_ATE && RT5392_AP_INCLUDE

config RT5592_AP_ATE
	bool "RT5592 ATE support"
	depends on RTPCI_AP_ATE && RT5592_AP_INCLUDE
	default y

# QA
config RTPCI_AP_QA
	bool "QA tool support"
	depends on RTPCI_AP_ATE
	default y
```

## src/linux/universal/linux-4.4/drivers/net/wireless/rt7612/rlt_wifi/Kconfig
```kconfig
config RLT_WIFI
	tristate "RLT WIFI Driver"
	select WIFI_BASIC_FUNC if RLT_WIFI

if RLT_WIFI
menu "WiFi Generic Feature Options"

choice
	prompt "Choose First WiFi Interface"
	config FIRST_IF_NONE
	bool "None"

	config FIRST_IF_RT2860
	bool "RT2860"
	select RTMP_MAC
	select RALINK_RT2860
	
	config FIRST_IF_MT7620
	bool "MT7620"
	select RTMP_MAC
	select RALINK_RT6352

	config FIRST_IF_MT7612E
	bool "MT7612E"
	select RLT_MAC
	select RALINK_MT7612E

endchoice


choice
        prompt "EEPROM Type of 1st Card"
        depends on ! FIRST_IF_NONE

        config FIRST_IF_EEPROM_PROM
        bool "EEPROM"

        config FIRST_IF_EEPROM_EFUSE
        bool "EFUSE"

        config FIRST_IF_EEPROM_FLASH
        bool "FLASH"
endchoice

config RT_FIRST_CARD_EEPROM
        string
        depends on ! FIRST_IF_NONE
        default "prom" if FIRST_IF_EEPROM_PROM
        default "efuse" if FIRST_IF_EEPROM_EFUSE
        default "flash" if FIRST_IF_EEPROM_FLASH

choice
	prompt "Choose Second WiFi Interface"
	config SECOND_IF_NONE
	bool "None"

	config SECOND_IF_RT3092
	bool "RT3092"
	select RTMP_MAC
	select RALINK_RT3092
    
	config SECOND_IF_RT5392
	bool "RT5392"
	select RTMP_MAC
	select RALINK_RT5392
    	
	config SECOND_IF_RT5592
	bool "RT5592"
	select RTMP_MAC
	select RALINK_RT5592
	
	config SECOND_IF_RT3593
	bool "RT3593"
	select RTMP_MAC
	select RALINK_RT5392
    
	config SECOND_IF_RT3572
	bool "RT3572"
	select RTMP_MAC
	select RALINK_RT3572

	config SECOND_IF_RT5572
	bool "RT5572"
	select RTMP_MAC
	select RALINK_RT5572
    
	config SECOND_IF_MT7620
	bool "MT7620"
	select RTMP_MAC
	select RALINK_RT6352
    
	config SECOND_IF_MT7610U
	bool "MT7610U"
	select RLT_MAC
	select RALINK_MT7610U
    
	config SECOND_IF_MT7610E
	bool "MT7610E"
	select RLT_MAC
	select RALINK_MT7610E
    
	config SECOND_IF_RT8592
	bool "RT85592"
	select RLT_MAC
	select RALINK_RT8592
	
	config SECOND_IF_MT7612U
	bool "MT7612U"
	select RLT_MAC
	select RALINK_MT7612U
    
	config SECOND_IF_MT7612E
	bool "MT7612E"
	select RLT_MAC
	select RALINK_MT7612E

endchoice



choice
        prompt "EEPROM Type of 2nd Card"
        depends on ! SECOND_IF_NONE

        config SECOND_IF_EEPROM_PROM
        bool "EEPROM"

        config SECOND_IF_EEPROM_EFUSE
        bool "EFUSE"

        config SECOND_IF_EEPROM_FLASH
        bool "FLASH"
endchoice

config RT_SECOND_CARD_EEPROM
        string
        depends on ! SECOND_IF_NONE
        default "prom" if SECOND_IF_EEPROM_PROM
        default "efuse" if SECOND_IF_EEPROM_EFUSE
        default "flash" if SECOND_IF_EEPROM_FLASH
		
config MULTI_INF_SUPPORT
        bool
        default y if !FIRST_IF_NONE && !SECOND_IF_NONE
		
config WIFI_BASIC_FUNC
	bool "Basic Functions"
	select WIRELESS_EXT
	select WEXT_SPY
	select WEXT_PRIV
        
config WSC_INCLUDED
	bool "WSC (WiFi Simple Config)"
	depends on WIFI_DRIVER
    default y

config WSC_V2_SUPPORT
	bool "WSC V2(WiFi Simple Config Version 2.0)"
	depends on WIFI_DRIVER
    default y

config DOT11N_DRAFT3
	bool "802.11n Draft3"
    default y
    
config DOT11_VHT_AC
	bool "802.11 ac"
    default y
    
config DOT11W_PMF_SUPPORT
	bool "PMF"
	depends on WIFI_DRIVER
    default n

#config WMM_ACM_SUPPORT
#	bool "WMM ACM"
#	depends on WIFI_DRIVER
#   default n
	
config LLTD_SUPPORT
	bool "LLTD (Link Layer Topology Discovery Protocol)"
	depends on WIFI_DRIVER
    default n

config QOS_DLS_SUPPORT
	bool "802.11e DLS ((Direct-Link Setup) Support"
	depends on WIFI_DRIVER
    default n

#config WAPI_SUPPORT
#	bool "WAPI Support"
#	depends on WIFI_DRIVER
#    default n

config CARRIER_DETECTION_SUPPORT
	bool "Carrier Detect"
	depends on WIFI_DRIVER
    default n

config IGMP_SNOOP_SUPPORT
	bool "IGMP snooping"
	depends on WIFI_DRIVER
    default n

config BLOCK_NET_IF
	bool "NETIF Block"
	depends on WIFI_DRIVER
    default n
	help
	Support Net interface block while Tx-Sw queue full

config TXBF_SUPPORT
    bool "Tx Bean Forming Support"
    depends on WIFI_DRIVER
    default n

#config VIDEO_TURBINE_SUPPORT
#	bool "Video Turbine support"
#	depends on WIFI_DRIVER
#   default n

#config RA_CLASSIFIER
#	tristate "Ralink Flow Classifier"
#	depends on WIFI_DRIVER
#	default n

config RATE_ADAPTION
    bool "New Rate Adaptation support"
    default n

config NEW_RATE_ADAPT_SUPPORT
    bool "Intelligent Rate Adaption"
    depends on RATE_ADAPTION
    default y

config AGS_SUPPORT
	bool "Adaptive Group Switching"
	depends on RATE_ADAPTION
    default n
    
config IDS_SUPPORT
	bool "IDS (Intrusion Detection System) Support"
    default n

config WIFI_WORK_QUEUE
	bool "Work Queue"
	depends on WIFI_DRIVER
    default n

config WIFI_SKB_RECYCLE
    bool "SKB Recycle(Linux)"
    depends on WIFI_DRIVER
    default n

config RTMP_FLASH_SUPPORT
	bool "Flash Support"
    default y

config LED_CONTROL_SUPPORT
	bool "LED Support"
	depends on WIFI_DRIVER
    default n

#config SINGLE_SKU
#	bool "Single SKU"
#	depends on WIFI_DRIVER
#    default n

#config SINGLE_SKU_V2
#    bool "Single SKU V2"
#    depends on SINGLE_SKU && RALINK_RT6352
#    default n

config HW_ANTENNA_DIVERSITY
	bool "Antenna Diversity Support"
	depends on RLT_AP_SUPPORT || RLT_STA_SUPPORT
	depends on RALINK_RT5350
    default n

config ATE_SUPPORT
	bool "ATE/QA Support"
	depends on WIFI_DRIVER
    default n

config RT2860V2_AP_V24_DATA_STRUCTURE
	bool
	depends on WIFI_DRIVER
	default y

config  RT2860V2_AP_32B_DESC
	bool "32 Byte Descriptor Support"
	depends on WIFI_DRIVER
	depends on RALINK_RT6352 || RALINK_MT7620
	default n

config MEMORY_OPTIMIZATION
	bool "Memory Optimization"
	depends on WIFI_DRIVER
    default n

config RTMP_INTERNAL_TX_ALC
    bool "TSSI Compensation"
    depends on WIFI_DRIVER
    depends on RALINK_RT3350 || RALINK_RT3352 || RALINK_RT5350 || RALINK_RT6352
	default n
    
config RTMP_TEMPERATURE_CALIBRATION
    bool "Temperature Calibration"
    depends on WIFI_DRIVER
    depends on RALINK_RT6352
    default n

config HOTSPOT
	bool "Passpoint-R1"
	depends on WIFI_DRIVER
    default n
#
# Section for chip architectures
#
# "RLT MAC Support"
config RLT_MAC
	bool
	default y

config RLT_BBP
	bool

config RLT_RF
	bool

# "RTMP MAC Support"
config RTMP_MAC
	bool
	depends on WIFI_DRIVER
	default n

config RTMP_BBP
    	bool

config RTMP_RF
    	bool

#
# Section for interfaces
#
config RTMP_PCI_SUPPORT
    	bool

config RTMP_USB_SUPPORT
	bool

config RTMP_RBUS_SUPPORT
    	bool

endmenu

menu "WiFi Operation Modes"
    choice
        prompt "Main Mode"
        default WIFI_MODE_AP

        config WIFI_MODE_AP
                bool "AP"

        config WIFI_MODE_STA
                bool "STA"

        config WIFI_MODE_BOTH
                bool "APSTA"
    endchoice

    if WIFI_MODE_AP || WIFI_MODE_BOTH
        source "drivers/net/wireless/rt7612/rlt_wifi_ap/Kconfig"
    endif

    #if WIFI_MODE_STA || WIFI_MODE_BOTH
     #   source "drivers/net/wireless/rt7612/rlt_wifi_sta/Kconfig"
    #endif
endmenu	

#"RT2860 series"
config RALINK_RT28XX
        bool
        default n
        select RTMP_PCI_SUPPORT

#"RT3092"
config RALINK_RT3092
        bool
        default n
        select RTMP_PCI_SUPPORT

#"RT3572"
config RALINK_RT3572
        bool
        default n
        select RTMP_USB_SUPPORT

#"RT5392"
config RALINK_RT5392
        bool
        default n
        select RTMP_PCI_SUPPORT

#"RT5572"
config RALINK_RT5572
        bool
        default n
        select RTMP_USB_SUPPORT

#"RT5592"
config RALINK_RT5592
        bool
        default n
        select RTMP_PCI_SUPPORT

#"MT7620/RT6352"
config RALINK_RT6352
        bool
        default n
        select RTMP_RBUS_SUPPORT
#        select RTMP_TEMPERATURE_CALIBRATION
#        select RTMP_INTERNAL_TX_ALC

#"MT7610E"
config RALINK_MT7610E
        bool
        default n
        select RTMP_PCI_SUPPORT

#"MT7610U"
config RALINK_MT7610U
        bool
        default n
        select RTMP_USB_SUPPORT

#"RT8592"
config RALINK_RT8592
        bool
        default n
        select RTMP_PCI_SUPPORT

#"MT7612E"
config RALINK_MT7612E
        bool
        default y
        select RTMP_PCI_SUPPORT

config SECOND_IF_NONE
        bool "no secondary interface"
        default y

#"MT7612U"
config RALINK_MT7612U
        bool
        default n
        select RTMP_USB_SUPPORT

config  RT_FIRST_IF_RF_OFFSET
        hex "first if rf offset"
        depends on ! FIRST_IF_NONE
        default 0x8000

config  RT_SECOND_IF_RF_OFFSET
        hex "second if rf offset"
        depends on ! SECOND_IF_NONE
        default 0x48000


config  RT_FIRST_CARD
        string
        depends on ! FIRST_IF_NONE
        default 2860 if FIRST_IF_RT2860
        default 7620 if FIRST_IF_MT7620
	default 7612e if FIRST_IF_MT7612E
        
config  RT_SECOND_CARD
        string
        depends on ! SECOND_IF_NONE
        default 3090 if SECOND_IF_RT3092
        default 5392 if SECOND_IF_RT5392
        default 5592 if SECOND_IF_RT5592
        default 3593 if SECOND_IF_RT3593
        default 7610 if SECOND_IF_MT7610E
        default 8592 if SECOND_IF_RT8592
        default 3572 if SECOND_IF_RT3572
        default 5572 if SECOND_IF_RT5572
	default 7612e if SECOND_IF_MT7612E
	default 7612u if SECOND_IF_MT7612U

endif
```
