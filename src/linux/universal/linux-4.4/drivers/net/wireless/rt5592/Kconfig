## src/linux/universal/linux-4.9/Documentation/devicetree/bindings/mtd/qcom_nandc.txt
```
* Qualcomm NAND controller

Required properties:
- compatible:		"qcom,ipq806x-nand" for IPQ8064 which uses
			ADM DMA.
			"qcom,ebi2-nand-bam" - nand drivers using BAM DMA
			like IPQ4019.
- reg:			MMIO address range
- clocks:		must contain core clock and always on clock
- clock-names:		must contain "core" for the core clock and "aon" for the
			always on clock
- dmas:			DMA specifier, consisting of a phandle to the ADM DMA
			or BAM DMA controller node and the channel number to
			be used for NAND. Refer to dma.txt, qcom_adm.txt(ADM)
			and qcom_bam_dma.txt(BAM) for more details
- dma-names:		"rxtx" - ADM
			"tx", "rx", "cmd" - BAM
- qcom,cmd-crci:	Only required for ADM DMA. must contain the ADM command
			type CRCI block instance number specified for the NAND
			controller on the given platform.
- qcom,data-crci:	Only required for ADM DMA. must contain the ADM data
			type CRCI block instance number specified for the NAND
			controller on the given platform.
- #address-cells:	<1> - subnodes give the chip-select number
- #size-cells:		<0>

* NAND chip-select

Each controller may contain one or more subnodes to represent enabled
chip-selects which (may) contain NAND flash chips. Their properties are as
follows.

Required properties:
- compatible:		should contain "qcom,nandcs"
- reg:			a single integer representing the chip-select
			number (e.g., 0, 1, 2, etc.)
- #address-cells:	see partition.txt
- #size-cells:		see partition.txt
- nand-ecc-strength:	see nand.txt
- nand-ecc-step-size:	must be 512. see nand.txt for more details.

Optional properties:
- nand-bus-width:	see nand.txt

Each nandcs device node may optionally contain a 'partitions' sub-node, which
further contains sub-nodes describing the flash partition mapping. See
partition.txt for more detail.

Example:

nand@1ac00000 {
	compatible = "qcom,ipq806x-nand","qcom.qcom_nand";
	reg = <0x1ac00000 0x800>;

	clocks = <&gcc EBI2_CLK>,
		 <&gcc EBI2_AON_CLK>;
	clock-names = "core", "aon";

	dmas = <&adm_dma 3>;
	dma-names = "rxtx";
	qcom,cmd-crci = <15>;
	qcom,data-crci = <3>;

	#address-cells = <1>;
	#size-cells = <0>;

	nandcs@0 {
		compatible = "qcom,nandcs";
		reg = <0>;

		nand-ecc-strength = <4>;
		nand-ecc-step-size = <512>;
		nand-bus-width = <8>;

		partitions {
			compatible = "fixed-partitions";
			#address-cells = <1>;
			#size-cells = <1>;

			partition@0 {
				label = "boot-nand";
				reg = <0 0x58a0000>;
			};

			partition@58a0000 {
				label = "fs-nand";
				reg = <0x58a0000 0x4000000>;
			};
		};
	};
};

nand@79B0000 {
	compatible = "qcom,ebi2-nandc-bam";
	reg = <0x79B0000 0x1000>;

	clocks = <&gcc EBI2_CLK>,
		 <&gcc EBI2_AON_CLK>;
	clock-names = "core", "aon";

	dmas = <&qpicbam 0>,
		<&qpicbam 1>,
		<&qpicbam 2>;
	dma-names = "tx", "rx", "cmd";

	#address-cells = <1>;
	#size-cells = <0>;

	nandcs@0 {
		compatible = "qcom,nandcs";
		reg = <0>;

		nand-ecc-strength = <4>;
		nand-ecc-step-size = <512>;
		nand-bus-width = <8>;

		partitions {
			compatible = "fixed-partitions";
			#address-cells = <1>;
			#size-cells = <1>;

			partition@0 {
				label = "boot-nand";
				reg = <0 0x58a0000>;
			};

			partition@58a0000 {
				label = "fs-nand";
				reg = <0x58a0000 0x4000000>;
			};
		};
	};
};
```

## src/linux/universal/linux-4.9/Documentation/devicetree/bindings/phy/ralink-usb-phy.txt
```
Mediatek/Ralink USB PHY

Required properties:
 - compatible: ralink,rt3352-usbphy or mediatek,mt7620-usbphy
 - #phy-cells: should be 0
 - resets: the two reset controllers for host and device
 - reset-names: the names of the 2 reset controllers

Example:

usbphy: phy {
	compatible = "mediatek,mt7620-usbphy";
	#phy-cells = <0>;

	resets = <&rstctrl 22 &rstctrl 25>;
	reset-names = "host", "device";
};
```

## src/linux/universal/linux-4.9/Documentation/devicetree/bindings/thermal/qcom-tsens.txt
```
* QCOM SoC Temperature Sensor (TSENS)

Required properties:
- compatible :
 - "qcom,msm8916-tsens" : For 8916 Family of SoCs
 - "qcom,msm8974-tsens" : For 8974 Family of SoCs
 - "qcom,msm8996-tsens" : For 8996 Family of SoCs

- reg: Address range of the thermal registers
- #thermal-sensor-cells : Should be 1. See ./thermal.txt for a description.
- Refer to Documentation/devicetree/bindings/nvmem/nvmem.txt to know how to specify
nvmem cells

Optional properties:
- interrupts: Interrupt which gets triggered when threshold is hit

Example:
tsens: thermal-sensor@900000 {
		compatible = "qcom,msm8916-tsens";
		reg = <0x4a8000 0x2000>;
		nvmem-cells = <&tsens_caldata>, <&tsens_calsel>;
		nvmem-cell-names = "caldata", "calsel";
		interrupts = <0 178 0>;
		#thermal-sensor-cells = <1>;
	};
```

## src/linux/universal/linux-4.9/arch/mips/crypto/Kconfig
```kconfig
# SPDX-License-Identifier: GPL-2.0

menu "Accelerated Cryptographic Algorithms for CPU (mips)"

config CRYPTO_POLY1305_MIPS
	tristate "Hash functions: Poly1305"
	depends on MIPS
	select CRYPTO_ARCH_HAVE_LIB_POLY1305
	select CRYPTO_LIB_POLY1305
	help
	  Poly1305 authenticator algorithm (RFC7539)

	  Architecture: mips

endmenu
```

## src/linux/universal/linux-4.9/drivers/bus/msm_bus/Kconfig
```kconfig
config BUS_TOPOLOGY_ADHOC
	bool "ad-hoc bus scaling topology"
	depends on ARCH_QCOM
	default n
	help
	  This option enables a driver that can handle adhoc bus topologies.
	  Adhoc bus topology driver allows one to many connections and maintains
	  directionality of connections by explicitly listing device connections
	  thus avoiding illegal routes.

config MSM_BUS_SCALING
	bool "Bus scaling driver"
	depends on BUS_TOPOLOGY_ADHOC
	default n
	help
	  This option enables bus scaling on MSM devices.  Bus scaling
	  allows devices to request the clocks be set to rates sufficient
	  for the active devices needs without keeping the clocks at max
	  frequency when a slower speed is sufficient.
```

## src/linux/universal/linux-4.9/drivers/crypto/msm/Kconfig
```kconfig
config CRYPTO_DEV_OTA_CRYPTO
	tristate "OTA Crypto module"
	help
	  This driver supports QTI OTA Crypto in the FSM9xxx.
	  To compile this driver as a module, choose M here: the
	  module will be called ota_crypto.

config CRYPTO_DEV_QCE50
	bool

config CRYPTO_DEV_QCEDEV
	tristate "QCEDEV Interface to CE module"
	default n
	help
	  This driver supports QTI QCEDEV Crypto in MSM7x30, MSM8660,
	  MSM8960, MSM9615, APQ8064, MSM8974, MSM8916, MSM8994, MSM8996
	  and APQ8084. This exposes the interface to the QCE hardware
	  accelerator via IOCTLs.

	  To compile this driver as a module, choose M here: the
	  module will be called qcedev.

config CRYPTO_DEV_QCOM_ICE
	tristate "Inline Crypto Module"
	default n
	depends on BLK_DEV_DM
	help
	  This driver supports Inline Crypto Engine for QTI chipsets, MSM8994
	  and later, to accelerate crypto operations for storage needs.
	  To compile this driver as a module, choose M here: the
	  module will be called ice.

config CRYPTO_DEV_QCOM_MSM_QCE
	tristate "Qualcomm Technologies,Inc (QTI)  module"
	select  CRYPTO_DEV_QCE50 if ARCH_APQ8084 || ARCH_MSM8916 || ARCH_MSM8994 || ARCH_MSM8996 || ARCH_MSM8992 || ARCH_MSMTITANIUM || ARCH_QCOM
	default n
	help
	  This driver supports QTI Crypto Engine in MSM7x30, MSM8660
	  MSM8x55, MSM8960, MSM9615, MSM8916, MSM8994, MSM8996, FSM9900,
	  MSMTITANINUM and APQ8084.

	  To compile this driver as a module, choose M here: the
	  For MSM7x30 MSM8660 and MSM8x55 the module is called qce
	  For MSM8960, APQ8064 and MSM9615 the module is called qce40
	  For MSM8974, MSM8916, MSM8994, MSM8996, MSM8992, MSMTITANIUM
	  and APQ8084 the module is called qce50.

config CRYPTO_DEV_QCRYPTO
	tristate "QTI Crypto accelerator"
	select CRYPTO_DES
	select CRYPTO_ALGAPI
	select CRYPTO_AUTHENC
	select CRYPTO_BLKCIPHER
	default n
	help
	  This driver supports QTI crypto acceleration.
	  To compile this driver as a module, choose M here: the
	  module will be called qcrypto.
```

## src/linux/universal/linux-6.1-nss/drivers/base/regmap/Kconfig
```kconfig
# SPDX-License-Identifier: GPL-2.0
# Generic register map support.  There are no user servicable options here,
# this is an API intended to be used by other kernel subsystems.  These
# subsystems should select the appropriate symbols.

config REGMAP
	select IRQ_DOMAIN if REGMAP_IRQ
	select MDIO_BUS if REGMAP_MDIO
	tristate

config REGCACHE_COMPRESSED
	select LZO_COMPRESS
	select LZO_DECOMPRESS
	bool

config REGMAP_AC97
	select REGMAP
	tristate

config REGMAP_I2C
	select REGMAP
	tristate
	depends on I2C

config REGMAP_SLIMBUS
	select REGMAP
	tristate
	depends on SLIMBUS

config REGMAP_SPI
	select REGMAP
	tristate
	depends on SPI

config REGMAP_SPMI
	select REGMAP
	tristate
	depends on SPMI

config REGMAP_W1
	select REGMAP
	tristate
	depends on W1

config REGMAP_MDIO
	select REGMAP
	tristate

config REGMAP_MMIO
	select REGMAP
	tristate

config REGMAP_IRQ
	select REGMAP
	bool

config REGMAP_SOUNDWIRE
	select REGMAP
	tristate
	depends on SOUNDWIRE

config REGMAP_SOUNDWIRE_MBQ
	select REGMAP
	tristate
	depends on SOUNDWIRE

config REGMAP_SCCB
	select REGMAP
	tristate
	depends on I2C

config REGMAP_I3C
	select REGMAP
	tristate
	depends on I3C

config REGMAP_SPI_AVMM
	select REGMAP
	tristate
	depends on SPI
```

## src/linux/universal/linux-6.1/fs/apfs/Kconfig
```kconfig
config APFS_FS
	tristate "APFS filesystem support"
	select LIBCRC32C
	select NLS
	help
	  This module provides a small degree of experimental support for the
	  Apple File System (APFS).

	  To compile this file system support as a module, choose M here: the
	  module will be called apfs.

	  This module is out-of-tree, so if you are reading this you probably
	  want to choose Y or M.

config APFS_DEBUG
	bool "APFS debugging support"
	depends on APFS_FS
	help
	  Enable the debugging features for apfs. This may hurt performance,
	  so say N if you are not a developer.
```

## src/linux/universal/linux-6.12-nss/Documentation/devicetree/bindings/phy/mediatek,xfi-tphy.yaml
```yaml
# SPDX-License-Identifier: (GPL-2.0-only OR BSD-2-Clause)
%YAML 1.2
---
$id: http://devicetree.org/schemas/phy/mediatek,xfi-tphy.yaml#
$schema: http://devicetree.org/meta-schemas/core.yaml#

title: MediaTek XFI T-PHY

maintainers:
  - Daniel Golle <daniel@makrotopia.org>

description:
  The MediaTek XFI SerDes T-PHY provides the physical SerDes lanes
  used by the (10G/5G) USXGMII PCS and (1G/2.5G) LynxI PCS found in
  MediaTek's 10G-capabale SoCs.

properties:
  $nodename:
    pattern: "^phy@[0-9a-f]+$"

  compatible:
    const: mediatek,mt7988-xfi-tphy

  reg:
    maxItems: 1

  clocks:
    items:
      - description: XFI PHY clock
      - description: XFI register clock

  clock-names:
    items:
      - const: xfipll
      - const: topxtal

  resets:
    items:
      - description: PEXTP reset

  mediatek,usxgmii-performance-errata:
    $ref: /schemas/types.yaml#/definitions/flag
    description:
      One instance of the T-PHY on MT7988 suffers from a performance
      problem in 10GBase-R mode which needs a work-around in the driver.
      The work-around is enabled using this flag.

  "#phy-cells":
    const: 0

required:
  - compatible
  - reg
  - clocks
  - clock-names
  - resets
  - "#phy-cells"

additionalProperties: false

examples:
  - |
    #include <dt-bindings/clock/mediatek,mt7988-clk.h>
    soc {
      #address-cells = <2>;
      #size-cells = <2>;

      phy@11f20000 {
        compatible = "mediatek,mt7988-xfi-tphy";
        reg = <0 0x11f20000 0 0x10000>;
        clocks = <&xfi_pll CLK_XFIPLL_PLL_EN>,
                 <&topckgen CLK_TOP_XFI_PHY_0_XTAL_SEL>;
        clock-names = "xfipll", "topxtal";
        resets = <&watchdog 14>;
        mediatek,usxgmii-performance-errata;
        #phy-cells = <0>;
      };
    };

...
```

## src/linux/universal/linux-6.12-nss/arch/arm/mach-alpine/Kconfig
```kconfig
# SPDX-License-Identifier: GPL-2.0
config ARCH_ALPINE
	bool "Annapurna Labs Alpine platform"
	depends on ARCH_MULTI_V7
	select CPU_V7
	select HAVE_SMP
	select ARM_AMBA
	select SPARSE_IRQ
	select ARM_GIC
	select GENERIC_IRQ_CHIP
	select GENERIC_IRQ_MULTI_HANDLER
	select HAVE_ARM_ARCH_TIMER
	select ARM_TIMER_SP804
	select CLKDEV_LOOKUP
	select GENERIC_CLOCKEVENTS
	select HAVE_CLK
	select HAVE_ARCH_TIMERS
	select COMMON_CLK
	select HAVE_SCHED_CLOCK
	select ARCH_SCHED_CLOCK
	select MFD_SYSCON
	select ARM_HWCC_FLAG
	select ARM_HAS_SG_CHAIN
	select ARCH_SUPPORTS_BIG_ENDIAN
	select FORCE_PCI
	select PCI_HOST_GENERIC
	select PCI_DOMAINS
	select PCI_DOMAINS_GENERIC
	select ARCH_SUPPORTS_MSI
	select ALPINE_MSI
	select PCI_MSI_IRQ_DOMAIN
	help
	  This enables support for the Annapurna Labs Alpine V1 boards.
```

## src/linux/universal/linux-6.12-nss/arch/mips/ath79/Kconfig
```kconfig
# SPDX-License-Identifier: GPL-2.0
if ATH79

config PCI_AR71XX
	bool "PCI support for AR7100 type SoCs"
	depends on PCI
	def_bool n

config PCI_AR724X
	bool "PCI support for AR724x type SoCs"
	depends on PCI
	def_bool n

endif
```

## src/linux/universal/linux-6.12-nss/drivers/net/phy/realtek/Kconfig
```kconfig
# SPDX-License-Identifier: GPL-2.0-only
config REALTEK_PHY
	tristate "Realtek PHYs"
	select PHY_COMMON_PROPS
	select PHY_PACKAGE
	help
	  Currently supports RTL821x/RTL822x and fast ethernet PHYs

config REALTEK_PHY_MULTIPORT
	tristate "Realtek multiport PHYs"
	depends on PHYLIB
	select PHY_PACKAGE
	help
	  Currently supports RTL8214x/RTL8218x gigabit multiport PHYs

if REALTEK_PHY

config REALTEK_PHY_HWMON
	bool "HWMON support for Realtek PHYs"
	depends on HWMON && !(REALTEK_PHY=y && HWMON=m)
	help
	  Optional hwmon support for the temperature sensor

endif # REALTEK_PHY
```

## src/linux/universal/linux-6.12/Documentation/devicetree/bindings/mtd/mediatek,mt7621-nfc.yaml
```yaml
# SPDX-License-Identifier: GPL-2.0
%YAML 1.2
---
$id: http://devicetree.org/schemas/mtd/mediatek,mt7621-nfc.yaml#
$schema: http://devicetree.org/meta-schemas/core.yaml#

title: MediaTek MT7621 SoC NAND Flash Controller (NFC) DT binding

maintainers:
  - Weijie Gao <weijie.gao@mediatek.com>

description: |
  This driver uses a single node to describe both NAND Flash controller
  interface (NFI) and ECC engine for MT7621 SoC.
  MT7621 supports only one chip select.

properties:
  "#address-cells": false
  "#size-cells": false

  compatible:
    enum:
      - mediatek,mt7621-nfc

  reg:
    items:
      - description: Register base of NFI core
      - description: Register base of ECC engine

  reg-names:
    items:
      - const: nfi
      - const: ecc

  clocks:
    items:
      - description: Source clock for NFI core, fixed 125MHz

  clock-names:
    items:
      - const: nfi_clk

required:
  - compatible
  - reg
  - reg-names
  - clocks
  - clock-names

examples:
  - |
    nficlock: nficlock {
    	#clock-cells = <0>;
    	compatible = "fixed-clock";

    	clock-frequency = <125000000>;
    };

    nand@1e003000 {
    	compatible = "mediatek,mt7621-nfc";

    	reg = <0x1e003000 0x800
    	       0x1e003800 0x800>;
    	reg-names = "nfi", "ecc";

    	clocks = <&nficlock>;
    	clock-names = "nfi_clk";
    };
```

## src/linux/universal/linux-6.12/Documentation/devicetree/bindings/net/mediatek,2p5gphy-fw.yaml
```yaml
# SPDX-License-Identifier: (GPL-2.0-only OR BSD-2-Clause)
%YAML 1.2
---
$id: http://devicetree.org/schemas/net/mediatek,2p5gphy-fw.yaml#
$schema: http://devicetree.org/meta-schemas/core.yaml#

title: MediaTek Built-in 2.5G Ethernet PHY

maintainers:
  - Sky Huang <SkyLake.Huang@mediatek.com>

description: |
  MediaTek Built-in 2.5G Ethernet PHY needs to load firmware so it can
  run correctly.

properties:
  compatible:
    const: "mediatek,2p5gphy-fw"

  reg:
    items:
      - description: pmb firmware load address
      - description: firmware trigger register

required:
  - compatible
  - reg

additionalProperties: false

examples:
  - |
    phyfw: phy-firmware@f000000 {
      compatible = "mediatek,2p5gphy-fw";
      reg = <0 0x0f100000 0 0x20000>,
            <0 0x0f0f0018 0 0x20>;
    };
```
